&mdss_mdp {
	dsi_lgd_sw49105_fhd_incell_vid: qcom,mdss_dsi_lgd_incell_sw49105_fhd_video{
		compatible = "qcom,mdss-dsi-panel";
		status = "disable";
		qcom,cont-splash-enabled;
		qcom,mdss-dsi-panel-name = "LGD INCELL SW49105 FHD video mode dsi panel";
		qcom,mdss-dsi-panel-controller = <&mdss_dsi0>;
		qcom,mdss-dsi-panel-type = "dsi_video_mode";
		qcom,mdss-dsi-panel-destination = "display_1";
		qcom,mdss-dsi-panel-framerate = <60>;
		qcom,mdss-dsi-force-clock-lane-hs;
		qcom,mdss-dsi-virtual-channel-id = <0>;
		qcom,mdss-dsi-stream = <0>;
		qcom,mdss-dsi-lp11-init;
		qcom,suspend-ulps-enabled;
		qcom,mdss-dsi-panel-width = <1080>;
		qcom,mdss-dsi-panel-height = <1920>;
		qcom,mdss-dsi-h-front-porch = <16>;
		qcom,mdss-dsi-h-back-porch = <16>;
		qcom,mdss-dsi-h-pulse-width = <4>;
		qcom,mdss-dsi-h-sync-skew = <0>;
		qcom,mdss-dsi-v-front-porch = <380>;
		qcom,mdss-dsi-v-back-porch = <200>;
		qcom,mdss-dsi-v-pulse-width = <4>;
		qcom,mdss-dsi-h-left-border = <0>;
		qcom,mdss-dsi-h-right-border = <0>;
		qcom,mdss-dsi-v-top-border = <0>;
		qcom,mdss-dsi-v-bottom-border = <0>;
		qcom,mdss-pan-physical-width-dimension = <71>;
		qcom,mdss-pan-physical-height-dimension = <126>;
		qcom,mdss-dsi-bpp = <24>;
		qcom,mdss-dsi-color-order = "rgb_swap_rgb";
		qcom,mdss-dsi-underflow-color = <0>;
		qcom,mdss-dsi-border-color = <0>;
		qcom,mdss-dsi-on-command = [
			39 01 00 00 00 00 02
			B0 AC

			39 01 00 00 00 00 08 /* Display Control1 */
			B3 12 14 28 08
			1A 94 00

			39 01 00 00 00 00 0D /* Display Control2 */
			B4 93 08 00 10
			0A 0A 0A 14 14
			14 14 84

			39 01 00 00 00 00 0F /* Display Control3 */
			B5 03 32 10 02
			41 09 09 09 09
			34 05 05 05 05

			39 01 00 00 00 00 0A /* Display Control4 */
			B6 00 72 39 13
			08 E6 00 60 46

			39 01 00 00 00 00 05 /* Panel Setting */
			B7 01 50 BF 03

			39 01 00 00 00 00 0C /* Touch Timing Control */
			B8 70 C0 93 3A
			0A 04 04 01 0A
			A0 00

			39 01 00 00 00 00 06 /* Power Control3 */
			C3 04 14 14 00
			88

			39 01 00 00 00 00 05 /* Power Control5 */
			C5 C2 2A 54 14

			39 01 00 00 00 00 03 /* VCOM Setting */
			C6 30 01

			39 01 00 00 00 00 03 /* Rev ID */
			CB 3F 00

			39 01 00 00 00 00 07 /* Touch Power Control */
			CE A2 2A 1E 1E
			00 AB

			39 01 00 00 00 00 10 /* Positive Gamma Curve for Red */
			D0 0D 15 1C 27
			2F 3A 42 4B 58
			4D 3E 2D 14 00
			8A

			39 01 00 00 00 00 10 /* Negative Gamma Curve for Red */
			D1 0D 15 1C 27
			2F 3A 42 4B 58
			4D 3E 2D 14 00
			8A

			39 01 00 00 00 00 10 /* Positive Gamma Curve for Green */
			D2 0D 15 1C 27
			2F 3A 42 4B 58
			4D 3E 2D 14 00
			8A

			39 01 00 00 00 00 10 /* Negative Gamma Curve for Green */
			D3 0D 15 1C 27
			2F 3A 42 4B 58
			4D 3E 2D 14 00
			8A

			39 01 00 00 00 00 10 /* Positive Gamma Curve for Blue */
			D4 0D 15 1C 27
			2F 3A 42 4B 58
			4D 3E 2D 14 00
			8A

			39 01 00 00 00 00 10 /* Negative Gamma Curve for Blue */
			D5 0D 15 1C 27
			2F 3A 42 4B 58
			4D 3E 2D 14 00
			8A

			39 01 00 00 00 00 0D /* Left Side GIP setting */
			E5 27 0D 0C 01
			0B 09 07 05 11
			0E 10 27

			39 01 00 00 00 00 0D /* Right Side GIP setting */
			E6 27 0D 0C 00
			0A 08 06 04 11
			0E 23 27

			39 01 00 00 00 00 07 /* Left Side MUX setting */
			E7 15 16 17 27
			27 27

			39 01 00 00 00 00 07 /* Right Side MUX setting */
			E8 1B 1C 1D 27
			27 27

			15 01 00 00 00 00 02
			51 FF

			15 01 00 00 00 00 02
			53 24

			39 01 00 00 00 00 06
			ED 00 00 72 00 7F

			15 01 00 00 00 00 02 /* Memory Access Control */
			36 02

			05 01 00 00 64 00 01 /* Sleep Out */
			11

			05 01 00 00 64 00 01 /* Display On */
			29

		];
		qcom,mdss-dsi-off-command = [
			05 01 00 00 00 00 01 /* Display Off */
			28
			05 01 00 00 78 00 01 /* Sleep In */
			10
		];

		qcom,mdss-dsi-on-command-state = "dsi_lp_mode";
		qcom,mdss-dsi-off-command-state = "dsi_hs_mode";
		qcom,mdss-dsi-reader-mode-command-state = "dsi_lp_mode";
		qcom,mdss-dsi-h-sync-pulse = <0>;
		qcom,mdss-dsi-traffic-mode = "non_burst_sync_pulse";
		qcom,mdss-dsi-lane-map = "lane_map_0123";
		qcom,mdss-dsi-bllp-eof-power-mode;
		qcom,mdss-dsi-bllp-power-mode;
		qcom,mdss-dsi-lane-0-state;
		qcom,mdss-dsi-lane-1-state;
		qcom,mdss-dsi-lane-2-state;
		qcom,mdss-dsi-lane-3-state;
		qcom,mdss-dsi-tx-eot-append;

		qcom,mdss-dsi-panel-timings = [1D 3E 2A 01 72 76 30 42 32 03 04 00];
		qcom,mdss-dsi-t-clk-post = <0x2>;
		qcom,mdss-dsi-t-clk-pre = <0x32>;

		//The following feature "none" and "trigger_sw" are the same in video mode.
		//The feature used any option of TE signal in command mode.
		qcom,mdss-dsi-dma-trigger = "trigger_sw";	//default "trigger_sw"
		qcom,mdss-dsi-mdp-trigger = "trigger_sw";	//default "trigger_sw"

		qcom,mdss-dsi-bl-min-level = <1>;
		qcom,mdss-dsi-bl-max-level = <255>;
		qcom,mdss-dsi-bl-pmic-control-type = "bl_ctrl_wled";
		qcom,mdss-dsi-reset-sequence = <1 10>, <0 10>, <1 100>;

		lge,blmap-size = <256>;
		lge,blmap = <
			0	25	25	25	25	25	25	25	25	25		/* 0 ~ 9 */
			25	26	27	27	28	29	30	30	31	32		/* 10 ~ 19 */
			33	33	34	35	36	37	37	38	39	40		/* 20 ~ 29 */
			40	41	42	43	43	44	45	48	52	55		/* 30 ~ 39 */
			58	62	65	68	72	75	78	82	85	88		/* 40 ~ 49 */
			92	95	98	102	105	108	112	115	118	122		/* 50 ~ 59 */
			125	131	137	143	149	155	161	167	173	179		/* 60 ~ 69 */
			185	191	198	204	210	216	222	228	234	240		/* 70 ~ 79 */
			246	252	258	264	270	278	287	295	304	312		/* 80 ~ 89 */
			321	329	338	346	355	363	372	380	388	397		/* 90 ~ 99 */
			405	414	422	431	439	448	456	465	473	482		/* 100 ~ 109 */
			490	502	514	526	538	550	563	575	587	599		/* 110 ~ 119 */
			611	623	635	647	659	671	683	695	708	720		/* 120 ~ 129 */
			732	744	756	768	780	796	812	828	844	860		/* 130 ~ 139 */
			876	892	908	924	940	956	973	989	1005	1021		/* 140 ~ 149 */
			1037	1053	1069	1085	1101	1117	1133	1149	1165	1184		/* 150 ~ 159 */
			1203	1221	1240	1259	1278	1296	1315	1334	1353	1371		/* 160 ~ 169 */
			1390	1411	1433	1454	1475	1496	1518	1539	1560	1581		/* 170 ~ 179 */
			1603	1624	1645	1669	1693	1717	1741	1765	1789	1813		/* 180 ~ 189 */
			1837	1861	1885	1909	1933	1956	1980	2004	2028	2052		/* 190 ~ 199 */
			2076	2100	2124	2148	2172	2196	2220	2246	2272	2298		/* 200 ~ 209 */
			2325	2351	2377	2403	2429	2455	2482	2508	2534	2560		/* 210 ~ 219 */
			2586	2612	2638	2665	2691	2717	2743	2769	2795	2822		/* 220 ~ 229 */
			2848	2874	2900	2933	2966	2998	3031	3064	3097	3130		/* 230 ~ 239 */
			3163	3195	3228	3261	3294	3327	3360	3392	3425	3458		/* 240 ~ 249 */
			3491	3524	3557	3589	3622	3655						/* 250 ~ 255 */
		>;

	};
};
