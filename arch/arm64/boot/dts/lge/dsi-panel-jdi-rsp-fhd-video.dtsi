/* Copyright (c) 2014, Code Aurora Forum. All rights reserved.
 *
 * This program is free software; you can redistribute it and/or modify
 * it under the terms of the GNU General Public License version 2 and
 * only version 2 as published by the Free Software Foundation.
 *
 * This program is distributed in the hope that it will be useful,
 * but WITHOUT ANY WARRANTY; without even the implied warranty of
 * MERCHANTABILITY or FITNESS FOR A PARTICULAR PURPOSE.  See the
 * GNU General Public License for more details.
 */

&mdss_mdp {
	dsi_jdi_rsp_vid: qcom,mdss_dsi_jdi_rsp_fhd_video {
		compatible = "qcom,mdss-dsi-panel";
		qcom,mdss-dsi-panel-name = "JDI FHD video mode dsi panel";
		qcom,mdss-dsi-panel-controller = <&mdss_dsi0>;
		qcom,mdss-dsi-panel-type = "dsi_video_mode";
		qcom,mdss-dsi-panel-destination = "display_1";
		qcom,mdss-dsi-panel-framerate = <60>;
		qcom,mdss-dsi-virtual-channel-id = <0>;
		qcom,mdss-dsi-stream = <0>;

		qcom,mdss-dsi-panel-width = <1080>;
		qcom,mdss-dsi-panel-height = <1920>;
		qcom,mdss-dsi-h-front-porch = <96>;
		qcom,mdss-dsi-h-back-porch = <36>;
		qcom,mdss-dsi-h-pulse-width = <12>;
		qcom,mdss-dsi-h-sync-skew = <0>;
		qcom,mdss-dsi-v-back-porch = <3>;
		qcom,mdss-dsi-v-front-porch = <4>;
		qcom,mdss-dsi-v-pulse-width = <1>;


		qcom,mdss-pan-physical-width-dimension = <65>;
		qcom,mdss-pan-physical-height-dimension = <115>;

		qcom,mdss-dsi-h-left-border = <0>;
		qcom,mdss-dsi-h-right-border = <0>;
		qcom,mdss-dsi-v-top-border = <0>;
		qcom,mdss-dsi-v-bottom-border = <0>;
		qcom,mdss-dsi-bpp = <24>;
		qcom,mdss-dsi-color-order = "rgb_swap_rgb";
		qcom,mdss-dsi-underflow-color = <0xff>;
		qcom,mdss-dsi-border-color = <0xff>;

		qcom,mdss-dsi-on-command = [
			39 00 00 00 00 00 02 /* display brightness */
			51 FF
			39 00 00 00 00 00 02 /* ctrl display */
			53 0C
//			39 00 00 00 00 00 02 /* CABC OFF*/
//			55 00

			39 00 00 00 00 00 02 /* CABC SRE:OFF , CABC ON GUI mode */
				55 01

			29 00 00 00 00 00 02 // Panel CMD
			B0 04
			29 00 00 00 00 00 1F // Gamma C7h CMD
			C7 00 0D 16 1D 2B
			38 42 50 35 3D 4B
			59 62 69 76 00 0D
			16 1D 2B 38 42 50
			35 3D 4B 59 62 69
			76
			29 00 00 00 00 00 14 // Gamma tunning
			C8 01 00 00 FA
			00 FC 00 00 00
			FA 00 FC 00 00
			00 00 00 FC 00
			29 00 00 00 00 00 07   	     /*  Backlight Ctrl 1 */
			B8 07 88 25 18 00 31
			29 00 00 00 00 00 07      	 /*  Backlight Ctrl 2 */
			B9 07 82 3C 10 3C 87
			29 00 00 00 00 00 07 	     /*  Backlight Ctrl 3 */
			BA 07 78 64 10 64 B4
			29 00 00 00 00 00 19      	 /*  Backlight Ctrl 4 */
			CE 75 40 43 49 55 62 71 82 94
			A8 B9 CB DB E9 F5 FC FF 07 25
			04 04 44 00 00

//			29 00 00 00 00 00 04      	/*  SRE Control 1 */
//			BB 01 1E 14
//			29 00 00 00 00 00 04      	/*  SRE Control 2 */
//			BC 01 50 32
//			29 00 00 00 00 00 04      	/*  SRE Control 3 */
//			BD 01 B4 A0


//			29 00 00 00 00 00 21 			/* CE setting */
//			CA 01 70 9A 95
//			A2 98 95 8F 3F
//			3F 80 80 08 80
//			08 3F 08 90 0C
//			0C 0A 06 04 04
//			00 C8 10 10 3F
//			3F 3F 3F

			29 00 00 00 00 00 21 			/* CE JDI */
			CA 01 70 80 95
			80 98 95 8F 08
			3F 80 88 E6 F0
			00 FF 00 FF 0C
			0C 0A 06 04 04
			00 E0 0C 08 3F
			3F 3F 3F
			29 01 00 00 00 00 02
			D6 01
			05 01 00 00 78 00 01 /* exit sleep - wait 120ms */
			11
			05 01 00 00 00 00 01 /* display on */
			29
			];
		qcom,mdss-dsi-off-command = [
			05 01 00 00 14 00 01 /* display off - wait 20ms*/
	        28
	        05 01 00 00 50 00 01 /* enter sleep - wait 80ms */
	        10
			];
		/*qcom,mdss-dsi-on-command-state = "dsi_lp_mode";*/
		qcom,mdss-dsi-on-command-state = "dsi_hs_mode";
		qcom,mdss-dsi-off-command-state = "dsi_hs_mode";
		qcom,mdss-dsi-h-sync-pulse = <0>;
		qcom,mdss-dsi-lane-map = "lane_map_0123";
		//qcom,mdss-dsi-bllp-eof-power-mode;
		qcom,mdss-dsi-bllp-power-mode;
		qcom,mdss-dsi-lane-0-state;
		qcom,mdss-dsi-lane-1-state;
		qcom,mdss-dsi-lane-2-state;
		qcom,mdss-dsi-lane-3-state;
		qcom,mdss-dsi-panel-timings = [CD 42 35 00 5C 53 37 44 56 03 04 00]; // 36

		qcom,mdss-dsi-reset-sequence = <0 5>, <1 5>;
		qcom,mdss-dsi-t-clk-post = <0x1E>;
		qcom,mdss-dsi-t-clk-pre = <0x36>;
		qcom,mdss-dsi-dma-trigger = "trigger_sw";

		/* KYH 20150904 modified from none to trigger_sw */
		qcom,mdss-dsi-mdp-trigger = "none";
		qcom,mdss-dsi-tx-eot-append;
		//qcom,cont-splash-enabled;
		//qcom,mdss-dsi-force-clock-lane-hs;
		qcom,mdss-dsi-lp11-init;

		/* KYH 20150904 modified from DSI_NON_BURST_SYNCH_PULSE to DSI_NON_BURST_SYNCH_EVENT */
		qcom,mdss-dsi-traffic-mode = "non_burst_sync_event";

		qcom,mdss-dsi-post-init-delay = <1>;

		lge,blmap-size = <256>;
		lge,blmap = <
			0 25 25 25 25 25 25 25 25 25 				/* 0 ~ 9 */
			25 25 25 26 26 26 27 27 28 28				/* 10 ~ 19 */
			28 29 29 30 31 32 33 35 36 37				/* 20 ~ 29 */
			38 40 41 42 43 45 47 50 52 55				/* 30 ~ 39 */
			57 60 62 65 67 70 72 75 77 80				/* 40 ~ 49 */
			85 90 95 100 105 110 115 120 125 130			/* 50 ~ 59 */
			134 139 143 148 153 157 162 167 171 176			/* 60 ~ 69 */
			181 185 190 195 202 210 217 225 232 240			/* 70 ~ 79 */
			247 255 262 270 277 285 293 302 311 319			/* 80 ~ 89 */
			328 337 345 354 363 371 380 389 398 408			/* 90 ~ 99 */
			418 429 439 450 460 471 481 492 502 513			/* 100 ~ 109 */
			523 534 545 556 567 578 589 600 611 622			/* 110 ~ 119 */
			633 644 655 665 676 687 698 709 720 731			/* 120 ~ 129 */
			742 753 764 775 817 833 850 866 883 900			/* 130 ~ 139 */
			916 933 950 966 983 1000 1015 1030 1046 1061		/* 140 ~ 149 */
			1076 1092 1107 1123 1138 1153 1169 1184 1200 1219	/* 150 ~ 159 */
			1239 1258 1278 1297 1317 1337 1356 1376 1395 1415	/* 160 ~ 169 */
			1435 1454 1474 1493 1513 1533 1552 1572 1591 1611	/* 170 ~ 179 */
			1631 1650 1670 1690 1713 1737 1761 1785 1808 1832	/* 180 ~ 189 */
			1856 1880 1903 1927 1951 1975 1999 2023 2047 2071	/* 190 ~ 199 */
			2096 2120 2144 2168 2193 2217 2241 2265 2290 2320	/* 200 ~ 209 */
			2350 2380 2410 2440 2470 2500 2530 2560 2590 2620	/* 210 ~ 219 */
			2647 2675 2703 2730 2758 2786 2813 2841 2869 2896	/* 220 ~ 229 */
			2924 2952 2980 3012 3045 3077 3110 3142 3175 3207	/* 230 ~ 239 */
			3240 3272 3305 3337 3370 3409 3448 3487 3526 3565	/* 240 ~ 249 */
			3604 3643 3682 3721 3760 3800>;				/* 250 ~ 255 */
	};
};
