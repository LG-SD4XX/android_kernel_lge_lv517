/*
 * Copyright (c) 2016, The Linux Foundation. All rights reserved.
 *
 * This program is free software; you can redistribute it and/or modify
 * it under the terms of the GNU General Public License version 2 and
 * only version 2 as published by the Free Software Foundation.
 *
 * This program is distributed in the hope that it will be useful,
 * but WITHOUT ANY WARRANTY; without even the implied warranty of
 * MERCHANTABILITY or FITNESS FOR A PARTICULAR PURPOSE.  See the
 * GNU General Public License for more details.
 */

/dts-v1/;

#include "../../qcom/msm8940.dtsi"
#include "../../qcom/msm-pmi8950.dtsi"
#include "../msm8940-lge-common/msm8940-lge-pmi8950.dtsi"
#include "msm8940-sf3_tmo_us.dtsi"

/ {
	model = "Qualcomm Technologies, Inc. MSM8940-PMI8950 MTP";
	compatible = "qcom,msm8940-mtp", "qcom,msm8940", "qcom,mtp";
	qcom,board-id= <0x61 0>;
	qcom,pmic-id = <0x10019 0x010011 0x0 0x0>;
};

&soc {
        earjack-debugger {
                compatible = "serial,earjack-debugger";
                status = "ok";
                interrupt-parent = <&tlmm>;
                serial,irq-gpio = <&tlmm 45 0x00>;
        };
};
