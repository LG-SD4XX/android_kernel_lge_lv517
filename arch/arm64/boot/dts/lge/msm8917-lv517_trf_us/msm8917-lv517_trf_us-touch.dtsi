/*
 * Copyright (c) 2016, The Linux Foundation. All rights reserved.
 *
 * This program is free software; you can redistribute it and/or modify
 * it under the terms of the GNU General Public License version 2 and
 * only version 2 as published by the Free Software Foundation.
 *
 * This program is distributed in the hope that it will be useful,
 * but WITHOUT ANY WARRANTY; without even the implied warranty of
 * MERCHANTABILITY or FITNESS FOR A PARTICULAR PURPOSE.  See the
 * GNU General Public License for more details.
 */


&i2c_3 { /* BLSP1 QUP3 */
	qcom,clk-freq-out = <400000>;

	lg4894@28 {
		status = "okay";
		compatible = "lge,lg4894";
		reg = <0x28>;

		/* GPIOs */
		interrupt-parent = <&tlmm>;
		interrupts = <65 0x2002>; // #define IRQF_ONESHOT 0x00002000 IRQF_TRIGGER_FALLING 0x00000002 #define IRQF_NO_SUSPEND 0x00004000
		reset-gpio = <&tlmm 64 0x0>;
		irq-gpio = <&tlmm 65 0x2002>;
		irqflags = <0x2002>;
		pinctrl-names = "touch_pin_active","touch_pin_sleep";	/*Touch GPIO pin name setting*/
		pinctrl-0 = <&ts_int_active &ts_reset_active>;		/*Touch GPIO pin active setting*/
		pinctrl-1 = <&ts_int_suspend &ts_reset_suspend>;	/*Touch GPIO pin suspend setting*/
			//vdd-gpio = <&tlmm 3 0x0>;  /* ???? 3 : ph2 3.3v/l5 mipi 1.2v */
		//vio-gpio = <&tlmm 63 0x0>; /* ???? 63 : 1.8v io*/

		/* Caps */
		max_x = <720>;
		max_y = <1280>;
		max_pressure = <0xff>;
		max_width = <15>;
		max_orientation = <1>;
		max_id = <10>;
		/* role */
		hw_reset_delay = <210>;
		sw_reset_delay = <90>;
		use_lpwg = <1>;
		use_lpwg_test = <1>;
		hide_coordinate = <1>;
		/* firmware */
		use_fw_upgrade = <1>;
		use_firmware = <0>;
		fw_image = "touch/lv5/sic/L0W53LV5_1_06.img", /* for revision 9 & lcd fpcb revision 2 */
		           "touch/lv5/sic/L0W53LV5_1_09.img", /* for revision 9 & lcd fpcb revision 4 */
		           "touch/lv5/sic/L0W53LV5_1_20.img"; /* for revision 9 & lcd fpcb revision 5 */
		panel_spec = "touch/lv5/sic/lv5_limit.txt";
		panel_spec_mfts_folder = "touch/lv5/sic/lv5_limit_mfts.txt";
	};

	focaltech_ft8707@38 {
		compatible = "focaltech,ft8707";
		status = "disable";

		reg = <0x38>;
		interrupt-parent = <&tlmm>;
		interrupts = <65 0x2002>; // #define IRQF_ONESHOT	0x00002000 IRQF_TRIGGER_FALLING 0x00000002 #define IRQF_NO_SUSPEND		0x00004000

		pinctrl-names = "touch_pin_active","touch_pin_sleep";	/*Touch GPIO pin name setting*/
		pinctrl-0 = <&ts_int_active &ts_reset_active>;		/*Touch GPIO pin active setting*/
		pinctrl-1 = <&ts_int_suspend &ts_reset_suspend>;	/*Touch GPIO pin suspend setting*/

		reset-gpio = <&tlmm 64 0x0>;
		irq-gpio = <&tlmm 65 0x2002>;
		//vdd-gpio = <&tlmm 3 0x0>;  /* ???? 3 : ph2 3.3v/l5 mipi 1.2v */
		//vio-gpio = <&tlmm 63 0x0>; /* ???? 63 : 1.8v io*/

		irqflags = <0x2002>;

		hw_reset_delay = <20>;

		/*Caps*/
		max_x = <720>;
		max_y = <1280>;
		max_pressure = <0xff>;
		max_width = <15>;
		max_orientation = <1>;
		max_id = <10>;

		/* firmware & panel_spec path */
		fw_image = "focaltech/lv517/FT8606/FT8606_Pramboot_V0.6_20150304.img", "focaltech/lv517/FT8606/LGE_K6_8607_V0_60.img";

		/* ft8707 specific */
		//vdd-supply = <&pm8916_l17>;
		//vcc_i2c-supply = <&pm8916_l6>;
		focaltech,name = "fts";
		focaltech,family-id = <0x54>;
		//focaltech,reset-gpio = <&msmgpio 16 0x00>;
		//focaltech,irq-gpio =<&msm_gpio 13 0x00>;
		//focaltech,id1-gpio = <&msm_gpio 109 0x00>;
		//focaltech,id2-gpio = <&msm_gpio 114 0x00>;
		//focaltech,id3-gpio = <&msm_gpio 121 0x00>;
		focaltech,display-coords = <0 0 480 854>;
		focaltech,panel-coords = <0 0 1080 2000>;
		focaltech,button-map= <70 150 907>;
		focaltech,no-force-update;
		focaltech,i2c-pull-up;
		focaltech,group-id = <1>;
		focaltech,hard-reset-delay-ms = <20>;
		focaltech,soft-reset-delay-ms = <150>;
		focaltech,num-max-touches = <10>;
		focaltech,fw-name = "FT_Upgrade_App.i";
		focaltech,fw-delay-aa-ms = <50>;
		focaltech,fw-delay-55-ms = <30>;
		focaltech,fw-upgrade-id1 = <0x79>;
		focaltech,fw-upgrade-id2 = <0x03>;
		focaltech,fw-delay-readid-ms = <10>;
		focaltech,fw-delay-era-flsh-ms = <2000>;

	};
};

