/* Copyright (c) 2013, The Linux Foundation. All rights reserved.
 *
 * This program is free software; you can redistribute it and/or modify
 * it under the terms of the GNU General Public License version 2 and
 * only version 2 as published by the Free Software Foundation.
 *
 * This program is distributed in the hope that it will be useful,
 * but WITHOUT ANY WARRANTY; without even the implied warranty of
 * MERCHANTABILITY or FITNESS FOR A PARTICULAR PURPOSE.  See the
 * GNU General Public License for more details.
 */

/*---------------------------------------------------------------------------
 * This file is autogenerated file using gcdb parser. Please do not edit it.
 * Update input XML file to add a new entry or update variable in this file
 * VERSION = "1.0"
 *---------------------------------------------------------------------------*/
&mdss_mdp {
	dsi_china_hx8394c_wxga_video: qcom,mdss_dsi_china_hx8394c_wxga_video {
		compatible = "qcom,mdss-dsi-panel";
		status = "ok";
		qcom,cont-splash-enabled;
		qcom,mdss-dsi-panel-name = "china hx8394c wxga video mode dsi panel";
		qcom,mdss-dsi-panel-controller = <&mdss_dsi0>;
		qcom,mdss-dsi-panel-type = "dsi_video_mode";
		qcom,mdss-dsi-panel-destination = "display_1";
		qcom,mdss-dsi-panel-framerate = <60>;
		qcom,mdss-pan-physical-width-dimension = <94>;
		qcom,mdss-pan-physical-height-dimension = <150>;
		qcom,mdss-dsi-virtual-channel-id = <0>;
		qcom,mdss-dsi-stream = <0>;
		qcom,mdss-dsi-panel-width = <800>;
		qcom,mdss-dsi-panel-height = <1280>;
		qcom,mdss-dsi-h-front-porch = <16>;
		qcom,mdss-dsi-h-back-porch = <48>;
		qcom,mdss-dsi-h-pulse-width = <16>;
		qcom,mdss-dsi-h-sync-skew = <0>;
		qcom,mdss-dsi-v-front-porch = <8>;
		qcom,mdss-dsi-v-back-porch = <4>;
		qcom,mdss-dsi-v-pulse-width = <4>;
		qcom,mdss-dsi-h-left-border = <0>;
		qcom,mdss-dsi-h-right-border = <0>;
		qcom,mdss-dsi-v-top-border = <0>;
		qcom,mdss-dsi-v-bottom-border = <0>;
		qcom,mdss-dsi-bpp = <24>;
		qcom,mdss-dsi-color-order = "rgb_swap_rgb";
		qcom,mdss-dsi-underflow-color = <0xff>;
		qcom,mdss-dsi-border-color = <0>;

		qcom,mdss-dsi-on-command = [
			39 01 00 00 00 00 04
			B9 FF 83 94
			39 01 00 00 00 00 06
			C9 1F 2E 1E 1E 10
			39 01 00 00 00 00 2D
			D5 03 02 03 02 01 00 01 00 07 06 07 06 05 04 05 04 21 20 18 18 18 18 18 18 18 18 18 18 18 18 23 22 18 18 18 18 18 18 18 18 18 18 18 18
			39 01 00 00 00 00 2D
			D6 04 05 04 05 06 07 06 07 00 01 00 01 02 03 02 03 22 23 18 18 18 18 18 18 18 18 18 18 18 18 20 21 18 18 18 18 18 18 18 18 18 18 18 18
			39 01 00 00 00 00 03
			BA 23 42
			39 01 00 00 00 00 26
			D3 00 05 00 01 07 18 00 32 10 02 00 02 32 15 0B 05 0B 00 00 00 00 00 47 03 04 04 47 00 00 00 0C 00 00 00 0A 00 01
			39 01 00 00 00 00 2B
			E0 03 09 0A 25 2B 39 0D 2A 06 09 0B 16 0D 0F 12 10 12 07 12 14 18 03 09 0A 22 2A 39 0E 2A 06 09 0B 16 0D 10 12 10 12 07 12 14 18
			39 01 00 00 00 00 10
			B1 6C 10 10 44 04 11 F1 81 69 DA 23 80 C0 D2 58
			39 01 00 00 00 00 10
			B2 45 64 14 09 70 1C 08 08 1C 4D 00 00 30 44 24
			39 01 00 00 00 00 17
			B4 00 FF 5C 56 48 4A 58 59 01 68 02 67 5C 56 5C 56 5C 56 01 68 01 68
			39 01 00 00 00 00 02
			CC 09
			39 01 00 00 00 00 02
			BC 07
			39 01 00 00 00 00 03
			C0 30 11
			39 01 00 00 00 00 04
			C7 00 00 20
			39 01 00 00 00 00 03
			E4 01 55

			05 01 00 00 78 00 01
			11
			05 01 00 00 0A 00 01
			29
			];
		qcom,mdss-dsi-off-command = [
			05 01 00 00 32 00 01
			28
			05 01 00 00 78 00 01
			10
			];

		qcom,mdss-dsi-on-command-state = "dsi_lp_mode";
		qcom,mdss-dsi-off-command-state = "dsi_hs_mode";
		qcom,mdss-dsi-reader-mode-command-state = "dsi_hs_mode";
		qcom,mdss-dsi-h-sync-pulse = <0>;
		qcom,mdss-dsi-traffic-mode = "non_burst_sync_event";
		qcom,mdss-dsi-lane-map = "lane_map_0123";
		qcom,mdss-dsi-bllp-eof-power-mode;
		qcom,mdss-dsi-bllp-power-mode;
		qcom,mdss-dsi-lane-0-state;
		qcom,mdss-dsi-lane-1-state;
		qcom,mdss-dsi-lane-2-state;
		qcom,mdss-dsi-lane-3-state;
		qcom,mdss-dsi-lp11-init = <1>;
		qcom,mdss-dsi-panel-timings = [7B 1A 10 00 3C 42 14 1c 15 03 04 00];
		qcom,mdss-dsi-t-clk-post = <0x04>;
		qcom,mdss-dsi-t-clk-pre = <0x1A>;
		qcom,mdss-dsi-dma-trigger = "trigger_sw";
		qcom,mdss-dsi-mdp-trigger = "none";
		qcom,mdss-dsi-reset-sequence = <1 10>, <0 20>, <1 200>;
	};
};
