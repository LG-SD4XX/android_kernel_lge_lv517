/*
 * Copyright (c) 2015, The Linux Foundation. All rights reserved.
 *
 * This program is free software; you can redistribute it and/or modify
 * it under the terms of the GNU General Public License version 2 and
 * only version 2 as published by the Free Software Foundation.
 *
 * This program is distributed in the hope that it will be useful,
 * but WITHOUT ANY WARRANTY; without even the implied warranty of
 * MERCHANTABILITY or FITNESS FOR A PARTICULAR PURPOSE.  See the
 * GNU General Public License for more details.
 */

&pmi8950_vadc {
	interrupts = <0x2 0x31 0x0>,
		     <0x2 0x31 0x3>,
		     <0x2 0x31 0x4>;
	interrupt-names = "eoc-int-en-set",
			  "high-thr-en-set",
			  "low-thr-en-set";
	qcom,vadc-meas-int-mode;
};

&usb_otg {
	qcom,phy-otg-vadc = <&pmi8950_vadc>;
};
