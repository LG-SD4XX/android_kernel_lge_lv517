/* Copyright (c) 2012, Code Aurora Forum. All rights reserved.
 *
 * This program is free software; you can redistribute it and/or modify
 * it under the terms of the GNU General Public License version 2 and
 * only version 2 as published by the Free Software Foundation.
 *
 * This program is distributed in the hope that it will be useful,
 * but WITHOUT ANY WARRANTY; without even the implied warranty of
 * MERCHANTABILITY or FITNESS FOR A PARTICULAR PURPOSE.  See the
 * GNU General Public License for more details.
 */

&i2c_5 {
        qcom,disable-dma;
        qcom,clk-freq-out = <400000>;
        pn547@28 {
                status = "disable";
                compatible = "nxp,pn547";
                reg = <0x28>;

                nxp,gpio_sda = <&tlmm 18 0x00>;
                nxp,gpio_scl = <&tlmm 19 0x00>;
                nxp,gpio_ven = <&tlmm 16 0x00>;
                nxp,gpio_mode = <&tlmm 130 0x00>;
                nxp,gpio_irq = <&tlmm 13 0x00>;
                nxp,i2c-pull-up = <1>;

                interrupt-parent = <&tlmm>;
                interrupts = <13 0>;
                interrupt-names = "nfc_irq";
        };

        cxd224x-i2c@28 {
                compatible = "sony,cxd224x";
                status = "ok";
                reg = <0x28>;
                sony,gpio_sda = <&tlmm 18 0x00>;
                sony,gpio_scl = <&tlmm 19 0x00>;
                sony,gpio_irq = <&tlmm 13 0x00>;
                sony,gpio_hvdd = <&tlmm 45 0x00>;
                sony,gpio_xrst = <&tlmm 46 0x00>;
                sony,gpio_mode = <&tlmm 16 0x00>;
                sony,i2c-pull-up = <1>;
                qcom,clk-src = "BBCLK2";
                interrupt-parent = <&tlmm>;
                interrupts = <13 0>;
                interrupt-names = "nfc_irq";
                pinctrl-names = "nfc_active","nfc_suspend";
                pinctrl-0 = <&nfc_int_active &nfc_disable_active &nfc_mode_active &nfc_hvdd_active>;
                pinctrl-1 = <&nfc_int_suspend &nfc_disable_suspend &nfc_mode_suspend &nfc_hvdd_suspend>;
        };
};
