/* Copyright (c) 2013, The Linux Foundation. All rights reserved.
 *
 * This program is free software; you can redistribute it and/or modify
 * it under the terms of the GNU General Public License version 2 and
 * only version 2 as published by the Free Software Foundation.
 *
 * This program is distributed in the hope that it will be useful,
 * but WITHOUT ANY WARRANTY; without even the implied warranty of
 * MERCHANTABILITY or FITNESS FOR A PARTICULAR PURPOSE.  See the
 * GNU General Public License for more details.
 */

/*---------------------------------------------------------------------------
 * This file is autogenerated file using gcdb parser. Please do not edit it.
 * Update input XML file to add a new entry or update variable in this file
 * VERSION = "1.0"
 *---------------------------------------------------------------------------*/
&mdss_mdp {
	dsi_lv3_lgd_lg4894_hd_video: qcom,mdss_dsi_lv3_lgd_lg4894_hd_video {
		compatible = "qcom,mdss-dsi-panel";
		status = "ok";
		qcom,cont-splash-enabled;
		qcom,mdss-dsi-panel-name = "LGD LG4894 HD video mode dsi panel";
		qcom,mdss-dsi-panel-controller = <&mdss_dsi0>;
		qcom,mdss-dsi-panel-type = "dsi_video_mode";
		qcom,mdss-dsi-panel-destination = "display_1";
		qcom,mdss-dsi-force-clock-lane-hs;
		qcom,mdss-dsi-panel-framerate = <60>;
		qcom,mdss-pan-physical-width-dimension = < 62 >;
		qcom,mdss-pan-physical-height-dimension = < 110 >;
		qcom,mdss-dsi-virtual-channel-id = <0>;
		qcom,mdss-dsi-stream = <0>;
		qcom,mdss-dsi-lp11-init;
		qcom,suspend-ulps-enabled;
		//qcom,esd-check-enabled;
		//qcom,mdss-dsi-panel-status-check-mode = "reg_read";
		//qcom,mdss-dsi-panel-status-read-length = <1>;
		//qcom,mdss-dsi-panel-status-value = <0x00>;
		qcom,mdss-dsi-tx-eot-append;
		qcom,mdss-dsi-panel-width = <720>;
		qcom,mdss-dsi-panel-height = <1280>;
		qcom,mdss-dsi-h-front-porch = <12>;
		qcom,mdss-dsi-h-back-porch = <36>;
		qcom,mdss-dsi-h-pulse-width = <4>;
		qcom,mdss-dsi-h-sync-skew = <0>;
		qcom,mdss-dsi-v-back-porch = <15>;
		qcom,mdss-dsi-v-front-porch = <500>;
		qcom,mdss-dsi-v-pulse-width = <1>;
		qcom,mdss-dsi-h-left-border = <0>;
		qcom,mdss-dsi-h-right-border = <0>;
		qcom,mdss-dsi-v-top-border = <0>;
		qcom,mdss-dsi-v-bottom-border = <0>;
		qcom,mdss-dsi-bpp = <24>;
		qcom,mdss-dsi-color-order = "rgb_swap_rgb";
		qcom,mdss-dsi-underflow-color = <0xff>;
		qcom,mdss-dsi-border-color = <0>;
		qcom,mdss-dsi-on-command = [
			/* step1 : Manufacturer Command Protection */
			15 01 00 00 00 00 02 B0 AC
			/* step2 : Display Control 1 */
			39 01 00 00 00 00 05 B1 10 30 16 00
			/* step3 : Display Control 2 */
			39 01 00 00 00 00 0D B2 01 00 21 20 58 00 CF 10 1F 1F 34 34
			/* step4 : Panel Setting */
			39 01 00 00 00 00 04 B4 00 9F 00
			/* step5 : MIPI DSI Configuration */
			39 01 00 00 00 00 06 B5 42 C0 80 00 00
			/* step6 : MIPI D-PHY Configuration */
			39 01 00 00 00 00 04 B6 77 34 48
			/* step7 : Touch Control */
			39 01 00 00 00 00 0A BD D0 02 F4 01 04 04 12 20 22
			/* step8 : LFD Control */
			39 01 00 00 00 00 08 BE E0 E0 C9 C9 C8 F8 00
			/* step9 : Power Control 1 */
			39 01 00 00 00 00 07 C1 01 E8 D8 C2 C1 00
			/* step10: Power Control 2 */
			39 01 00 00 00 00 04 C2 3B 13 13
			/* step11: Power Control 3 */
			39 01 00 00 00 00 07 C3 15 2F 2F 00 66 21
			/* step12: Power Control 4 */
			39 01 00 00 00 00 04 C4 51 00 37
			/* step13: Power Control 5 */
			39 01 00 00 00 00 06 C5 25 21 20 15 15
			/* step14: Temp Control */
			39 01 00 00 00 00 0D C7 10 22 00 28 00 62 62 62 D8 B0 61 03
			/* step15: Power Sequence Option Configuration */
			39 01 00 00 00 00 05 C8 01 00 03 8C
			/* step16: Power Control for Touch */
			39 01 00 00 00 00 0F CC 80 20 11 26 21 24 02 62 62 62 00 B1 01 00
			/* step17: Positive Gamma Curve for Red */
			39 01 00 00 00 00 0D D0 12 55 63 54 13 22 00 03 07 60 67 03
			/* step18: Negative Gamma Curve for Red */
			39 01 00 00 00 00 0D D1 12 55 63 54 13 22 00 03 07 60 67 03
			/* step19: Positive Gamma Curve for Green */
			39 01 00 00 00 00 0D D2 12 55 63 54 13 22 00 03 07 60 67 03
			/* step20: Negative Gamma Curve for Green */
			39 01 00 00 00 00 0D D3 12 55 63 54 13 22 00 03 07 60 67 03
			/* step21: Positive Gamma Curve for Blue */
			39 01 00 00 00 00 0D D4 12 55 63 54 13 22 00 03 07 60 67 03
			/* step22: Negative Gamma Curve for Blue */
			39 01 00 00 00 00 0D D5 12 55 63 54 13 22 00 03 07 60 67 03
			/* step23: GIP Pad Setting 1 */
			39 01 00 00 00 00 16 E4 2F C3 2F 60 41 C5 C6 CC CC CB 2F CB CA CA C9 C9 C7 C8 2F 41 2F
			/* step24: GIP Pad Setting 2 */
			39 01 00 00 00 00 0D E5 FF FF FF FF FF 13 EF FF FF FF FF 03
			/* Sleep out */
			05 01 00 00 64 00 01 11
			/* Display on */
			05 01 00 00 00 00 01 29
		];
		qcom,mdss-dsi-off-command = [
			/* Display off */
			05 01 00 00 64 00 01 28
			/* Sleep in */
			05 01 00 00 78 00 01 10
		];
		qcom,panel-reader-mode-step1-command = [	// LOW 5850K
			39 01 00 00 00 00 11 F5 40 40 40 40 40 40 40 40 00 00 00 00 00 00 00 00
			39 01 00 00 00 00 11 F6 40 40 40 40 40 40 40 40 00 00 00 00 00 00 00 00
			39 01 00 00 00 00 11 F7 34 34 34 34 34 34 34 34 00 00 00 00 00 00 00 00
			15 01 00 00 00 00 02 ED 04
		];
		qcom,panel-reader-mode-step2-command = [	// MIDDLE 5500K
			39 01 00 00 00 00 11 F5 40 40 40 40 40 40 40 40 00 00 00 00 00 00 00 00
			39 01 00 00 00 00 11 F6 40 40 40 40 40 40 40 40 00 00 00 00 00 00 00 00
			39 01 00 00 00 00 11 F7 2F 2F 2F 2F 2F 2F 2F 2F 00 00 00 00 00 00 00 00
			15 01 00 00 00 00 02 ED 04
		];
		qcom,panel-reader-mode-step3-command = [	// HIGH 5350K
			39 01 00 00 00 00 11 F5 3F 3F 3F 3F 3F 3F 3F 3F 00 00 00 00 00 00 00 00
			39 01 00 00 00 00 11 F6 3F 3F 3F 3F 3F 3F 3F 3F 00 00 00 00 00 00 00 00
			39 01 00 00 00 00 11 F7 2D 2D 2D 2D 2D 2D 2D 2D 00 00 00 00 00 00 00 00
			15 01 00 00 00 00 02 ED 04
		];
		qcom,panel-reader-mode-off-command = [		// NORMAL
			15 01 00 00 00 00 02 ED 00
		];
		qcom,mdss-dsi-on-command-state = "dsi_lp_mode";
		qcom,mdss-dsi-off-command-state = "dsi_hs_mode";
		qcom,mdss-dsi-reader-mode-command-state = "dsi_hs_mode";
		qcom,mdss-dsi-h-sync-pulse = <0>;
		qcom,mdss-dsi-traffic-mode = "non_burst_sync_event";
		qcom,mdss-dsi-lane-map = "lane_map_0123";
		qcom,mdss-dsi-bllp-eof-power-mode;
		qcom,mdss-dsi-bllp-power-mode;
		qcom,mdss-dsi-last-line-interleave;
		qcom,mdss-dsi-lane-0-state;
		qcom,mdss-dsi-lane-1-state;
		qcom,mdss-dsi-lane-2-state;
		qcom,mdss-dsi-lane-3-state;
		qcom,mdss-dsi-panel-timings = [8B 1E 14 00 44 4A 18 22 19 03 04 00];
		qcom,mdss-dsi-t-clk-post = <0x04>;
		qcom,mdss-dsi-t-clk-pre = <0x1C>;
		qcom,mdss-dsi-bl-pmic-control-type = "bl_ctrl_wled";
		qcom,mdss-dsi-bl-min-level = <1>;
		qcom,mdss-dsi-bl-max-level = <255>;
		qcom,mdss-dsi-dma-trigger = "trigger_sw";
		qcom,mdss-dsi-mdp-trigger = "none";
		qcom,mdss-dsi-reset-sequence = <1 0>, <0 1>, <1 5>;
		qcom,mdss-dsi-panel-status-command = [06 01 00 01 05 00 02 05 00];
		qcom,mdss-dsi-panel-status-command-state = "dsi_hs_mode";

		lge,pre-bl-on-delay = <40>;
		lge,mdss-dsi-extra-command-names = "touch-osc-on", "touch-osc-off";
		lge,mdss-dsi-extra-command-touch-osc-on = [
			15 01 00 00 01 00 02 BF 20
			15 01 00 00 01 00 02 BF 60
		];
		lge,mdss-dsi-extra-command-touch-osc-off = [
			15 01 00 00 01 00 02 BF 20
			15 01 00 00 01 00 02 BF 00
		];
		lge,mdss-dsi-extra-command-state-touch-osc-on = "dsi_lp_mode";
		lge,mdss-dsi-extra-command-state-touch-osc-off = "dsi_lp_mode";

		lge,blmap-size = <256>;
		lge,blmap = <
			0 42 42 42 42 42 42 42 42 42                            /* 0 ~ 9 */
			42 42 42 43 43 44 44 45 45 46                           /* 10 ~ 19 */
			46 46 47 47 47 49 51 53 55 57                           /* 20 ~ 29 */
			59 61 62 63 65 65 65 68 72 75                           /* 30 ~ 39 */
			79 82 86 89 93 96 99 99 99 105                          /* 40 ~ 49 */
			110 115 120 125 130 135 140 145 149 149                 /* 50 ~ 59 */
			149 155 162 168 175 182 188 195 202 206                 /* 60 ~ 69 */
			210 215 215 215 223 231 239 248 257 266                 /* 70 ~ 79 */
			275 282 290 300 300 300 310 320 330 340                 /* 80 ~ 89 */
			350 360 370 380 390 412 424 436 447 460                 /* 90 ~ 99 */
			472 484 496 503 510 515 520 524 524 524                 /* 100 ~ 109 */
			536 548 560 572 584 596 608 620 632 644                 /* 110 ~ 119 */
			666 666 666 682 698 714 730 746 762 778                 /* 120 ~ 129 */
			794 810 828 828 828 846 862 878 896 914                 /* 130 ~ 139 */
			930 950 970 992 1013 1013 1013 1033 1053 1075           /* 140 ~ 149 */
			1096 1117 1140 1160 1180 1200 1219 1219 1219 1242       /* 150 ~ 159 */
			1265 1283 1306 1329 1352 1375 1399 1410 1425 1449       /* 160 ~ 169 */
			1449 1449 1475 1501 1527 1553 1579 1605 1631 1658       /* 170 ~ 179 */
			1680 1703 1703 1703 1731 1759 1788 1808 1836 1852       /* 180 ~ 189 */
			1890 1918 1950 1983 1983 1983 2014 2044 2073 2103       /* 190 ~ 199 */
			2133 2166 2193 2223 2263 2292 2292 2292 2328 2354       /* 200 ~ 209 */
			2390 2426 2450 2486 2522 2558 2594 2601 2629 2629       /* 210 ~ 219 */
			2629 2665 2701 2737 2773 2809 2845 2881 2917 2953       /* 220 ~ 229 */
			2990 2990 2990 3030 3070 3110 3150 3190 3240 3280       /* 230 ~ 239 */
			3320 3350 3380 3380 3380 3422 3464 3506 3548 3590       /* 240 ~ 249 */
			3630 3670 3710 3750 3775 3800>;
	};
};
