/*
 * Copyright (c) 2016, The Linux Foundation. All rights reserved.
 *
 * This program is free software; you can redistribute it and/or modify
 * it under the terms of the GNU General Public License version 2 and
 * only version 2 as published by the Free Software Foundation.
 *
 * This program is distributed in the hope that it will be useful,
 * but WITHOUT ANY WARRANTY; without even the implied warranty of
 * MERCHANTABILITY or FITNESS FOR A PARTICULAR PURPOSE.  See the
 * GNU General Public License for more details.
 */

&i2c_2 { /* BLSP2 QUP1 */
	status = "okay";
	em-tech_epack@36 {
		compatible = "em-tech,epack";
		status = "ok";

		reg = <0x36>;
		id-gpio = <&tlmm 62 0x2001>;
		pack-power-gpio = <&tlmm 35 0x2001>;

		usb-power-gpio = <&tlmm 34 0>;
		ovp-sw-pcon-gpio = <&tlmm 50 0>;

		interrupt-parent = <&tlmm>;
		interrupts = <62 0x2001>, <35 0x2001>;
		interrupt-names = "epack_detect_irq","epack_power_chnage_irq";

		polling_time_pwr = <1000>;
		polling_time_snd = <1000>;
	};
};
