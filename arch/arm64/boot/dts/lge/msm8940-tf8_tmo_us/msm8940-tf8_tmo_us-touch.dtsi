/*
 * Copyright (c) 2016, The Linux Foundation. All rights reserved.
 *
 * This program is free software; you can redistribute it and/or modify
 * it under the terms of the GNU General Public License version 2 and
 * only version 2 as published by the Free Software Foundation.
 *
 * This program is distributed in the hope that it will be useful,
 * but WITHOUT ANY WARRANTY; without even the implied warranty of
 * MERCHANTABILITY or FITNESS FOR A PARTICULAR PURPOSE.  See the
 * GNU General Public License for more details.
 */

&i2c_3 { /* BLSP3 QUP1 */

	status = "okay";
	qcom,clk-freq-out = <400000>;

	synaptics@20 {
		compatible = "synaptics,TD4310";
		status = "disable";
		revision = "rev_b..rev_10";

		reg = <0x20>;
		interrupt-parent = <&tlmm>;
		/* IRQF_ONESHOT				0x00002000 */
		/* IRQF_TRIGGER_FALLING		0x00000002 */
		/* IRQF_NO_SUSPEND			0x00004000 */
		interrupts = <65 0x2002>;
		irqflags = <0x2002>;
		reset-gpio = <&tlmm 64 0x00>;
		irq-gpio = <&tlmm 65 0x2002>;

		pinctrl-names = "touch_pin_active", "touch_pin_sleep";	/* Touch GPIO pin name setting */
		pinctrl-0 = <&ts_int_active>;							/* Touch GPIO pin active setting */
		pinctrl-1 = <&ts_int_suspend>;							/* Touch GPIO pin suspend setting */

		/* Caps */
		max_x = <1080>;
		max_y = <1920>;
		max_pressure = <0xff>;
		max_width = <15>;
		max_orientation = <90>;
		max_id = <10>;
		hw_reset_delay = <150>;
		sw_reset_delay = <150>;

		/* Role */
		use_lpwg = <1>;
		use_lpwg_test = <1>;
		hide_coordinate = <0>;

		/* Firmware */
		use_fw_upgrade = <1>;
		use_firmware = <0>;
		fw_image = "touch/sf3f/synaptics/temp.img",
				    "touch/sf3f/synaptics/temp.bin";
		panel_spec = "touch/sf3f/sf3f_limit.txt";
		panel_spec_mfts_folder = "touch/sf3f/sf3f_limit.txt";

		/* ASC */
		use_asc = <0>;
		low_delta_thres = <350>;
		high_delta_thres = <600>;
		max_delta_cnt = <2>;
	};

	sw49105@28 {
		compatible = "lge,sw49105";
		status = "disable";

		reg = <0x28>;
		interrupt-parent = <&tlmm>;
		/* IRQF_ONESHOT				0x00002000 */
		/* IRQF_TRIGGER_FALLING		0x00000002 */
		/* IRQF_NO_SUSPEND			0x00004000 */
		interrupts = <65 0x2002>;
		irqflags = <0x2002>;
		reset-gpio = <&tlmm 64 0x00>;
		irq-gpio = <&tlmm 65 0x2002>;

		pinctrl-names = "touch_pin_active", "touch_pin_sleep";	/*Touch GPIO pin name setting*/
		pinctrl-0 = <&ts_int_active &ts_reset_active>;			/*Touch GPIO pin active setting*/
		pinctrl-1 = <&ts_int_suspend &ts_reset_suspend>;		/*Touch GPIO pin suspend setting*/

		/* Caps */
		max_x = <1080>;
		max_y = <1920>;
		max_pressure = <0xff>;
		max_width = <15>;
		max_orientation = <1>;
		max_id = <10>;
		hw_reset_delay = <210>;
		sw_reset_delay = <90>;

		/* Role */
		use_lpwg = <1>;
		use_lpwg_test = <1>;
		hide_coordinate = <0>;

		/* Firmware */
		use_fw_upgrade = <1>;
		use_firmware = <0>;
		fw_image = "touch/sf3f/lgsic/L0W57SF6_0_01.img";
		panel_spec = "touch/sf3f/lgsic/sf3f_limit.txt";
		panel_spec_mfts_folder = "touch/sf3f/lgsic/sf3f_limit.txt";
		
		/* ASC */
		use_asc = <0>;
		low_delta_thres = <350>;
		high_delta_thres = <600>;
		max_delta_cnt = <2>;
	};
	novatek_nt11206@1 {
		compatible = "lge,nt11206";
		status = "ok";
		reg = <0x01>;
		interrupt-parent = <&tlmm>;
		interrupts = <65 0x2001>; // ONESHOT IRQF_TRIGGER_RISING
		irqflags = <0x00002001>; // IRQF_TRIGGER_RISING

		pinctrl-names = "touch_pin_active","touch_pin_sleep";       /*Touch GPIO pin name setting*/
		pinctrl-0 = <&ts_int_active &ts_reset_active>;          /*Touch GPIO pin active setting*/
		pinctrl-1 = <&ts_int_suspend &ts_reset_suspend>;        /*Touch GPIO pin suspend setting*/

		reset-gpio = <&tlmm 64 0x0>;
		irq-gpio = <&tlmm 65 0x2001>;

		/*Power*/
		vdd-gpio = <&tlmm 61 0x00>;
		vio-gpio = <&tlmm 128 0x00>;

		/*Caps*/
		max_x = <1200>;
		max_y = <1920>;
		max_pressure = <0xff>;
		max_width = <15>;
		max_orientation = <1>;
		max_id = <10>;

		/*role*/
		hw_reset_delay = <0>;
		sw_reset_delay = <90>;
		use_lpwg = <1>;
		use_lpwg_test = <1>;
		hide_coordinate = <0>;

		/* firmware */
		use_fw_upgrade = <1>;
		use_firmware = <0>;
		fw_image = "touch/tf8/novatek/TF8_001.bin";
	};
};
