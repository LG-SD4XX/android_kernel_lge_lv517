/*
 * Copyright (c) 2016, The Linux Foundation. All rights reserved.
 *
 * This program is free software; you can redistribute it and/or modify
 * it under the terms of the GNU General Public License version 2 and
 * only version 2 as published by the Free Software Foundation.
 *
 * This program is distributed in the hope that it will be useful,
 * but WITHOUT ANY WARRANTY; without even the implied warranty of
 * MERCHANTABILITY or FITNESS FOR A PARTICULAR PURPOSE.  See the
 * GNU General Public License for more details.
 */
&i2c_3 { /* BLSP1 QUP3 */

	status = "okay";
	qcom,clk-freq-out = <400000>;

	synaptics_s3330@20 {
		compatible = "synaptics,s3330";
		status = "ok";

		reg = <0x20>;
		interrupt-parent = <&tlmm>;
		interrupts = <65 0x2008>;

		pinctrl-names = "touch_pin_active","touch_pin_sleep";	/*Touch GPIO pin name setting*/
		pinctrl-0 = <&ts_int_active &ts_reset_active>;		/*Touch GPIO pin active setting*/
		pinctrl-1 = <&ts_int_suspend &ts_reset_suspend>;	/*Touch GPIO pin suspend setting*/

		reset-gpio = <&tlmm 64 0x0>;
		irq-gpio = <&tlmm 65 0x2008>;
		vdd-gpio = <&tlmm 3 0x0>;
		vio-gpio = <&tlmm 46 0x0>;

		irqflags = <0x2002>;

		hw_reset_delay = <80>;
		use_lpwg = <1>;
		hide_coordinate = <1>;

		/*Caps*/
		max_x = <1080>;
		max_y = <1920>;
		max_pressure = <0xff>;
		max_width = <15>;
		max_orientation = <1>;
		max_id = <10>;

		/* Role */
		use_lpwg_test = <1>;

		/* firmware & panel_spec path */
		use_fw_upgrade = <1>;
		fw_image = "touch/lv9/synaptics/PLG636-V1.03-PR2528259-DS5.2.20.2.1046_40052183.img";
		panel_spec = "touch/lv9/synaptics/lv9_limit.txt";
		panel_spec_mfts_folder = "touch/lv9/synaptics/lv9_limit_mfts.txt";
	};
};
