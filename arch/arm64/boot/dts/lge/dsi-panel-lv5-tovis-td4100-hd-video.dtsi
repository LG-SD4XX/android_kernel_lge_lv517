/* Copyright (c) 2013, The Linux Foundation. All rights reserved.
 *
 * This program is free software; you can redistribute it and/or modify
 * it under the terms of the GNU General Public License version 2 and
 * only version 2 as published by the Free Software Foundation.
 *
 * This program is distributed in the hope that it will be useful,
 * but WITHOUT ANY WARRANTY; without even the implied warranty of
 * MERCHANTABILITY or FITNESS FOR A PARTICULAR PURPOSE.  See the
 * GNU General Public License for more details.
 */

/*---------------------------------------------------------------------------
 * This file is autogenerated file using gcdb parser. Please do not edit it.
 * Update input XML file to add a new entry or update variable in this file
 * VERSION = "1.0"
 *---------------------------------------------------------------------------*/
&mdss_mdp {
	dsi_tvs_td4100_hd_video: qcom,mdss_dsi_lv5_tovis_td4100_hd_video {
		compatible = "qcom,mdss-dsi-panel";
		status = "ok";
		qcom,cont-splash-enabled;
		qcom,mdss-dsi-panel-name = "TOVIS TD4100 HD video mode dsi panel";
		qcom,mdss-dsi-panel-controller = <&mdss_dsi0>;
		qcom,mdss-dsi-panel-type = "dsi_video_mode";
		qcom,mdss-dsi-panel-destination = "display_1";
		qcom,mdss-dsi-panel-framerate = <60>;
		qcom,mdss-dsi-virtual-channel-id = <0>;
		qcom,mdss-dsi-stream = <0>;
		qcom,mdss-dsi-lp11-init;
		qcom,suspend-ulps-enabled;
		qcom,mdss-dsi-panel-width = <720>;
		qcom,mdss-dsi-panel-height = <1280>;
		qcom,mdss-dsi-h-front-porch = <78>;
		qcom,mdss-dsi-h-back-porch = <32>;
		qcom,mdss-dsi-h-pulse-width = <4>;
		qcom,mdss-dsi-h-sync-skew = <0>;
		qcom,mdss-dsi-v-front-porch = <127>;
		qcom,mdss-dsi-v-back-porch = <127>;
		qcom,mdss-dsi-v-pulse-width = <127>;
		qcom,mdss-dsi-h-left-border = <0>;
		qcom,mdss-dsi-h-right-border = <0>;
		qcom,mdss-dsi-v-top-border = <0>;
		qcom,mdss-dsi-v-bottom-border = <0>;
		qcom,mdss-pan-physical-width-dimension = < 66 >; // 65.98mm
		qcom,mdss-pan-physical-height-dimension = < 117 >; // 117.31 mm
		qcom,mdss-dsi-bpp = <24>;
		qcom,mdss-dsi-color-order = "rgb_swap_rgb";
		qcom,mdss-dsi-underflow-color = <0xff>;
		qcom,mdss-dsi-border-color = <0>;
		qcom,mdss-dsi-post-panel-on-command = [
			05 01 00 00 78 00 01 11
			05 01 00 00 00 00 01 29
		];
		qcom,mdss-dsi-off-command = [
			05 01 00 00 00 00 01 28
			05 01 00 00 78 00 01 10
		];
		qcom,panel-reader-mode-step1-command = [	// LOW 6200K
			15 01 00 00 00 00 02 84 50
		];
		qcom,panel-reader-mode-step2-command = [	// MIDDLE 5620K
			15 01 00 00 00 00 02 84 70
		];
		qcom,panel-reader-mode-step3-command = [	// HIGH 5040K
			15 01 00 00 00 00 02 84 7F
		];
		qcom,panel-reader-mode-off-command = [		// NORMAL
			15 01 00 00 00 00 02 84 00
		];

		qcom,mdss-dsi-on-command-state = "dsi_lp_mode";
		qcom,mdss-dsi-off-command-state = "dsi_hs_mode";
		qcom,mdss-dsi-reader-mode-command-state = "dsi_hs_mode";
		qcom,mdss-dsi-h-sync-pulse = <1>;
		qcom,mdss-dsi-traffic-mode = "non_burst_sync_pulse";
		qcom,mdss-dsi-lane-map = "lane_map_0123";
		qcom,mdss-dsi-bllp-eof-power-mode;
		qcom,mdss-dsi-bllp-power-mode;
		qcom,mdss-dsi-lane-0-state;
		qcom,mdss-dsi-lane-1-state;
		qcom,mdss-dsi-lane-2-state;
		qcom,mdss-dsi-lane-3-state;
		qcom,mdss-dsi-tx-eot-append;
		qcom,mdss-dsi-panel-timings = [8B 1E 14 00 44 4A 18 22 19 03 04 00];
		qcom,mdss-dsi-t-clk-post = <0x04>;
		qcom,mdss-dsi-t-clk-pre = <0x1C>;

		qcom,mdss-dsi-dma-trigger = "trigger_sw";	//default "trigger_sw"
		qcom,mdss-dsi-mdp-trigger = "trigger_sw";	//default "trigger_sw"

		qcom,mdss-dsi-bl-min-level = <1>;
		qcom,mdss-dsi-bl-max-level = <255>;

		qcom,mdss-dsi-reset-sequence = <0 10>, <1 130>;

		lge,blmap-size = <256>;
		lge,blmap = <
			0 45 45 45 45 45 45 45 45 45
			45 45 45 46 46 47 47 48 48 49
			49 50 50 51 52 53 54 56 57 58
			59 61 62 63 64 66 68 70 72 74
			77 79 81 83 85 88 90 92 94 97
			101 106 111 116 121 125 130 135 140 145
			149 153 157 161 166 170 174 178 182 187
			191 195 199 204 211 218 225 232 239 247
			254 261 268 275 282 290 297 304 311 319
			326 333 341 348 355 363 370 377 385 396
			407 418 429 440 451 462 473 484 495 507
			518 529 540 551 562 573 584 595 606 617
			628 639 650 661 672 683 694 705 716 727
			738 749 760 771 852 866 880 895 909 923
			938 952 966 981 995 1010 1026 1042 1058 1074
			1090 1106 1123 1139 1155 1171 1187 1203 1220 1246
			1272 1298 1325 1351 1377 1403 1430 1456 1482 1508
			1540 1560 1580 1600 1620 1640 1660 1680 1700 1720
			1740 1760 1780 1800 1823 1846 1870 1893 1916 1940
			1963 1986 2010 2033 2056 2080 2100 2120 2140 2160
			2180 2200 2220 2240 2280 2260 2300 2320 2340 2370
			2401 2432 2463 2494 2525 2556 2587 2618 2649 2680
			2708 2737 2766 2795 2824 2853 2881 2910 2939 2968
			2997 3026 3055 3089 3123 3157 3191 3225 3260 3294
			3328 3362 3396 3430 3465 3505 3545 3586 3626 3667
			3707 3748 3788 3829 3869 3910>;
	};
};
