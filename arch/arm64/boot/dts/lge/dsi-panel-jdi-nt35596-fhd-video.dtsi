/* Copyright (c) 2014, Code Aurora Forum. All rights reserved.
 *
 * This program is free software; you can redistribute it and/or modify
 * it under the terms of the GNU General Public License version 2 and
 * only version 2 as published by the Free Software Foundation.
 *
 * This program is distributed in the hope that it will be useful,
 * but WITHOUT ANY WARRANTY; without even the implied warranty of
 * MERCHANTABILITY or FITNESS FOR A PARTICULAR PURPOSE.  See the
 * GNU General Public License for more details.
 */

&mdss_mdp {
	dsi_jdi_nt35596_vid: qcom,mdss_dsi_jdi_nt35596_fhd_video {
		compatible = "qcom,mdss-dsi-panel";
		qcom,mdss-dsi-panel-name = "JDI FHD video mode dsi panel";
		qcom,mdss-dsi-panel-controller = <&mdss_dsi0>;
		qcom,mdss-dsi-panel-type = "dsi_video_mode";
		qcom,mdss-dsi-panel-destination = "display_1";
		qcom,mdss-dsi-panel-framerate = <60>;
		qcom,mdss-dsi-virtual-channel-id = <0>;
		qcom,mdss-dsi-stream = <0>;

		qcom,mdss-dsi-panel-width = <1080>;
		qcom,mdss-dsi-panel-height = <1920>;
		qcom,mdss-dsi-h-front-porch = <24>;
		qcom,mdss-dsi-h-back-porch = <96>;
		qcom,mdss-dsi-h-pulse-width = <4>;
		qcom,mdss-dsi-h-sync-skew = <0>;
		qcom,mdss-dsi-v-back-porch = <3>;
		qcom,mdss-dsi-v-front-porch = <4>;
		qcom,mdss-dsi-v-pulse-width = <1>;


		qcom,mdss-pan-physical-width-dimension = <73>;
		qcom,mdss-pan-physical-height-dimension = <125>;

		qcom,mdss-dsi-h-left-border = <0>;
		qcom,mdss-dsi-h-right-border = <0>;
		qcom,mdss-dsi-v-top-border = <0>;
		qcom,mdss-dsi-v-bottom-border = <0>;
		qcom,mdss-dsi-bpp = <24>;
		qcom,mdss-dsi-color-order = "rgb_swap_rgb";
		qcom,mdss-dsi-underflow-color = <0xff>;
		qcom,mdss-dsi-border-color = <0xff>;

		qcom,mdss-dsi-on-command = [
			15 01 00 00 00 00 02 FF 20
			15 01 00 00 00 00 02 75 00
			15 01 00 00 00 00 02 76 00
			15 01 00 00 00 00 02 77 00
			15 01 00 00 00 00 02 78 26
			15 01 00 00 00 00 02 79 00
			15 01 00 00 00 00 02 7A 67
			15 01 00 00 00 00 02 7B 00
			15 01 00 00 00 00 02 7C 92
			15 01 00 00 00 00 02 7D 00
			15 01 00 00 00 00 02 7E AF
			15 01 00 00 00 00 02 7F 00
			15 01 00 00 00 00 02 80 C9
			15 01 00 00 00 00 02 81 00
			15 01 00 00 00 00 02 82 E1
			15 01 00 00 00 00 02 83 00
			15 01 00 00 00 00 02 84 F5
			15 01 00 00 00 00 02 85 01
			15 01 00 00 00 00 02 86 06
			15 01 00 00 00 00 02 87 01
			15 01 00 00 00 00 02 88 3D
			15 01 00 00 00 00 02 89 01
			15 01 00 00 00 00 02 8A 68
			15 01 00 00 00 00 02 8B 01
			15 01 00 00 00 00 02 8C A5
			15 01 00 00 00 00 02 8D 01
			15 01 00 00 00 00 02 8E D2
			15 01 00 00 00 00 02 8F 02
			15 01 00 00 00 00 02 90 16
			15 01 00 00 00 00 02 91 02
			15 01 00 00 00 00 02 92 4C
			15 01 00 00 00 00 02 93 02
			15 01 00 00 00 00 02 94 4D
			15 01 00 00 00 00 02 95 02
			15 01 00 00 00 00 02 96 80
			15 01 00 00 00 00 02 97 02
			15 01 00 00 00 00 02 98 B9
			15 01 00 00 00 00 02 99 02
			15 01 00 00 00 00 02 9A DD
			15 01 00 00 00 00 02 9B 03
			15 01 00 00 00 00 02 9C 0D
			15 01 00 00 00 00 02 9D 03
			15 01 00 00 00 00 02 9E 30
			15 01 00 00 00 00 02 9F 03
			15 01 00 00 00 00 02 A0 61
			15 01 00 00 00 00 02 A2 03
			15 01 00 00 00 00 02 A3 70
			15 01 00 00 00 00 02 A4 03
			15 01 00 00 00 00 02 A5 81
			15 01 00 00 00 00 02 A6 03
			15 01 00 00 00 00 02 A7 94
			15 01 00 00 00 00 02 A9 03
			15 01 00 00 00 00 02 AA A8
			15 01 00 00 00 00 02 AB 03
			15 01 00 00 00 00 02 AC BE
			15 01 00 00 00 00 02 AD 03
			15 01 00 00 00 00 02 AE D7
			15 01 00 00 00 00 02 AF 03
			15 01 00 00 00 00 02 B0 F1
			15 01 00 00 00 00 02 B1 03
			15 01 00 00 00 00 02 B2 FF
			15 01 00 00 00 00 02 B3 00
			15 01 00 00 00 00 02 B4 00
			15 01 00 00 00 00 02 B5 00
			15 01 00 00 00 00 02 B6 26
			15 01 00 00 00 00 02 B7 00
			15 01 00 00 00 00 02 B8 67
			15 01 00 00 00 00 02 B9 00
			15 01 00 00 00 00 02 BA 92
			15 01 00 00 00 00 02 BB 00
			15 01 00 00 00 00 02 BC AF
			15 01 00 00 00 00 02 BD 00
			15 01 00 00 00 00 02 BE C9
			15 01 00 00 00 00 02 BF 00
			15 01 00 00 00 00 02 C0 E1
			15 01 00 00 00 00 02 C1 00
			15 01 00 00 00 00 02 C2 F5
			15 01 00 00 00 00 02 C3 01
			15 01 00 00 00 00 02 C4 06
			15 01 00 00 00 00 02 C5 01
			15 01 00 00 00 00 02 C6 3D
			15 01 00 00 00 00 02 C7 01
			15 01 00 00 00 00 02 C8 68
			15 01 00 00 00 00 02 C9 01
			15 01 00 00 00 00 02 CA A5
			15 01 00 00 00 00 02 CB 01
			15 01 00 00 00 00 02 CC D2
			15 01 00 00 00 00 02 CD 02
			15 01 00 00 00 00 02 CE 16
			15 01 00 00 00 00 02 CF 02
			15 01 00 00 00 00 02 D0 4C
			15 01 00 00 00 00 02 D1 02
			15 01 00 00 00 00 02 D2 4D
			15 01 00 00 00 00 02 D3 02
			15 01 00 00 00 00 02 D4 80
			15 01 00 00 00 00 02 D5 02
			15 01 00 00 00 00 02 D6 B9
			15 01 00 00 00 00 02 D7 02
			15 01 00 00 00 00 02 D8 DD
			15 01 00 00 00 00 02 D9 03
			15 01 00 00 00 00 02 DA 0D
			15 01 00 00 00 00 02 DB 03
			15 01 00 00 00 00 02 DC 30
			15 01 00 00 00 00 02 DD 03
			15 01 00 00 00 00 02 DE 61
			15 01 00 00 00 00 02 DF 03
			15 01 00 00 00 00 02 E0 70
			15 01 00 00 00 00 02 E1 03
			15 01 00 00 00 00 02 E2 81
			15 01 00 00 00 00 02 E3 03
			15 01 00 00 00 00 02 E4 94
			15 01 00 00 00 00 02 E5 03
			15 01 00 00 00 00 02 E6 A8
			15 01 00 00 00 00 02 E7 03
			15 01 00 00 00 00 02 E8 BE
			15 01 00 00 00 00 02 E9 03
			15 01 00 00 00 00 02 EA D7
			15 01 00 00 00 00 02 EB 03
			15 01 00 00 00 00 02 EC F1
			15 01 00 00 00 00 02 ED 03
			15 01 00 00 00 00 02 EE FF
			15 01 00 00 00 00 02 EF 00
			15 01 00 00 00 00 02 F0 5C
			15 01 00 00 00 00 02 F1 00
			15 01 00 00 00 00 02 F2 74
			15 01 00 00 00 00 02 F3 00
			15 01 00 00 00 00 02 F4 9F
			15 01 00 00 00 00 02 F5 00
			15 01 00 00 00 00 02 F6 BF
			15 01 00 00 00 00 02 F7 00
			15 01 00 00 00 00 02 F8 D8
			15 01 00 00 00 00 02 F9 00
			15 01 00 00 00 00 02 FA EE
			15 01 00 00 00 00 02 FB 01
			15 01 00 00 00 00 02 FF 21
			15 01 00 00 00 00 02 00 01
			15 01 00 00 00 00 02 01 01
			15 01 00 00 00 00 02 02 01
			15 01 00 00 00 00 02 03 12
			15 01 00 00 00 00 02 04 01
			15 01 00 00 00 00 02 05 21
			15 01 00 00 00 00 02 06 01
			15 01 00 00 00 00 02 07 53
			15 01 00 00 00 00 02 08 01
			15 01 00 00 00 00 02 09 79
			15 01 00 00 00 00 02 0A 01
			15 01 00 00 00 00 02 0B B0
			15 01 00 00 00 00 02 0C 01
			15 01 00 00 00 00 02 0D DB
			15 01 00 00 00 00 02 0E 02
			15 01 00 00 00 00 02 0F 1B
			15 01 00 00 00 00 02 10 02
			15 01 00 00 00 00 02 11 4F
			15 01 00 00 00 00 02 12 02
			15 01 00 00 00 00 02 13 51
			15 01 00 00 00 00 02 14 02
			15 01 00 00 00 00 02 15 82
			15 01 00 00 00 00 02 16 02
			15 01 00 00 00 00 02 17 BB
			15 01 00 00 00 00 02 18 02
			15 01 00 00 00 00 02 19 DF
			15 01 00 00 00 00 02 1A 03
			15 01 00 00 00 00 02 1B 0F
			15 01 00 00 00 00 02 1C 03
			15 01 00 00 00 00 02 1D 32
			15 01 00 00 00 00 02 1E 03
			15 01 00 00 00 00 02 1F 63
			15 01 00 00 00 00 02 20 03
			15 01 00 00 00 00 02 21 72
			15 01 00 00 00 00 02 22 03
			15 01 00 00 00 00 02 23 83
			15 01 00 00 00 00 02 24 03
			15 01 00 00 00 00 02 25 95
			15 01 00 00 00 00 02 26 03
			15 01 00 00 00 00 02 27 A9
			15 01 00 00 00 00 02 28 03
			15 01 00 00 00 00 02 29 BF
			15 01 00 00 00 00 02 2A 03
			15 01 00 00 00 00 02 2B D7
			15 01 00 00 00 00 02 2D 03
			15 01 00 00 00 00 02 2F F2
			15 01 00 00 00 00 02 30 03
			15 01 00 00 00 00 02 31 FF
			15 01 00 00 00 00 02 32 00
			15 01 00 00 00 00 02 33 5C
			15 01 00 00 00 00 02 34 00
			15 01 00 00 00 00 02 35 74
			15 01 00 00 00 00 02 36 00
			15 01 00 00 00 00 02 37 9F
			15 01 00 00 00 00 02 38 00
			15 01 00 00 00 00 02 39 BF
			15 01 00 00 00 00 02 3A 00
			15 01 00 00 00 00 02 3B D8
			15 01 00 00 00 00 02 3D 00
			15 01 00 00 00 00 02 3F EE
			15 01 00 00 00 00 02 40 01
			15 01 00 00 00 00 02 41 01
			15 01 00 00 00 00 02 42 01
			15 01 00 00 00 00 02 43 12
			15 01 00 00 00 00 02 44 01
			15 01 00 00 00 00 02 45 21
			15 01 00 00 00 00 02 46 01
			15 01 00 00 00 00 02 47 53
			15 01 00 00 00 00 02 48 01
			15 01 00 00 00 00 02 49 79
			15 01 00 00 00 00 02 4A 01
			15 01 00 00 00 00 02 4B B0
			15 01 00 00 00 00 02 4C 01
			15 01 00 00 00 00 02 4D DB
			15 01 00 00 00 00 02 4E 02
			15 01 00 00 00 00 02 4F 1B
			15 01 00 00 00 00 02 50 02
			15 01 00 00 00 00 02 51 4F
			15 01 00 00 00 00 02 52 02
			15 01 00 00 00 00 02 53 51
			15 01 00 00 00 00 02 54 02
			15 01 00 00 00 00 02 55 82
			15 01 00 00 00 00 02 56 02
			15 01 00 00 00 00 02 58 BB
			15 01 00 00 00 00 02 59 02
			15 01 00 00 00 00 02 5A DF
			15 01 00 00 00 00 02 5B 03
			15 01 00 00 00 00 02 5C 0F
			15 01 00 00 00 00 02 5D 03
			15 01 00 00 00 00 02 5E 32
			15 01 00 00 00 00 02 5F 03
			15 01 00 00 00 00 02 60 63
			15 01 00 00 00 00 02 61 03
			15 01 00 00 00 00 02 62 72
			15 01 00 00 00 00 02 63 03
			15 01 00 00 00 00 02 64 83
			15 01 00 00 00 00 02 65 03
			15 01 00 00 00 00 02 66 95
			15 01 00 00 00 00 02 67 03
			15 01 00 00 00 00 02 68 A9
			15 01 00 00 00 00 02 69 03
			15 01 00 00 00 00 02 6A BF
			15 01 00 00 00 00 02 6B 03
			15 01 00 00 00 00 02 6C D7
			15 01 00 00 00 00 02 6D 03
			15 01 00 00 00 00 02 6E F2
			15 01 00 00 00 00 02 6F 03
			15 01 00 00 00 00 02 70 FF
			15 01 00 00 00 00 02 71 00
			15 01 00 00 00 00 02 72 D3
			15 01 00 00 00 00 02 73 00
			15 01 00 00 00 00 02 74 DF
			15 01 00 00 00 00 02 75 00
			15 01 00 00 00 00 02 76 F6
			15 01 00 00 00 00 02 77 01
			15 01 00 00 00 00 02 78 0A
			15 01 00 00 00 00 02 79 01
			15 01 00 00 00 00 02 7A 1B
			15 01 00 00 00 00 02 7B 01
			15 01 00 00 00 00 02 7C 2A
			15 01 00 00 00 00 02 7D 01
			15 01 00 00 00 00 02 7E 37
			15 01 00 00 00 00 02 7F 01
			15 01 00 00 00 00 02 80 43
			15 01 00 00 00 00 02 81 01
			15 01 00 00 00 00 02 82 4F
			15 01 00 00 00 00 02 83 01
			15 01 00 00 00 00 02 84 76
			15 01 00 00 00 00 02 85 01
			15 01 00 00 00 00 02 86 95
			15 01 00 00 00 00 02 87 01
			15 01 00 00 00 00 02 88 C5
			15 01 00 00 00 00 02 89 01
			15 01 00 00 00 00 02 8A EB
			15 01 00 00 00 00 02 8B 02
			15 01 00 00 00 00 02 8C 26
			15 01 00 00 00 00 02 8D 02
			15 01 00 00 00 00 02 8E 57
			15 01 00 00 00 00 02 8F 02
			15 01 00 00 00 00 02 90 58
			15 01 00 00 00 00 02 91 02
			15 01 00 00 00 00 02 92 88
			15 01 00 00 00 00 02 93 02
			15 01 00 00 00 00 02 94 C0
			15 01 00 00 00 00 02 95 02
			15 01 00 00 00 00 02 96 E3
			15 01 00 00 00 00 02 97 03
			15 01 00 00 00 00 02 98 12
			15 01 00 00 00 00 02 99 03
			15 01 00 00 00 00 02 9A 34
			15 01 00 00 00 00 02 9B 03
			15 01 00 00 00 00 02 9C 64
			15 01 00 00 00 00 02 9D 03
			15 01 00 00 00 00 02 9E 73
			15 01 00 00 00 00 02 9F 03
			15 01 00 00 00 00 02 A0 84
			15 01 00 00 00 00 02 A2 03
			15 01 00 00 00 00 02 A3 96
			15 01 00 00 00 00 02 A4 03
			15 01 00 00 00 00 02 A5 AA
			15 01 00 00 00 00 02 A6 03
			15 01 00 00 00 00 02 A7 BF
			15 01 00 00 00 00 02 A9 03
			15 01 00 00 00 00 02 AA D7
			15 01 00 00 00 00 02 AB 03
			15 01 00 00 00 00 02 AC F2
			15 01 00 00 00 00 02 AD 03
			15 01 00 00 00 00 02 AE FF
			15 01 00 00 00 00 02 AF 00
			15 01 00 00 00 00 02 B0 D3
			15 01 00 00 00 00 02 B1 00
			15 01 00 00 00 00 02 B2 DF
			15 01 00 00 00 00 02 B3 00
			15 01 00 00 00 00 02 B4 F6
			15 01 00 00 00 00 02 B5 01
			15 01 00 00 00 00 02 B6 0A
			15 01 00 00 00 00 02 B7 01
			15 01 00 00 00 00 02 B8 1B
			15 01 00 00 00 00 02 B9 01
			15 01 00 00 00 00 02 BA 2A
			15 01 00 00 00 00 02 BB 01
			15 01 00 00 00 00 02 BC 37
			15 01 00 00 00 00 02 BD 01
			15 01 00 00 00 00 02 BE 43
			15 01 00 00 00 00 02 BF 01
			15 01 00 00 00 00 02 C0 4F
			15 01 00 00 00 00 02 C1 01
			15 01 00 00 00 00 02 C2 76
			15 01 00 00 00 00 02 C3 01
			15 01 00 00 00 00 02 C4 95
			15 01 00 00 00 00 02 C5 01
			15 01 00 00 00 00 02 C6 C5
			15 01 00 00 00 00 02 C7 01
			15 01 00 00 00 00 02 C8 EB
			15 01 00 00 00 00 02 C9 02
			15 01 00 00 00 00 02 CA 26
			15 01 00 00 00 00 02 CB 02
			15 01 00 00 00 00 02 CC 57
			15 01 00 00 00 00 02 CD 02
			15 01 00 00 00 00 02 CE 58
			15 01 00 00 00 00 02 CF 02
			15 01 00 00 00 00 02 D0 88
			15 01 00 00 00 00 02 D1 02
			15 01 00 00 00 00 02 D2 C0
			15 01 00 00 00 00 02 D3 02
			15 01 00 00 00 00 02 D4 E3
			15 01 00 00 00 00 02 D5 03
			15 01 00 00 00 00 02 D6 12
			15 01 00 00 00 00 02 D7 03
			15 01 00 00 00 00 02 D8 34
			15 01 00 00 00 00 02 D9 03
			15 01 00 00 00 00 02 DA 64
			15 01 00 00 00 00 02 DB 03
			15 01 00 00 00 00 02 DC 73
			15 01 00 00 00 00 02 DD 03
			15 01 00 00 00 00 02 DE 84
			15 01 00 00 00 00 02 DF 03
			15 01 00 00 00 00 02 E0 96
			15 01 00 00 00 00 02 E1 03
			15 01 00 00 00 00 02 E2 AA
			15 01 00 00 00 00 02 E3 03
			15 01 00 00 00 00 02 E4 BF
			15 01 00 00 00 00 02 E5 03
			15 01 00 00 00 00 02 E6 D7
			15 01 00 00 00 00 02 E7 03
			15 01 00 00 00 00 02 E8 F2
			15 01 00 00 00 00 02 E9 03
			15 01 00 00 00 00 02 EA FF
			15 01 00 00 00 00 02 FB 01

			/* Preset Monochrome mode */
			15 01 00 00 00 00 02 FF 22
			15 01 00 00 00 00 02 00 AA
			15 01 00 00 00 00 02 01 AA
			15 01 00 00 00 00 02 02 AA
			15 01 00 00 00 00 02 03 AA
			15 01 00 00 00 00 02 04 AA
			15 01 00 00 00 00 02 05 AA
			15 01 00 00 00 00 02 06 AA
			15 01 00 00 00 00 02 07 AA
			15 01 00 00 00 00 02 08 AA
			15 01 00 00 00 00 02 09 AA
			15 01 00 00 00 00 02 0A AA
			15 01 00 00 00 00 02 0B AA
			15 01 00 00 00 00 02 0C AA
			15 01 00 00 00 00 02 0D AA
			15 01 00 00 00 00 02 0E AA
			15 01 00 00 00 00 02 0F AA
			15 01 00 00 00 00 02 10 AA
			15 01 00 00 00 00 02 11 AA
			15 01 00 00 00 00 02 12 AA
			15 01 00 00 00 00 02 13 AA
			15 01 00 00 00 00 02 14 20
			15 01 00 00 00 00 02 1A 01
			15 01 00 00 00 00 02 55 00
			15 01 00 00 00 00 02 56 00
			15 01 00 00 00 00 02 58 00
			15 01 00 00 00 00 02 68 00
			15 01 00 00 00 00 02 84 FF
			15 01 00 00 00 00 02 85 FF
			15 01 00 00 00 00 02 86 0F
			15 01 00 00 00 00 02 FB 01

			15 01 00 00 00 00 02 FF 10
			15 01 00 00 00 00 02 35 01
			15 01 00 00 00 00 02 51 FF
			15 01 00 00 00 00 02 53 24
			15 01 00 00 00 00 02 55 00
			15 01 00 00 28 00 02 B0 00 /* wait time 40ms befor sleep out */

			/* Sleep out */
			05 01 00 00 78 00 01 11
			/* Display On */
			05 01 00 00 00 00 01 29
		];

		qcom,mdss-dsi-off-command = [
			/* Display off */
			05 01 00 00 28 00 01 28
			/* Sleep in */
			05 01 00 00 78 00 01 10
		];

		qcom,panel-reader-mode-initial-step1-command = [
			//page selection cmd start
			15 01 00 00 00 00 02 FF 20
			//R(+) MCR cmd
			15 01 00 00 00 00 02 75 00
			15 01 00 00 00 00 02 76 00
			15 01 00 00 00 00 02 77 00
			15 01 00 00 00 00 02 78 24
			15 01 00 00 00 00 02 79 00
			15 01 00 00 00 00 02 7A 64
			15 01 00 00 00 00 02 7B 00
			15 01 00 00 00 00 02 7C 8F
			15 01 00 00 00 00 02 7D 00
			15 01 00 00 00 00 02 7E AD
			15 01 00 00 00 00 02 7F 00
			15 01 00 00 00 00 02 80 C7
			15 01 00 00 00 00 02 81 00
			15 01 00 00 00 00 02 82 DE
			15 01 00 00 00 00 02 83 00
			15 01 00 00 00 00 02 84 F2
			15 01 00 00 00 00 02 85 01
			15 01 00 00 00 00 02 86 03
			15 01 00 00 00 00 02 87 01
			15 01 00 00 00 00 02 88 3B
			15 01 00 00 00 00 02 89 01
			15 01 00 00 00 00 02 8A 66
			15 01 00 00 00 00 02 8B 01
			15 01 00 00 00 00 02 8C A2
			15 01 00 00 00 00 02 8D 01
			15 01 00 00 00 00 02 8E CF
			15 01 00 00 00 00 02 8F 02
			15 01 00 00 00 00 02 90 13
			15 01 00 00 00 00 02 91 02
			15 01 00 00 00 00 02 92 48
			15 01 00 00 00 00 02 93 02
			15 01 00 00 00 00 02 94 4A
			15 01 00 00 00 00 02 95 02
			15 01 00 00 00 00 02 96 7D
			15 01 00 00 00 00 02 97 02
			15 01 00 00 00 00 02 98 B6
			15 01 00 00 00 00 02 99 02
			15 01 00 00 00 00 02 9A DA
			15 01 00 00 00 00 02 9B 03
			15 01 00 00 00 00 02 9C 0A
			15 01 00 00 00 00 02 9D 03
			15 01 00 00 00 00 02 9E 2D
			15 01 00 00 00 00 02 9F 03
			15 01 00 00 00 00 02 A0 5F
			15 01 00 00 00 00 02 A2 03
			15 01 00 00 00 00 02 A3 6E
			15 01 00 00 00 00 02 A4 03
			15 01 00 00 00 00 02 A5 7F
			15 01 00 00 00 00 02 A6 03
			15 01 00 00 00 00 02 A7 92
			15 01 00 00 00 00 02 A9 03
			15 01 00 00 00 00 02 AA A6
			15 01 00 00 00 00 02 AB 03
			15 01 00 00 00 00 02 AC BD
			15 01 00 00 00 00 02 AD 03
			15 01 00 00 00 00 02 AE D6
			15 01 00 00 00 00 02 AF 03
			15 01 00 00 00 00 02 B0 F1
			15 01 00 00 00 00 02 B1 03
			15 01 00 00 00 00 02 B2 FF
			//R(-) MCR cmd
			15 01 00 00 00 00 02 B3 00
			15 01 00 00 00 00 02 B4 00
			15 01 00 00 00 00 02 B5 00
			15 01 00 00 00 00 02 B6 24
			15 01 00 00 00 00 02 B7 00
			15 01 00 00 00 00 02 B8 64
			15 01 00 00 00 00 02 B9 00
			15 01 00 00 00 00 02 BA 8F
			15 01 00 00 00 00 02 BB 00
			15 01 00 00 00 00 02 BC AD
			15 01 00 00 00 00 02 BD 00
			15 01 00 00 00 00 02 BE C7
			15 01 00 00 00 00 02 BF 00
			15 01 00 00 00 00 02 C0 DE
			15 01 00 00 00 00 02 C1 00
			15 01 00 00 00 00 02 C2 F2
			15 01 00 00 00 00 02 C3 01
			15 01 00 00 00 00 02 C4 03
			15 01 00 00 00 00 02 C5 01
			15 01 00 00 00 00 02 C6 3B
			15 01 00 00 00 00 02 C7 01
			15 01 00 00 00 00 02 C8 66
			15 01 00 00 00 00 02 C9 01
			15 01 00 00 00 00 02 CA A2
			15 01 00 00 00 00 02 CB 01
			15 01 00 00 00 00 02 CC CF
			15 01 00 00 00 00 02 CD 02
			15 01 00 00 00 00 02 CE 13
			15 01 00 00 00 00 02 CF 02
			15 01 00 00 00 00 02 D0 48
			15 01 00 00 00 00 02 D1 02
			15 01 00 00 00 00 02 D2 4A
			15 01 00 00 00 00 02 D3 02
			15 01 00 00 00 00 02 D4 7D
			15 01 00 00 00 00 02 D5 02
			15 01 00 00 00 00 02 D6 B6
			15 01 00 00 00 00 02 D7 02
			15 01 00 00 00 00 02 D8 DA
			15 01 00 00 00 00 02 D9 03
			15 01 00 00 00 00 02 DA 0A
			15 01 00 00 00 00 02 DB 03
			15 01 00 00 00 00 02 DC 2D
			15 01 00 00 00 00 02 DD 03
			15 01 00 00 00 00 02 DE 5F
			15 01 00 00 00 00 02 DF 03
			15 01 00 00 00 00 02 E0 6E
			15 01 00 00 00 00 02 E1 03
			15 01 00 00 00 00 02 E2 7F
			15 01 00 00 00 00 02 E3 03
			15 01 00 00 00 00 02 E4 92
			15 01 00 00 00 00 02 E5 03
			15 01 00 00 00 00 02 E6 A6
			15 01 00 00 00 00 02 E7 03
			15 01 00 00 00 00 02 E8 BD
			15 01 00 00 00 00 02 E9 03
			15 01 00 00 00 00 02 EA D6
			15 01 00 00 00 00 02 EB 03
			15 01 00 00 00 00 02 EC F1
			15 01 00 00 00 00 02 ED 03
			15 01 00 00 00 00 02 EE FF
			//G(+) MCR cmd
			15 01 00 00 00 00 02 EF 00
			15 01 00 00 00 00 02 F0 E2
			15 01 00 00 00 00 02 F1 00
			15 01 00 00 00 00 02 F2 EC
			15 01 00 00 00 00 02 F3 00
			15 01 00 00 00 00 02 F4 FE
			15 01 00 00 00 00 02 F5 01
			15 01 00 00 00 00 02 F6 0F
			15 01 00 00 00 00 02 F7 01
			15 01 00 00 00 00 02 F8 1E
			15 01 00 00 00 00 02 F9 01
			15 01 00 00 00 00 02 FA 2B
			//page selection cmd start
			15 01 00 00 00 00 02 FB 01
			15 01 00 00 00 00 02 FF 21
			//page selection cmd end
			15 01 00 00 00 00 02 00 01
			15 01 00 00 00 00 02 01 38
			15 01 00 00 00 00 02 02 01
			15 01 00 00 00 00 02 03 43
			15 01 00 00 00 00 02 04 01
			15 01 00 00 00 00 02 05 4E
			15 01 00 00 00 00 02 06 01
			15 01 00 00 00 00 02 07 73
			15 01 00 00 00 00 02 08 01
			15 01 00 00 00 00 02 09 91
			15 01 00 00 00 00 02 0A 01
			15 01 00 00 00 00 02 0B C0
			15 01 00 00 00 00 02 0C 01
			15 01 00 00 00 00 02 0D E7
			15 01 00 00 00 00 02 0E 02
			15 01 00 00 00 00 02 0F 21
			15 01 00 00 00 00 02 10 02
			15 01 00 00 00 00 02 11 53
			15 01 00 00 00 00 02 12 02
			15 01 00 00 00 00 02 13 54
			15 01 00 00 00 00 02 14 02
			15 01 00 00 00 00 02 15 84
			15 01 00 00 00 00 02 16 02
			15 01 00 00 00 00 02 17 BC
			15 01 00 00 00 00 02 18 02
			15 01 00 00 00 00 02 19 E0
			15 01 00 00 00 00 02 1A 03
			15 01 00 00 00 00 02 1B 10
			15 01 00 00 00 00 02 1C 03
			15 01 00 00 00 00 02 1D 33
			15 01 00 00 00 00 02 1E 03
			15 01 00 00 00 00 02 1F 63
			15 01 00 00 00 00 02 20 03
			15 01 00 00 00 00 02 21 72
			15 01 00 00 00 00 02 22 03
			15 01 00 00 00 00 02 23 83
			15 01 00 00 00 00 02 24 03
			15 01 00 00 00 00 02 25 95
			15 01 00 00 00 00 02 26 03
			15 01 00 00 00 00 02 27 A9
			15 01 00 00 00 00 02 28 03
			15 01 00 00 00 00 02 29 BF
			15 01 00 00 00 00 02 2A 03
			15 01 00 00 00 00 02 2B D7
			15 01 00 00 00 00 02 2D 03
			15 01 00 00 00 00 02 2F F1
			15 01 00 00 00 00 02 30 03
			15 01 00 00 00 00 02 31 FF
			//G(-) MCR cmd
			15 01 00 00 00 00 02 32 00
			15 01 00 00 00 00 02 33 E2
			15 01 00 00 00 00 02 34 00
			15 01 00 00 00 00 02 35 EC
			15 01 00 00 00 00 02 36 00
			15 01 00 00 00 00 02 37 FE
			15 01 00 00 00 00 02 38 01
			15 01 00 00 00 00 02 39 0F
			15 01 00 00 00 00 02 3A 01
			15 01 00 00 00 00 02 3B 1E
			15 01 00 00 00 00 02 3D 01
			15 01 00 00 00 00 02 3F 2B
			15 01 00 00 00 00 02 40 01
			15 01 00 00 00 00 02 41 38
			15 01 00 00 00 00 02 42 01
			15 01 00 00 00 00 02 43 43
			15 01 00 00 00 00 02 44 01
			15 01 00 00 00 00 02 45 4E
			15 01 00 00 00 00 02 46 01
			15 01 00 00 00 00 02 47 73
			15 01 00 00 00 00 02 48 01
			15 01 00 00 00 00 02 49 91
			15 01 00 00 00 00 02 4A 01
			15 01 00 00 00 00 02 4B C0
			15 01 00 00 00 00 02 4C 01
			15 01 00 00 00 00 02 4D E7
			15 01 00 00 00 00 02 4E 02
			15 01 00 00 00 00 02 4F 21
			15 01 00 00 00 00 02 50 02
			15 01 00 00 00 00 02 51 53
			15 01 00 00 00 00 02 52 02
			15 01 00 00 00 00 02 53 54
			15 01 00 00 00 00 02 54 02
			15 01 00 00 00 00 02 55 84
			15 01 00 00 00 00 02 56 02
			15 01 00 00 00 00 02 58 BC
			15 01 00 00 00 00 02 59 02
			15 01 00 00 00 00 02 5A E0
			15 01 00 00 00 00 02 5B 03
			15 01 00 00 00 00 02 5C 10
			15 01 00 00 00 00 02 5D 03
			15 01 00 00 00 00 02 5E 33
			15 01 00 00 00 00 02 5F 03
			15 01 00 00 00 00 02 60 63
			15 01 00 00 00 00 02 61 03
			15 01 00 00 00 00 02 62 72
			15 01 00 00 00 00 02 63 03
			15 01 00 00 00 00 02 64 83
			15 01 00 00 00 00 02 65 03
			15 01 00 00 00 00 02 66 95
			15 01 00 00 00 00 02 67 03
			15 01 00 00 00 00 02 68 A9
			15 01 00 00 00 00 02 69 03
			15 01 00 00 00 00 02 6A BF
			15 01 00 00 00 00 02 6B 03
			15 01 00 00 00 00 02 6C D7
			15 01 00 00 00 00 02 6D 03
			15 01 00 00 00 00 02 6E F1
			15 01 00 00 00 00 02 6F 03
			15 01 00 00 00 00 02 70 FF
			//B(+) MCR cmd
			15 01 00 00 00 00 02 71 01
			15 01 00 00 00 00 02 72 85
			15 01 00 00 00 00 02 73 01
			15 01 00 00 00 00 02 74 88
			15 01 00 00 00 00 02 75 01
			15 01 00 00 00 00 02 76 8E
			15 01 00 00 00 00 02 77 01
			15 01 00 00 00 00 02 78 95
			15 01 00 00 00 00 02 79 01
			15 01 00 00 00 00 02 7A 9B
			15 01 00 00 00 00 02 7B 01
			15 01 00 00 00 00 02 7C A1
			15 01 00 00 00 00 02 7D 01
			15 01 00 00 00 00 02 7E A6
			15 01 00 00 00 00 02 7F 01
			15 01 00 00 00 00 02 80 AC
			15 01 00 00 00 00 02 81 01
			15 01 00 00 00 00 02 82 B1
			15 01 00 00 00 00 02 83 01
			15 01 00 00 00 00 02 84 C4
			15 01 00 00 00 00 02 85 01
			15 01 00 00 00 00 02 86 D6
			15 01 00 00 00 00 02 87 01
			15 01 00 00 00 00 02 88 F5
			15 01 00 00 00 00 02 89 02
			15 01 00 00 00 00 02 8A 10
			15 01 00 00 00 00 02 8B 02
			15 01 00 00 00 00 02 8C 3E
			15 01 00 00 00 00 02 8D 02
			15 01 00 00 00 00 02 8E 68
			15 01 00 00 00 00 02 8F 02
			15 01 00 00 00 00 02 90 69
			15 01 00 00 00 00 02 91 02
			15 01 00 00 00 00 02 92 95
			15 01 00 00 00 00 02 93 02
			15 01 00 00 00 00 02 94 CB
			15 01 00 00 00 00 02 95 02
			15 01 00 00 00 00 02 96 EE
			15 01 00 00 00 00 02 97 03
			15 01 00 00 00 00 02 98 1C
			15 01 00 00 00 00 02 99 03
			15 01 00 00 00 00 02 9A 3D
			15 01 00 00 00 00 02 9B 03
			15 01 00 00 00 00 02 9C 6B
			15 01 00 00 00 00 02 9D 03
			15 01 00 00 00 00 02 9E 79
			15 01 00 00 00 00 02 9F 03
			15 01 00 00 00 00 02 A0 89
			15 01 00 00 00 00 02 A2 03
			15 01 00 00 00 00 02 A3 9A
			15 01 00 00 00 00 02 A4 03
			15 01 00 00 00 00 02 A5 AD
			15 01 00 00 00 00 02 A6 03
			15 01 00 00 00 00 02 A7 C2
			15 01 00 00 00 00 02 A9 03
			15 01 00 00 00 00 02 AA D9
			15 01 00 00 00 00 02 AB 03
			15 01 00 00 00 00 02 AC F2
			15 01 00 00 00 00 02 AD 03
			15 01 00 00 00 00 02 AE FF
			//B(-) MCR cmd
			15 01 00 00 00 00 02 AF 01
			15 01 00 00 00 00 02 B0 85
			15 01 00 00 00 00 02 B1 01
			15 01 00 00 00 00 02 B2 88
			15 01 00 00 00 00 02 B3 01
			15 01 00 00 00 00 02 B4 8E
			15 01 00 00 00 00 02 B5 01
			15 01 00 00 00 00 02 B6 95
			15 01 00 00 00 00 02 B7 01
			15 01 00 00 00 00 02 B8 9B
			15 01 00 00 00 00 02 B9 01
			15 01 00 00 00 00 02 BA A1
			15 01 00 00 00 00 02 BB 01
			15 01 00 00 00 00 02 BC A6
			15 01 00 00 00 00 02 BD 01
			15 01 00 00 00 00 02 BE AC
			15 01 00 00 00 00 02 BF 01
			15 01 00 00 00 00 02 C0 B1
			15 01 00 00 00 00 02 C1 01
			15 01 00 00 00 00 02 C2 C4
			15 01 00 00 00 00 02 C3 01
			15 01 00 00 00 00 02 C4 D6
			15 01 00 00 00 00 02 C5 01
			15 01 00 00 00 00 02 C6 F5
			15 01 00 00 00 00 02 C7 02
			15 01 00 00 00 00 02 C8 10
			15 01 00 00 00 00 02 C9 02
			15 01 00 00 00 00 02 CA 3E
			15 01 00 00 00 00 02 CB 02
			15 01 00 00 00 00 02 CC 68
			15 01 00 00 00 00 02 CD 02
			15 01 00 00 00 00 02 CE 69
			15 01 00 00 00 00 02 CF 02
			15 01 00 00 00 00 02 D0 95
			15 01 00 00 00 00 02 D1 02
			15 01 00 00 00 00 02 D2 CB
			15 01 00 00 00 00 02 D3 02
			15 01 00 00 00 00 02 D4 EE
			15 01 00 00 00 00 02 D5 03
			15 01 00 00 00 00 02 D6 1C
			15 01 00 00 00 00 02 D7 03
			15 01 00 00 00 00 02 D8 3D
			15 01 00 00 00 00 02 D9 03
			15 01 00 00 00 00 02 DA 6B
			15 01 00 00 00 00 02 DB 03
			15 01 00 00 00 00 02 DC 79
			15 01 00 00 00 00 02 DD 03
			15 01 00 00 00 00 02 DE 89
			15 01 00 00 00 00 02 DF 03
			15 01 00 00 00 00 02 E0 9A
			15 01 00 00 00 00 02 E1 03
			15 01 00 00 00 00 02 E2 AD
			15 01 00 00 00 00 02 E3 03
			15 01 00 00 00 00 02 E4 C2
			15 01 00 00 00 00 02 E5 03
			15 01 00 00 00 00 02 E6 D9
			15 01 00 00 00 00 02 E7 03
			15 01 00 00 00 00 02 E8 F2
			15 01 00 00 00 00 02 E9 03
			15 01 00 00 00 00 02 EA FF
			//page selection cmd start
			15 01 00 00 00 00 02 FB 01
			15 01 00 00 00 00 02 FF 10
			//page selection cmd end
		];

		qcom,panel-reader-mode-step1-command = [
			//page selection cmd start
			15 00 00 00 00 00 02 FF 20
			//R(+) MCR cmd
			15 00 00 00 00 00 02 75 00
			15 00 00 00 00 00 02 76 00
			15 00 00 00 00 00 02 77 00
			15 00 00 00 00 00 02 78 24
			15 00 00 00 00 00 02 79 00
			15 00 00 00 00 00 02 7A 64
			15 00 00 00 00 00 02 7B 00
			15 00 00 00 00 00 02 7C 8F
			15 00 00 00 00 00 02 7D 00
			15 00 00 00 00 00 02 7E AD
			15 00 00 00 00 00 02 7F 00
			15 00 00 00 00 00 02 80 C7
			15 00 00 00 00 00 02 81 00
			15 00 00 00 00 00 02 82 DE
			15 00 00 00 00 00 02 83 00
			15 00 00 00 00 00 02 84 F2
			15 00 00 00 00 00 02 85 01
			15 00 00 00 00 00 02 86 03
			15 00 00 00 00 00 02 87 01
			15 00 00 00 00 00 02 88 3B
			15 00 00 00 00 00 02 89 01
			15 00 00 00 00 00 02 8A 66
			15 00 00 00 00 00 02 8B 01
			15 00 00 00 00 00 02 8C A2
			15 00 00 00 00 00 02 8D 01
			15 00 00 00 00 00 02 8E CF
			15 00 00 00 00 00 02 8F 02
			15 00 00 00 00 00 02 90 13
			15 00 00 00 00 00 02 91 02
			15 00 00 00 00 00 02 92 48
			15 00 00 00 00 00 02 93 02
			15 00 00 00 00 00 02 94 4A
			15 00 00 00 00 00 02 95 02
			15 00 00 00 00 00 02 96 7D
			15 00 00 00 00 00 02 97 02
			15 00 00 00 00 00 02 98 B6
			15 00 00 00 00 00 02 99 02
			15 00 00 00 00 00 02 9A DA
			15 00 00 00 00 00 02 9B 03
			15 00 00 00 00 00 02 9C 0A
			15 00 00 00 00 00 02 9D 03
			15 00 00 00 00 00 02 9E 2D
			15 00 00 00 00 00 02 9F 03
			15 00 00 00 00 00 02 A0 5F
			15 00 00 00 00 00 02 A2 03
			15 00 00 00 00 00 02 A3 6E
			15 00 00 00 00 00 02 A4 03
			15 00 00 00 00 00 02 A5 7F
			15 00 00 00 00 00 02 A6 03
			15 00 00 00 00 00 02 A7 92
			15 00 00 00 00 00 02 A9 03
			15 00 00 00 00 00 02 AA A6
			15 00 00 00 00 00 02 AB 03
			15 00 00 00 00 00 02 AC BD
			15 00 00 00 00 00 02 AD 03
			15 00 00 00 00 00 02 AE D6
			15 00 00 00 00 00 02 AF 03
			15 00 00 00 00 00 02 B0 F1
			15 00 00 00 00 00 02 B1 03
			15 01 00 00 00 00 02 B2 FF
			//R(-) MCR cmd
			15 00 00 00 00 00 02 B3 00
			15 00 00 00 00 00 02 B4 00
			15 00 00 00 00 00 02 B5 00
			15 00 00 00 00 00 02 B6 24
			15 00 00 00 00 00 02 B7 00
			15 00 00 00 00 00 02 B8 64
			15 00 00 00 00 00 02 B9 00
			15 00 00 00 00 00 02 BA 8F
			15 00 00 00 00 00 02 BB 00
			15 00 00 00 00 00 02 BC AD
			15 00 00 00 00 00 02 BD 00
			15 00 00 00 00 00 02 BE C7
			15 00 00 00 00 00 02 BF 00
			15 00 00 00 00 00 02 C0 DE
			15 00 00 00 00 00 02 C1 00
			15 00 00 00 00 00 02 C2 F2
			15 00 00 00 00 00 02 C3 01
			15 00 00 00 00 00 02 C4 03
			15 00 00 00 00 00 02 C5 01
			15 00 00 00 00 00 02 C6 3B
			15 00 00 00 00 00 02 C7 01
			15 00 00 00 00 00 02 C8 66
			15 00 00 00 00 00 02 C9 01
			15 00 00 00 00 00 02 CA A2
			15 00 00 00 00 00 02 CB 01
			15 00 00 00 00 00 02 CC CF
			15 00 00 00 00 00 02 CD 02
			15 00 00 00 00 00 02 CE 13
			15 00 00 00 00 00 02 CF 02
			15 00 00 00 00 00 02 D0 48
			15 00 00 00 00 00 02 D1 02
			15 00 00 00 00 00 02 D2 4A
			15 00 00 00 00 00 02 D3 02
			15 00 00 00 00 00 02 D4 7D
			15 00 00 00 00 00 02 D5 02
			15 00 00 00 00 00 02 D6 B6
			15 00 00 00 00 00 02 D7 02
			15 00 00 00 00 00 02 D8 DA
			15 00 00 00 00 00 02 D9 03
			15 00 00 00 00 00 02 DA 0A
			15 00 00 00 00 00 02 DB 03
			15 00 00 00 00 00 02 DC 2D
			15 00 00 00 00 00 02 DD 03
			15 00 00 00 00 00 02 DE 5F
			15 00 00 00 00 00 02 DF 03
			15 00 00 00 00 00 02 E0 6E
			15 00 00 00 00 00 02 E1 03
			15 00 00 00 00 00 02 E2 7F
			15 00 00 00 00 00 02 E3 03
			15 00 00 00 00 00 02 E4 92
			15 00 00 00 00 00 02 E5 03
			15 00 00 00 00 00 02 E6 A6
			15 00 00 00 00 00 02 E7 03
			15 00 00 00 00 00 02 E8 BD
			15 00 00 00 00 00 02 E9 03
			15 00 00 00 00 00 02 EA D6
			15 00 00 00 00 00 02 EB 03
			15 00 00 00 00 00 02 EC F1
			15 00 00 00 00 00 02 ED 03
			15 01 00 00 00 00 02 EE FF
			//G(+) MCR cmd
			15 00 00 00 00 00 02 EF 00
			15 00 00 00 00 00 02 F0 E2
			15 00 00 00 00 00 02 F1 00
			15 00 00 00 00 00 02 F2 EC
			15 00 00 00 00 00 02 F3 00
			15 00 00 00 00 00 02 F4 FE
			15 00 00 00 00 00 02 F5 01
			15 00 00 00 00 00 02 F6 0F
			15 00 00 00 00 00 02 F7 01
			15 00 00 00 00 00 02 F8 1E
			15 00 00 00 00 00 02 F9 01
			15 00 00 00 00 00 02 FA 2B
			//page selection cmd start
			15 00 00 00 00 00 02 FB 01
			15 00 00 00 00 00 02 FF 21
			//page selection cmd end
			15 00 00 00 00 00 02 00 01
			15 00 00 00 00 00 02 01 38
			15 00 00 00 00 00 02 02 01
			15 00 00 00 00 00 02 03 43
			15 00 00 00 00 00 02 04 01
			15 00 00 00 00 00 02 05 4E
			15 00 00 00 00 00 02 06 01
			15 00 00 00 00 00 02 07 73
			15 00 00 00 00 00 02 08 01
			15 00 00 00 00 00 02 09 91
			15 00 00 00 00 00 02 0A 01
			15 00 00 00 00 00 02 0B C0
			15 00 00 00 00 00 02 0C 01
			15 00 00 00 00 00 02 0D E7
			15 00 00 00 00 00 02 0E 02
			15 00 00 00 00 00 02 0F 21
			15 00 00 00 00 00 02 10 02
			15 00 00 00 00 00 02 11 53
			15 00 00 00 00 00 02 12 02
			15 00 00 00 00 00 02 13 54
			15 00 00 00 00 00 02 14 02
			15 00 00 00 00 00 02 15 84
			15 00 00 00 00 00 02 16 02
			15 00 00 00 00 00 02 17 BC
			15 00 00 00 00 00 02 18 02
			15 00 00 00 00 00 02 19 E0
			15 00 00 00 00 00 02 1A 03
			15 00 00 00 00 00 02 1B 10
			15 00 00 00 00 00 02 1C 03
			15 00 00 00 00 00 02 1D 33
			15 00 00 00 00 00 02 1E 03
			15 00 00 00 00 00 02 1F 63
			15 00 00 00 00 00 02 20 03
			15 00 00 00 00 00 02 21 72
			15 00 00 00 00 00 02 22 03
			15 00 00 00 00 00 02 23 83
			15 00 00 00 00 00 02 24 03
			15 00 00 00 00 00 02 25 95
			15 00 00 00 00 00 02 26 03
			15 00 00 00 00 00 02 27 A9
			15 00 00 00 00 00 02 28 03
			15 00 00 00 00 00 02 29 BF
			15 00 00 00 00 00 02 2A 03
			15 00 00 00 00 00 02 2B D7
			15 00 00 00 00 00 02 2D 03
			15 00 00 00 00 00 02 2F F1
			15 00 00 00 00 00 02 30 03
			15 01 00 00 00 00 02 31 FF
			//G(-) MCR cmd
			15 00 00 00 00 00 02 32 00
			15 00 00 00 00 00 02 33 E2
			15 00 00 00 00 00 02 34 00
			15 00 00 00 00 00 02 35 EC
			15 00 00 00 00 00 02 36 00
			15 00 00 00 00 00 02 37 FE
			15 00 00 00 00 00 02 38 01
			15 00 00 00 00 00 02 39 0F
			15 00 00 00 00 00 02 3A 01
			15 00 00 00 00 00 02 3B 1E
			15 00 00 00 00 00 02 3D 01
			15 00 00 00 00 00 02 3F 2B
			15 00 00 00 00 00 02 40 01
			15 00 00 00 00 00 02 41 38
			15 00 00 00 00 00 02 42 01
			15 00 00 00 00 00 02 43 43
			15 00 00 00 00 00 02 44 01
			15 00 00 00 00 00 02 45 4E
			15 00 00 00 00 00 02 46 01
			15 00 00 00 00 00 02 47 73
			15 00 00 00 00 00 02 48 01
			15 00 00 00 00 00 02 49 91
			15 00 00 00 00 00 02 4A 01
			15 00 00 00 00 00 02 4B C0
			15 00 00 00 00 00 02 4C 01
			15 00 00 00 00 00 02 4D E7
			15 00 00 00 00 00 02 4E 02
			15 00 00 00 00 00 02 4F 21
			15 00 00 00 00 00 02 50 02
			15 00 00 00 00 00 02 51 53
			15 00 00 00 00 00 02 52 02
			15 00 00 00 00 00 02 53 54
			15 00 00 00 00 00 02 54 02
			15 00 00 00 00 00 02 55 84
			15 00 00 00 00 00 02 56 02
			15 00 00 00 00 00 02 58 BC
			15 00 00 00 00 00 02 59 02
			15 00 00 00 00 00 02 5A E0
			15 00 00 00 00 00 02 5B 03
			15 00 00 00 00 00 02 5C 10
			15 00 00 00 00 00 02 5D 03
			15 00 00 00 00 00 02 5E 33
			15 00 00 00 00 00 02 5F 03
			15 00 00 00 00 00 02 60 63
			15 00 00 00 00 00 02 61 03
			15 00 00 00 00 00 02 62 72
			15 00 00 00 00 00 02 63 03
			15 00 00 00 00 00 02 64 83
			15 00 00 00 00 00 02 65 03
			15 00 00 00 00 00 02 66 95
			15 00 00 00 00 00 02 67 03
			15 00 00 00 00 00 02 68 A9
			15 00 00 00 00 00 02 69 03
			15 00 00 00 00 00 02 6A BF
			15 00 00 00 00 00 02 6B 03
			15 00 00 00 00 00 02 6C D7
			15 00 00 00 00 00 02 6D 03
			15 00 00 00 00 00 02 6E F1
			15 00 00 00 00 00 02 6F 03
			15 01 00 00 00 00 02 70 FF
			//B(+) MCR cmd
			15 00 00 00 00 00 02 71 01
			15 00 00 00 00 00 02 72 85
			15 00 00 00 00 00 02 73 01
			15 00 00 00 00 00 02 74 88
			15 00 00 00 00 00 02 75 01
			15 00 00 00 00 00 02 76 8E
			15 00 00 00 00 00 02 77 01
			15 00 00 00 00 00 02 78 95
			15 00 00 00 00 00 02 79 01
			15 00 00 00 00 00 02 7A 9B
			15 00 00 00 00 00 02 7B 01
			15 00 00 00 00 00 02 7C A1
			15 00 00 00 00 00 02 7D 01
			15 00 00 00 00 00 02 7E A6
			15 00 00 00 00 00 02 7F 01
			15 00 00 00 00 00 02 80 AC
			15 00 00 00 00 00 02 81 01
			15 00 00 00 00 00 02 82 B1
			15 00 00 00 00 00 02 83 01
			15 00 00 00 00 00 02 84 C4
			15 00 00 00 00 00 02 85 01
			15 00 00 00 00 00 02 86 D6
			15 00 00 00 00 00 02 87 01
			15 00 00 00 00 00 02 88 F5
			15 00 00 00 00 00 02 89 02
			15 00 00 00 00 00 02 8A 10
			15 00 00 00 00 00 02 8B 02
			15 00 00 00 00 00 02 8C 3E
			15 00 00 00 00 00 02 8D 02
			15 00 00 00 00 00 02 8E 68
			15 00 00 00 00 00 02 8F 02
			15 00 00 00 00 00 02 90 69
			15 00 00 00 00 00 02 91 02
			15 00 00 00 00 00 02 92 95
			15 00 00 00 00 00 02 93 02
			15 00 00 00 00 00 02 94 CB
			15 00 00 00 00 00 02 95 02
			15 00 00 00 00 00 02 96 EE
			15 00 00 00 00 00 02 97 03
			15 00 00 00 00 00 02 98 1C
			15 00 00 00 00 00 02 99 03
			15 00 00 00 00 00 02 9A 3D
			15 00 00 00 00 00 02 9B 03
			15 00 00 00 00 00 02 9C 6B
			15 00 00 00 00 00 02 9D 03
			15 00 00 00 00 00 02 9E 79
			15 00 00 00 00 00 02 9F 03
			15 00 00 00 00 00 02 A0 89
			15 00 00 00 00 00 02 A2 03
			15 00 00 00 00 00 02 A3 9A
			15 00 00 00 00 00 02 A4 03
			15 00 00 00 00 00 02 A5 AD
			15 00 00 00 00 00 02 A6 03
			15 00 00 00 00 00 02 A7 C2
			15 00 00 00 00 00 02 A9 03
			15 00 00 00 00 00 02 AA D9
			15 00 00 00 00 00 02 AB 03
			15 00 00 00 00 00 02 AC F2
			15 00 00 00 00 00 02 AD 03
			15 01 00 00 00 00 02 AE FF
			//B(-) MCR cmd
			15 00 00 00 00 00 02 AF 01
			15 00 00 00 00 00 02 B0 85
			15 00 00 00 00 00 02 B1 01
			15 00 00 00 00 00 02 B2 88
			15 00 00 00 00 00 02 B3 01
			15 00 00 00 00 00 02 B4 8E
			15 00 00 00 00 00 02 B5 01
			15 00 00 00 00 00 02 B6 95
			15 00 00 00 00 00 02 B7 01
			15 00 00 00 00 00 02 B8 9B
			15 00 00 00 00 00 02 B9 01
			15 00 00 00 00 00 02 BA A1
			15 00 00 00 00 00 02 BB 01
			15 00 00 00 00 00 02 BC A6
			15 00 00 00 00 00 02 BD 01
			15 00 00 00 00 00 02 BE AC
			15 00 00 00 00 00 02 BF 01
			15 00 00 00 00 00 02 C0 B1
			15 00 00 00 00 00 02 C1 01
			15 00 00 00 00 00 02 C2 C4
			15 00 00 00 00 00 02 C3 01
			15 00 00 00 00 00 02 C4 D6
			15 00 00 00 00 00 02 C5 01
			15 00 00 00 00 00 02 C6 F5
			15 00 00 00 00 00 02 C7 02
			15 00 00 00 00 00 02 C8 10
			15 00 00 00 00 00 02 C9 02
			15 00 00 00 00 00 02 CA 3E
			15 00 00 00 00 00 02 CB 02
			15 00 00 00 00 00 02 CC 68
			15 00 00 00 00 00 02 CD 02
			15 00 00 00 00 00 02 CE 69
			15 00 00 00 00 00 02 CF 02
			15 00 00 00 00 00 02 D0 95
			15 00 00 00 00 00 02 D1 02
			15 00 00 00 00 00 02 D2 CB
			15 00 00 00 00 00 02 D3 02
			15 00 00 00 00 00 02 D4 EE
			15 00 00 00 00 00 02 D5 03
			15 00 00 00 00 00 02 D6 1C
			15 00 00 00 00 00 02 D7 03
			15 00 00 00 00 00 02 D8 3D
			15 00 00 00 00 00 02 D9 03
			15 00 00 00 00 00 02 DA 6B
			15 00 00 00 00 00 02 DB 03
			15 00 00 00 00 00 02 DC 79
			15 00 00 00 00 00 02 DD 03
			15 00 00 00 00 00 02 DE 89
			15 00 00 00 00 00 02 DF 03
			15 00 00 00 00 00 02 E0 9A
			15 00 00 00 00 00 02 E1 03
			15 00 00 00 00 00 02 E2 AD
			15 00 00 00 00 00 02 E3 03
			15 00 00 00 00 00 02 E4 C2
			15 00 00 00 00 00 02 E5 03
			15 00 00 00 00 00 02 E6 D9
			15 00 00 00 00 00 02 E7 03
			15 00 00 00 00 00 02 E8 F2
			15 00 00 00 00 00 02 E9 03
			15 00 00 00 00 00 02 EA FF
			//page selection cmd start
			15 00 00 00 00 00 02 FB 01
			15 01 00 00 00 00 02 FF 10
			//page selection cmd end
		];

		qcom,panel-reader-mode-initial-step2-command = [
			//page selection cmd start
			15 01 00 00 00 00 02 FF 20
			//R(+) MCR cmd
			15 01 00 00 00 00 02 75 00
			15 01 00 00 00 00 02 76 00
			15 01 00 00 00 00 02 77 00
			15 01 00 00 00 00 02 78 24
			15 01 00 00 00 00 02 79 00
			15 01 00 00 00 00 02 7A 64
			15 01 00 00 00 00 02 7B 00
			15 01 00 00 00 00 02 7C 8F
			15 01 00 00 00 00 02 7D 00
			15 01 00 00 00 00 02 7E AD
			15 01 00 00 00 00 02 7F 00
			15 01 00 00 00 00 02 80 C7
			15 01 00 00 00 00 02 81 00
			15 01 00 00 00 00 02 82 DE
			15 01 00 00 00 00 02 83 00
			15 01 00 00 00 00 02 84 F2
			15 01 00 00 00 00 02 85 01
			15 01 00 00 00 00 02 86 03
			15 01 00 00 00 00 02 87 01
			15 01 00 00 00 00 02 88 3B
			15 01 00 00 00 00 02 89 01
			15 01 00 00 00 00 02 8A 66
			15 01 00 00 00 00 02 8B 01
			15 01 00 00 00 00 02 8C A2
			15 01 00 00 00 00 02 8D 01
			15 01 00 00 00 00 02 8E CF
			15 01 00 00 00 00 02 8F 02
			15 01 00 00 00 00 02 90 13
			15 01 00 00 00 00 02 91 02
			15 01 00 00 00 00 02 92 48
			15 01 00 00 00 00 02 93 02
			15 01 00 00 00 00 02 94 4A
			15 01 00 00 00 00 02 95 02
			15 01 00 00 00 00 02 96 7D
			15 01 00 00 00 00 02 97 02
			15 01 00 00 00 00 02 98 B6
			15 01 00 00 00 00 02 99 02
			15 01 00 00 00 00 02 9A DA
			15 01 00 00 00 00 02 9B 03
			15 01 00 00 00 00 02 9C 0A
			15 01 00 00 00 00 02 9D 03
			15 01 00 00 00 00 02 9E 2D
			15 01 00 00 00 00 02 9F 03
			15 01 00 00 00 00 02 A0 5F
			15 01 00 00 00 00 02 A2 03
			15 01 00 00 00 00 02 A3 6E
			15 01 00 00 00 00 02 A4 03
			15 01 00 00 00 00 02 A5 7F
			15 01 00 00 00 00 02 A6 03
			15 01 00 00 00 00 02 A7 92
			15 01 00 00 00 00 02 A9 03
			15 01 00 00 00 00 02 AA A6
			15 01 00 00 00 00 02 AB 03
			15 01 00 00 00 00 02 AC BD
			15 01 00 00 00 00 02 AD 03
			15 01 00 00 00 00 02 AE D6
			15 01 00 00 00 00 02 AF 03
			15 01 00 00 00 00 02 B0 F1
			15 01 00 00 00 00 02 B1 03
			15 01 00 00 00 00 02 B2 FF
			//R(-) MCR cmd
			15 01 00 00 00 00 02 B3 00
			15 01 00 00 00 00 02 B4 00
			15 01 00 00 00 00 02 B5 00
			15 01 00 00 00 00 02 B6 24
			15 01 00 00 00 00 02 B7 00
			15 01 00 00 00 00 02 B8 64
			15 01 00 00 00 00 02 B9 00
			15 01 00 00 00 00 02 BA 8F
			15 01 00 00 00 00 02 BB 00
			15 01 00 00 00 00 02 BC AD
			15 01 00 00 00 00 02 BD 00
			15 01 00 00 00 00 02 BE C7
			15 01 00 00 00 00 02 BF 00
			15 01 00 00 00 00 02 C0 DE
			15 01 00 00 00 00 02 C1 00
			15 01 00 00 00 00 02 C2 F2
			15 01 00 00 00 00 02 C3 01
			15 01 00 00 00 00 02 C4 03
			15 01 00 00 00 00 02 C5 01
			15 01 00 00 00 00 02 C6 3B
			15 01 00 00 00 00 02 C7 01
			15 01 00 00 00 00 02 C8 66
			15 01 00 00 00 00 02 C9 01
			15 01 00 00 00 00 02 CA A2
			15 01 00 00 00 00 02 CB 01
			15 01 00 00 00 00 02 CC CF
			15 01 00 00 00 00 02 CD 02
			15 01 00 00 00 00 02 CE 13
			15 01 00 00 00 00 02 CF 02
			15 01 00 00 00 00 02 D0 48
			15 01 00 00 00 00 02 D1 02
			15 01 00 00 00 00 02 D2 4A
			15 01 00 00 00 00 02 D3 02
			15 01 00 00 00 00 02 D4 7D
			15 01 00 00 00 00 02 D5 02
			15 01 00 00 00 00 02 D6 B6
			15 01 00 00 00 00 02 D7 02
			15 01 00 00 00 00 02 D8 DA
			15 01 00 00 00 00 02 D9 03
			15 01 00 00 00 00 02 DA 0A
			15 01 00 00 00 00 02 DB 03
			15 01 00 00 00 00 02 DC 2D
			15 01 00 00 00 00 02 DD 03
			15 01 00 00 00 00 02 DE 5F
			15 01 00 00 00 00 02 DF 03
			15 01 00 00 00 00 02 E0 6E
			15 01 00 00 00 00 02 E1 03
			15 01 00 00 00 00 02 E2 7F
			15 01 00 00 00 00 02 E3 03
			15 01 00 00 00 00 02 E4 92
			15 01 00 00 00 00 02 E5 03
			15 01 00 00 00 00 02 E6 A6
			15 01 00 00 00 00 02 E7 03
			15 01 00 00 00 00 02 E8 BD
			15 01 00 00 00 00 02 E9 03
			15 01 00 00 00 00 02 EA D6
			15 01 00 00 00 00 02 EB 03
			15 01 00 00 00 00 02 EC F1
			15 01 00 00 00 00 02 ED 03
			15 01 00 00 00 00 02 EE FF
			//G(+) MCR cmd
			15 01 00 00 00 00 02 EF 01
			15 01 00 00 00 00 02 F0 1F
			15 01 00 00 00 00 02 F1 01
			15 01 00 00 00 00 02 F2 26
			15 01 00 00 00 00 02 F3 01
			15 01 00 00 00 00 02 F4 33
			15 01 00 00 00 00 02 F5 01
			15 01 00 00 00 00 02 F6 3E
			15 01 00 00 00 00 02 F7 01
			15 01 00 00 00 00 02 F8 49
			15 01 00 00 00 00 02 F9 01
			15 01 00 00 00 00 02 FA 53
			//page selection cmd start
			15 01 00 00 00 00 02 FB 01
			15 01 00 00 00 00 02 FF 21
			//page selection cmd end
			15 01 00 00 00 00 02 00 01
			15 01 00 00 00 00 02 01 5D
			15 01 00 00 00 00 02 02 01
			15 01 00 00 00 00 02 03 66
			15 01 00 00 00 00 02 04 01
			15 01 00 00 00 00 02 05 6E
			15 01 00 00 00 00 02 06 01
			15 01 00 00 00 00 02 07 8C
			15 01 00 00 00 00 02 08 01
			15 01 00 00 00 00 02 09 A6
			15 01 00 00 00 00 02 0A 01
			15 01 00 00 00 00 02 0B D0
			15 01 00 00 00 00 02 0C 01
			15 01 00 00 00 00 02 0D F1
			15 01 00 00 00 00 02 0E 02
			15 01 00 00 00 00 02 0F 29
			15 01 00 00 00 00 02 10 02
			15 01 00 00 00 00 02 11 58
			15 01 00 00 00 00 02 12 02
			15 01 00 00 00 00 02 13 59
			15 01 00 00 00 00 02 14 02
			15 01 00 00 00 00 02 15 88
			15 01 00 00 00 00 02 16 02
			15 01 00 00 00 00 02 17 C0
			15 01 00 00 00 00 02 18 02
			15 01 00 00 00 00 02 19 E4
			15 01 00 00 00 00 02 1A 03
			15 01 00 00 00 00 02 1B 13
			15 01 00 00 00 00 02 1C 03
			15 01 00 00 00 00 02 1D 36
			15 01 00 00 00 00 02 1E 03
			15 01 00 00 00 00 02 1F 65
			15 01 00 00 00 00 02 20 03
			15 01 00 00 00 00 02 21 74
			15 01 00 00 00 00 02 22 03
			15 01 00 00 00 00 02 23 85
			15 01 00 00 00 00 02 24 03
			15 01 00 00 00 00 02 25 97
			15 01 00 00 00 00 02 26 03
			15 01 00 00 00 00 02 27 AA
			15 01 00 00 00 00 02 28 03
			15 01 00 00 00 00 02 29 C0
			15 01 00 00 00 00 02 2A 03
			15 01 00 00 00 00 02 2B D8
			15 01 00 00 00 00 02 2D 03
			15 01 00 00 00 00 02 2F F2
			15 01 00 00 00 00 02 30 03
			15 01 00 00 00 00 02 31 FF
			//G(-) MCR cmd
			15 01 00 00 00 00 02 32 01
			15 01 00 00 00 00 02 33 1F
			15 01 00 00 00 00 02 34 01
			15 01 00 00 00 00 02 35 26
			15 01 00 00 00 00 02 36 01
			15 01 00 00 00 00 02 37 33
			15 01 00 00 00 00 02 38 01
			15 01 00 00 00 00 02 39 3E
			15 01 00 00 00 00 02 3A 01
			15 01 00 00 00 00 02 3B 49
			15 01 00 00 00 00 02 3D 01
			15 01 00 00 00 00 02 3F 53
			15 01 00 00 00 00 02 40 01
			15 01 00 00 00 00 02 41 5D
			15 01 00 00 00 00 02 42 01
			15 01 00 00 00 00 02 43 66
			15 01 00 00 00 00 02 44 01
			15 01 00 00 00 00 02 45 6E
			15 01 00 00 00 00 02 46 01
			15 01 00 00 00 00 02 47 8C
			15 01 00 00 00 00 02 48 01
			15 01 00 00 00 00 02 49 A6
			15 01 00 00 00 00 02 4A 01
			15 01 00 00 00 00 02 4B D0
			15 01 00 00 00 00 02 4C 01
			15 01 00 00 00 00 02 4D F1
			15 01 00 00 00 00 02 4E 02
			15 01 00 00 00 00 02 4F 29
			15 01 00 00 00 00 02 50 02
			15 01 00 00 00 00 02 51 58
			15 01 00 00 00 00 02 52 02
			15 01 00 00 00 00 02 53 59
			15 01 00 00 00 00 02 54 02
			15 01 00 00 00 00 02 55 88
			15 01 00 00 00 00 02 56 02
			15 01 00 00 00 00 02 58 C0
			15 01 00 00 00 00 02 59 02
			15 01 00 00 00 00 02 5A E4
			15 01 00 00 00 00 02 5B 03
			15 01 00 00 00 00 02 5C 13
			15 01 00 00 00 00 02 5D 03
			15 01 00 00 00 00 02 5E 36
			15 01 00 00 00 00 02 5F 03
			15 01 00 00 00 00 02 60 65
			15 01 00 00 00 00 02 61 03
			15 01 00 00 00 00 02 62 74
			15 01 00 00 00 00 02 63 03
			15 01 00 00 00 00 02 64 85
			15 01 00 00 00 00 02 65 03
			15 01 00 00 00 00 02 66 97
			15 01 00 00 00 00 02 67 03
			15 01 00 00 00 00 02 68 AA
			15 01 00 00 00 00 02 69 03
			15 01 00 00 00 00 02 6A C0
			15 01 00 00 00 00 02 6B 03
			15 01 00 00 00 00 02 6C D8
			15 01 00 00 00 00 02 6D 03
			15 01 00 00 00 00 02 6E F2
			15 01 00 00 00 00 02 6F 03
			15 01 00 00 00 00 02 70 FF
			//B(+) MCR cmd
			15 01 00 00 00 00 02 71 01
			15 01 00 00 00 00 02 72 C0
			15 01 00 00 00 00 02 73 01
			15 01 00 00 00 00 02 74 C2
			15 01 00 00 00 00 02 75 01
			15 01 00 00 00 00 02 76 C6
			15 01 00 00 00 00 02 77 01
			15 01 00 00 00 00 02 78 CA
			15 01 00 00 00 00 02 79 01
			15 01 00 00 00 00 02 7A CE
			15 01 00 00 00 00 02 7B 01
			15 01 00 00 00 00 02 7C D2
			15 01 00 00 00 00 02 7D 01
			15 01 00 00 00 00 02 7E D6
			15 01 00 00 00 00 02 7F 01
			15 01 00 00 00 00 02 80 DA
			15 01 00 00 00 00 02 81 01
			15 01 00 00 00 00 02 82 DE
			15 01 00 00 00 00 02 83 01
			15 01 00 00 00 00 02 84 EC
			15 01 00 00 00 00 02 85 01
			15 01 00 00 00 00 02 86 F9
			15 01 00 00 00 00 02 87 02
			15 01 00 00 00 00 02 88 11
			15 01 00 00 00 00 02 89 02
			15 01 00 00 00 00 02 8A 27
			15 01 00 00 00 00 02 8B 02
			15 01 00 00 00 00 02 8C 4F
			15 01 00 00 00 00 02 8D 02
			15 01 00 00 00 00 02 8E 75
			15 01 00 00 00 00 02 8F 02
			15 01 00 00 00 00 02 90 77
			15 01 00 00 00 00 02 91 02
			15 01 00 00 00 00 02 92 A1
			15 01 00 00 00 00 02 93 02
			15 01 00 00 00 00 02 94 D5
			15 01 00 00 00 00 02 95 02
			15 01 00 00 00 00 02 96 F8
			15 01 00 00 00 00 02 97 03
			15 01 00 00 00 00 02 98 25
			15 01 00 00 00 00 02 99 03
			15 01 00 00 00 00 02 9A 46
			15 01 00 00 00 00 02 9B 03
			15 01 00 00 00 00 02 9C 73
			15 01 00 00 00 00 02 9D 03
			15 01 00 00 00 00 02 9E 81
			15 01 00 00 00 00 02 9F 03
			15 01 00 00 00 00 02 A0 90
			15 01 00 00 00 00 02 A2 03
			15 01 00 00 00 00 02 A3 A1
			15 01 00 00 00 00 02 A4 03
			15 01 00 00 00 00 02 A5 B2
			15 01 00 00 00 00 02 A6 03
			15 01 00 00 00 00 02 A7 C6
			15 01 00 00 00 00 02 A9 03
			15 01 00 00 00 00 02 AA DC
			15 01 00 00 00 00 02 AB 03
			15 01 00 00 00 00 02 AC F3
			15 01 00 00 00 00 02 AD 03
			15 01 00 00 00 00 02 AE FF
			//B(-) MCR cmd
			15 01 00 00 00 00 02 AF 01
			15 01 00 00 00 00 02 B0 C0
			15 01 00 00 00 00 02 B1 01
			15 01 00 00 00 00 02 B2 C2
			15 01 00 00 00 00 02 B3 01
			15 01 00 00 00 00 02 B4 C6
			15 01 00 00 00 00 02 B5 01
			15 01 00 00 00 00 02 B6 CA
			15 01 00 00 00 00 02 B7 01
			15 01 00 00 00 00 02 B8 CE
			15 01 00 00 00 00 02 B9 01
			15 01 00 00 00 00 02 BA D2
			15 01 00 00 00 00 02 BB 01
			15 01 00 00 00 00 02 BC D6
			15 01 00 00 00 00 02 BD 01
			15 01 00 00 00 00 02 BE DA
			15 01 00 00 00 00 02 BF 01
			15 01 00 00 00 00 02 C0 DE
			15 01 00 00 00 00 02 C1 01
			15 01 00 00 00 00 02 C2 EC
			15 01 00 00 00 00 02 C3 01
			15 01 00 00 00 00 02 C4 F9
			15 01 00 00 00 00 02 C5 02
			15 01 00 00 00 00 02 C6 11
			15 01 00 00 00 00 02 C7 02
			15 01 00 00 00 00 02 C8 27
			15 01 00 00 00 00 02 C9 02
			15 01 00 00 00 00 02 CA 4F
			15 01 00 00 00 00 02 CB 02
			15 01 00 00 00 00 02 CC 75
			15 01 00 00 00 00 02 CD 02
			15 01 00 00 00 00 02 CE 77
			15 01 00 00 00 00 02 CF 02
			15 01 00 00 00 00 02 D0 A1
			15 01 00 00 00 00 02 D1 02
			15 01 00 00 00 00 02 D2 D5
			15 01 00 00 00 00 02 D3 02
			15 01 00 00 00 00 02 D4 F8
			15 01 00 00 00 00 02 D5 03
			15 01 00 00 00 00 02 D6 25
			15 01 00 00 00 00 02 D7 03
			15 01 00 00 00 00 02 D8 46
			15 01 00 00 00 00 02 D9 03
			15 01 00 00 00 00 02 DA 73
			15 01 00 00 00 00 02 DB 03
			15 01 00 00 00 00 02 DC 81
			15 01 00 00 00 00 02 DD 03
			15 01 00 00 00 00 02 DE 90
			15 01 00 00 00 00 02 DF 03
			15 01 00 00 00 00 02 E0 A1
			15 01 00 00 00 00 02 E1 03
			15 01 00 00 00 00 02 E2 B2
			15 01 00 00 00 00 02 E3 03
			15 01 00 00 00 00 02 E4 C6
			15 01 00 00 00 00 02 E5 03
			15 01 00 00 00 00 02 E6 DC
			15 01 00 00 00 00 02 E7 03
			15 01 00 00 00 00 02 E8 F3
			15 01 00 00 00 00 02 E9 03
			15 01 00 00 00 00 02 EA FF
			//page selection cmd start
			15 01 00 00 00 00 02 FB 01
			15 01 00 00 00 00 02 FF 10
			//page selection cmd end
		];

		qcom,panel-reader-mode-step2-command = [
			//page selection cmd start
			15 00 00 00 00 00 02 FF 20
			//R(+) MCR cmd
			15 00 00 00 00 00 02 75 00
			15 00 00 00 00 00 02 76 00
			15 00 00 00 00 00 02 77 00
			15 00 00 00 00 00 02 78 24
			15 00 00 00 00 00 02 79 00
			15 00 00 00 00 00 02 7A 64
			15 00 00 00 00 00 02 7B 00
			15 00 00 00 00 00 02 7C 8F
			15 00 00 00 00 00 02 7D 00
			15 00 00 00 00 00 02 7E AD
			15 00 00 00 00 00 02 7F 00
			15 00 00 00 00 00 02 80 C7
			15 00 00 00 00 00 02 81 00
			15 00 00 00 00 00 02 82 DE
			15 00 00 00 00 00 02 83 00
			15 00 00 00 00 00 02 84 F2
			15 00 00 00 00 00 02 85 01
			15 00 00 00 00 00 02 86 03
			15 00 00 00 00 00 02 87 01
			15 00 00 00 00 00 02 88 3B
			15 00 00 00 00 00 02 89 01
			15 00 00 00 00 00 02 8A 66
			15 00 00 00 00 00 02 8B 01
			15 00 00 00 00 00 02 8C A2
			15 00 00 00 00 00 02 8D 01
			15 00 00 00 00 00 02 8E CF
			15 00 00 00 00 00 02 8F 02
			15 00 00 00 00 00 02 90 13
			15 00 00 00 00 00 02 91 02
			15 00 00 00 00 00 02 92 48
			15 00 00 00 00 00 02 93 02
			15 00 00 00 00 00 02 94 4A
			15 00 00 00 00 00 02 95 02
			15 00 00 00 00 00 02 96 7D
			15 00 00 00 00 00 02 97 02
			15 00 00 00 00 00 02 98 B6
			15 00 00 00 00 00 02 99 02
			15 00 00 00 00 00 02 9A DA
			15 00 00 00 00 00 02 9B 03
			15 00 00 00 00 00 02 9C 0A
			15 00 00 00 00 00 02 9D 03
			15 00 00 00 00 00 02 9E 2D
			15 00 00 00 00 00 02 9F 03
			15 00 00 00 00 00 02 A0 5F
			15 00 00 00 00 00 02 A2 03
			15 00 00 00 00 00 02 A3 6E
			15 00 00 00 00 00 02 A4 03
			15 00 00 00 00 00 02 A5 7F
			15 00 00 00 00 00 02 A6 03
			15 00 00 00 00 00 02 A7 92
			15 00 00 00 00 00 02 A9 03
			15 00 00 00 00 00 02 AA A6
			15 00 00 00 00 00 02 AB 03
			15 00 00 00 00 00 02 AC BD
			15 00 00 00 00 00 02 AD 03
			15 00 00 00 00 00 02 AE D6
			15 00 00 00 00 00 02 AF 03
			15 00 00 00 00 00 02 B0 F1
			15 00 00 00 00 00 02 B1 03
			15 01 00 00 00 00 02 B2 FF
			//R(-) MCR cmd
			15 00 00 00 00 00 02 B3 00
			15 00 00 00 00 00 02 B4 00
			15 00 00 00 00 00 02 B5 00
			15 00 00 00 00 00 02 B6 24
			15 00 00 00 00 00 02 B7 00
			15 00 00 00 00 00 02 B8 64
			15 00 00 00 00 00 02 B9 00
			15 00 00 00 00 00 02 BA 8F
			15 00 00 00 00 00 02 BB 00
			15 00 00 00 00 00 02 BC AD
			15 00 00 00 00 00 02 BD 00
			15 00 00 00 00 00 02 BE C7
			15 00 00 00 00 00 02 BF 00
			15 00 00 00 00 00 02 C0 DE
			15 00 00 00 00 00 02 C1 00
			15 00 00 00 00 00 02 C2 F2
			15 00 00 00 00 00 02 C3 01
			15 00 00 00 00 00 02 C4 03
			15 00 00 00 00 00 02 C5 01
			15 00 00 00 00 00 02 C6 3B
			15 00 00 00 00 00 02 C7 01
			15 00 00 00 00 00 02 C8 66
			15 00 00 00 00 00 02 C9 01
			15 00 00 00 00 00 02 CA A2
			15 00 00 00 00 00 02 CB 01
			15 00 00 00 00 00 02 CC CF
			15 00 00 00 00 00 02 CD 02
			15 00 00 00 00 00 02 CE 13
			15 00 00 00 00 00 02 CF 02
			15 00 00 00 00 00 02 D0 48
			15 00 00 00 00 00 02 D1 02
			15 00 00 00 00 00 02 D2 4A
			15 00 00 00 00 00 02 D3 02
			15 00 00 00 00 00 02 D4 7D
			15 00 00 00 00 00 02 D5 02
			15 00 00 00 00 00 02 D6 B6
			15 00 00 00 00 00 02 D7 02
			15 00 00 00 00 00 02 D8 DA
			15 00 00 00 00 00 02 D9 03
			15 00 00 00 00 00 02 DA 0A
			15 00 00 00 00 00 02 DB 03
			15 00 00 00 00 00 02 DC 2D
			15 00 00 00 00 00 02 DD 03
			15 00 00 00 00 00 02 DE 5F
			15 00 00 00 00 00 02 DF 03
			15 00 00 00 00 00 02 E0 6E
			15 00 00 00 00 00 02 E1 03
			15 00 00 00 00 00 02 E2 7F
			15 00 00 00 00 00 02 E3 03
			15 00 00 00 00 00 02 E4 92
			15 00 00 00 00 00 02 E5 03
			15 00 00 00 00 00 02 E6 A6
			15 00 00 00 00 00 02 E7 03
			15 00 00 00 00 00 02 E8 BD
			15 00 00 00 00 00 02 E9 03
			15 00 00 00 00 00 02 EA D6
			15 00 00 00 00 00 02 EB 03
			15 00 00 00 00 00 02 EC F1
			15 00 00 00 00 00 02 ED 03
			15 01 00 00 00 00 02 EE FF
			//G(+) MCR cmd
			15 00 00 00 00 00 02 EF 01
			15 00 00 00 00 00 02 F0 1F
			15 00 00 00 00 00 02 F1 01
			15 00 00 00 00 00 02 F2 26
			15 00 00 00 00 00 02 F3 01
			15 00 00 00 00 00 02 F4 33
			15 00 00 00 00 00 02 F5 01
			15 00 00 00 00 00 02 F6 3E
			15 00 00 00 00 00 02 F7 01
			15 00 00 00 00 00 02 F8 49
			15 00 00 00 00 00 02 F9 01
			15 00 00 00 00 00 02 FA 53
			//page selection cmd start
			15 00 00 00 00 00 02 FB 01
			15 00 00 00 00 00 02 FF 21
			//page selection cmd end
			15 00 00 00 00 00 02 00 01
			15 00 00 00 00 00 02 01 5D
			15 00 00 00 00 00 02 02 01
			15 00 00 00 00 00 02 03 66
			15 00 00 00 00 00 02 04 01
			15 00 00 00 00 00 02 05 6E
			15 00 00 00 00 00 02 06 01
			15 00 00 00 00 00 02 07 8C
			15 00 00 00 00 00 02 08 01
			15 00 00 00 00 00 02 09 A6
			15 00 00 00 00 00 02 0A 01
			15 00 00 00 00 00 02 0B D0
			15 00 00 00 00 00 02 0C 01
			15 00 00 00 00 00 02 0D F1
			15 00 00 00 00 00 02 0E 02
			15 00 00 00 00 00 02 0F 29
			15 00 00 00 00 00 02 10 02
			15 00 00 00 00 00 02 11 58
			15 00 00 00 00 00 02 12 02
			15 00 00 00 00 00 02 13 59
			15 00 00 00 00 00 02 14 02
			15 00 00 00 00 00 02 15 88
			15 00 00 00 00 00 02 16 02
			15 00 00 00 00 00 02 17 C0
			15 00 00 00 00 00 02 18 02
			15 00 00 00 00 00 02 19 E4
			15 00 00 00 00 00 02 1A 03
			15 00 00 00 00 00 02 1B 13
			15 00 00 00 00 00 02 1C 03
			15 00 00 00 00 00 02 1D 36
			15 00 00 00 00 00 02 1E 03
			15 00 00 00 00 00 02 1F 65
			15 00 00 00 00 00 02 20 03
			15 00 00 00 00 00 02 21 74
			15 00 00 00 00 00 02 22 03
			15 00 00 00 00 00 02 23 85
			15 00 00 00 00 00 02 24 03
			15 00 00 00 00 00 02 25 97
			15 00 00 00 00 00 02 26 03
			15 00 00 00 00 00 02 27 AA
			15 00 00 00 00 00 02 28 03
			15 00 00 00 00 00 02 29 C0
			15 00 00 00 00 00 02 2A 03
			15 00 00 00 00 00 02 2B D8
			15 00 00 00 00 00 02 2D 03
			15 00 00 00 00 00 02 2F F2
			15 00 00 00 00 00 02 30 03
			15 01 00 00 00 00 02 31 FF
			//G(-) MCR cmd
			15 00 00 00 00 00 02 32 01
			15 00 00 00 00 00 02 33 1F
			15 00 00 00 00 00 02 34 01
			15 00 00 00 00 00 02 35 26
			15 00 00 00 00 00 02 36 01
			15 00 00 00 00 00 02 37 33
			15 00 00 00 00 00 02 38 01
			15 00 00 00 00 00 02 39 3E
			15 00 00 00 00 00 02 3A 01
			15 00 00 00 00 00 02 3B 49
			15 00 00 00 00 00 02 3D 01
			15 00 00 00 00 00 02 3F 53
			15 00 00 00 00 00 02 40 01
			15 00 00 00 00 00 02 41 5D
			15 00 00 00 00 00 02 42 01
			15 00 00 00 00 00 02 43 66
			15 00 00 00 00 00 02 44 01
			15 00 00 00 00 00 02 45 6E
			15 00 00 00 00 00 02 46 01
			15 00 00 00 00 00 02 47 8C
			15 00 00 00 00 00 02 48 01
			15 00 00 00 00 00 02 49 A6
			15 00 00 00 00 00 02 4A 01
			15 00 00 00 00 00 02 4B D0
			15 00 00 00 00 00 02 4C 01
			15 00 00 00 00 00 02 4D F1
			15 00 00 00 00 00 02 4E 02
			15 00 00 00 00 00 02 4F 29
			15 00 00 00 00 00 02 50 02
			15 00 00 00 00 00 02 51 58
			15 00 00 00 00 00 02 52 02
			15 00 00 00 00 00 02 53 59
			15 00 00 00 00 00 02 54 02
			15 00 00 00 00 00 02 55 88
			15 00 00 00 00 00 02 56 02
			15 00 00 00 00 00 02 58 C0
			15 00 00 00 00 00 02 59 02
			15 00 00 00 00 00 02 5A E4
			15 00 00 00 00 00 02 5B 03
			15 00 00 00 00 00 02 5C 13
			15 00 00 00 00 00 02 5D 03
			15 00 00 00 00 00 02 5E 36
			15 00 00 00 00 00 02 5F 03
			15 00 00 00 00 00 02 60 65
			15 00 00 00 00 00 02 61 03
			15 00 00 00 00 00 02 62 74
			15 00 00 00 00 00 02 63 03
			15 00 00 00 00 00 02 64 85
			15 00 00 00 00 00 02 65 03
			15 00 00 00 00 00 02 66 97
			15 00 00 00 00 00 02 67 03
			15 00 00 00 00 00 02 68 AA
			15 00 00 00 00 00 02 69 03
			15 00 00 00 00 00 02 6A C0
			15 00 00 00 00 00 02 6B 03
			15 00 00 00 00 00 02 6C D8
			15 00 00 00 00 00 02 6D 03
			15 00 00 00 00 00 02 6E F2
			15 00 00 00 00 00 02 6F 03
			15 01 00 00 00 00 02 70 FF
			//B(+) MCR cmd
			15 00 00 00 00 00 02 71 01
			15 00 00 00 00 00 02 72 C0
			15 00 00 00 00 00 02 73 01
			15 00 00 00 00 00 02 74 C2
			15 00 00 00 00 00 02 75 01
			15 00 00 00 00 00 02 76 C6
			15 00 00 00 00 00 02 77 01
			15 00 00 00 00 00 02 78 CA
			15 00 00 00 00 00 02 79 01
			15 00 00 00 00 00 02 7A CE
			15 00 00 00 00 00 02 7B 01
			15 00 00 00 00 00 02 7C D2
			15 00 00 00 00 00 02 7D 01
			15 00 00 00 00 00 02 7E D6
			15 00 00 00 00 00 02 7F 01
			15 00 00 00 00 00 02 80 DA
			15 00 00 00 00 00 02 81 01
			15 00 00 00 00 00 02 82 DE
			15 00 00 00 00 00 02 83 01
			15 00 00 00 00 00 02 84 EC
			15 00 00 00 00 00 02 85 01
			15 00 00 00 00 00 02 86 F9
			15 00 00 00 00 00 02 87 02
			15 00 00 00 00 00 02 88 11
			15 00 00 00 00 00 02 89 02
			15 00 00 00 00 00 02 8A 27
			15 00 00 00 00 00 02 8B 02
			15 00 00 00 00 00 02 8C 4F
			15 00 00 00 00 00 02 8D 02
			15 00 00 00 00 00 02 8E 75
			15 00 00 00 00 00 02 8F 02
			15 00 00 00 00 00 02 90 77
			15 00 00 00 00 00 02 91 02
			15 00 00 00 00 00 02 92 A1
			15 00 00 00 00 00 02 93 02
			15 00 00 00 00 00 02 94 D5
			15 00 00 00 00 00 02 95 02
			15 00 00 00 00 00 02 96 F8
			15 00 00 00 00 00 02 97 03
			15 00 00 00 00 00 02 98 25
			15 00 00 00 00 00 02 99 03
			15 00 00 00 00 00 02 9A 46
			15 00 00 00 00 00 02 9B 03
			15 00 00 00 00 00 02 9C 73
			15 00 00 00 00 00 02 9D 03
			15 00 00 00 00 00 02 9E 81
			15 00 00 00 00 00 02 9F 03
			15 00 00 00 00 00 02 A0 90
			15 00 00 00 00 00 02 A2 03
			15 00 00 00 00 00 02 A3 A1
			15 00 00 00 00 00 02 A4 03
			15 00 00 00 00 00 02 A5 B2
			15 00 00 00 00 00 02 A6 03
			15 00 00 00 00 00 02 A7 C6
			15 00 00 00 00 00 02 A9 03
			15 00 00 00 00 00 02 AA DC
			15 00 00 00 00 00 02 AB 03
			15 00 00 00 00 00 02 AC F3
			15 00 00 00 00 00 02 AD 03
			15 01 00 00 00 00 02 AE FF
			//B(-) MCR cmd
			15 00 00 00 00 00 02 AF 01
			15 00 00 00 00 00 02 B0 C0
			15 00 00 00 00 00 02 B1 01
			15 00 00 00 00 00 02 B2 C2
			15 00 00 00 00 00 02 B3 01
			15 00 00 00 00 00 02 B4 C6
			15 00 00 00 00 00 02 B5 01
			15 00 00 00 00 00 02 B6 CA
			15 00 00 00 00 00 02 B7 01
			15 00 00 00 00 00 02 B8 CE
			15 00 00 00 00 00 02 B9 01
			15 00 00 00 00 00 02 BA D2
			15 00 00 00 00 00 02 BB 01
			15 00 00 00 00 00 02 BC D6
			15 00 00 00 00 00 02 BD 01
			15 00 00 00 00 00 02 BE DA
			15 00 00 00 00 00 02 BF 01
			15 00 00 00 00 00 02 C0 DE
			15 00 00 00 00 00 02 C1 01
			15 00 00 00 00 00 02 C2 EC
			15 00 00 00 00 00 02 C3 01
			15 00 00 00 00 00 02 C4 F9
			15 00 00 00 00 00 02 C5 02
			15 00 00 00 00 00 02 C6 11
			15 00 00 00 00 00 02 C7 02
			15 00 00 00 00 00 02 C8 27
			15 00 00 00 00 00 02 C9 02
			15 00 00 00 00 00 02 CA 4F
			15 00 00 00 00 00 02 CB 02
			15 00 00 00 00 00 02 CC 75
			15 00 00 00 00 00 02 CD 02
			15 00 00 00 00 00 02 CE 77
			15 00 00 00 00 00 02 CF 02
			15 00 00 00 00 00 02 D0 A1
			15 00 00 00 00 00 02 D1 02
			15 00 00 00 00 00 02 D2 D5
			15 00 00 00 00 00 02 D3 02
			15 00 00 00 00 00 02 D4 F8
			15 00 00 00 00 00 02 D5 03
			15 00 00 00 00 00 02 D6 25
			15 00 00 00 00 00 02 D7 03
			15 00 00 00 00 00 02 D8 46
			15 00 00 00 00 00 02 D9 03
			15 00 00 00 00 00 02 DA 73
			15 00 00 00 00 00 02 DB 03
			15 00 00 00 00 00 02 DC 81
			15 00 00 00 00 00 02 DD 03
			15 00 00 00 00 00 02 DE 90
			15 00 00 00 00 00 02 DF 03
			15 00 00 00 00 00 02 E0 A1
			15 00 00 00 00 00 02 E1 03
			15 00 00 00 00 00 02 E2 B2
			15 00 00 00 00 00 02 E3 03
			15 00 00 00 00 00 02 E4 C6
			15 00 00 00 00 00 02 E5 03
			15 00 00 00 00 00 02 E6 DC
			15 00 00 00 00 00 02 E7 03
			15 00 00 00 00 00 02 E8 F3
			15 00 00 00 00 00 02 E9 03
			15 00 00 00 00 00 02 EA FF
			//page selection cmd start
			15 00 00 00 00 00 02 FB 01
			15 01 00 00 00 00 02 FF 10
			//page selection cmd end
		];

		qcom,panel-reader-mode-initial-step3-command = [
			//page selection cmd start
			15 01 00 00 00 00 02 FF 20
			//R(+) MCR cmd
			15 01 00 00 00 00 02 75 00
			15 01 00 00 00 00 02 76 00
			15 01 00 00 00 00 02 77 00
			15 01 00 00 00 00 02 78 24
			15 01 00 00 00 00 02 79 00
			15 01 00 00 00 00 02 7A 64
			15 01 00 00 00 00 02 7B 00
			15 01 00 00 00 00 02 7C 8F
			15 01 00 00 00 00 02 7D 00
			15 01 00 00 00 00 02 7E AD
			15 01 00 00 00 00 02 7F 00
			15 01 00 00 00 00 02 80 C7
			15 01 00 00 00 00 02 81 00
			15 01 00 00 00 00 02 82 DE
			15 01 00 00 00 00 02 83 00
			15 01 00 00 00 00 02 84 F2
			15 01 00 00 00 00 02 85 01
			15 01 00 00 00 00 02 86 03
			15 01 00 00 00 00 02 87 01
			15 01 00 00 00 00 02 88 3B
			15 01 00 00 00 00 02 89 01
			15 01 00 00 00 00 02 8A 66
			15 01 00 00 00 00 02 8B 01
			15 01 00 00 00 00 02 8C A2
			15 01 00 00 00 00 02 8D 01
			15 01 00 00 00 00 02 8E CF
			15 01 00 00 00 00 02 8F 02
			15 01 00 00 00 00 02 90 13
			15 01 00 00 00 00 02 91 02
			15 01 00 00 00 00 02 92 48
			15 01 00 00 00 00 02 93 02
			15 01 00 00 00 00 02 94 4A
			15 01 00 00 00 00 02 95 02
			15 01 00 00 00 00 02 96 7D
			15 01 00 00 00 00 02 97 02
			15 01 00 00 00 00 02 98 B6
			15 01 00 00 00 00 02 99 02
			15 01 00 00 00 00 02 9A DA
			15 01 00 00 00 00 02 9B 03
			15 01 00 00 00 00 02 9C 0A
			15 01 00 00 00 00 02 9D 03
			15 01 00 00 00 00 02 9E 2D
			15 01 00 00 00 00 02 9F 03
			15 01 00 00 00 00 02 A0 5F
			15 01 00 00 00 00 02 A2 03
			15 01 00 00 00 00 02 A3 6E
			15 01 00 00 00 00 02 A4 03
			15 01 00 00 00 00 02 A5 7F
			15 01 00 00 00 00 02 A6 03
			15 01 00 00 00 00 02 A7 92
			15 01 00 00 00 00 02 A9 03
			15 01 00 00 00 00 02 AA A6
			15 01 00 00 00 00 02 AB 03
			15 01 00 00 00 00 02 AC BD
			15 01 00 00 00 00 02 AD 03
			15 01 00 00 00 00 02 AE D6
			15 01 00 00 00 00 02 AF 03
			15 01 00 00 00 00 02 B0 F1
			15 01 00 00 00 00 02 B1 03
			15 01 00 00 00 00 02 B2 FF
			//R(-) MCR cmd
			15 01 00 00 00 00 02 B3 00
			15 01 00 00 00 00 02 B4 00
			15 01 00 00 00 00 02 B5 00
			15 01 00 00 00 00 02 B6 24
			15 01 00 00 00 00 02 B7 00
			15 01 00 00 00 00 02 B8 64
			15 01 00 00 00 00 02 B9 00
			15 01 00 00 00 00 02 BA 8F
			15 01 00 00 00 00 02 BB 00
			15 01 00 00 00 00 02 BC AD
			15 01 00 00 00 00 02 BD 00
			15 01 00 00 00 00 02 BE C7
			15 01 00 00 00 00 02 BF 00
			15 01 00 00 00 00 02 C0 DE
			15 01 00 00 00 00 02 C1 00
			15 01 00 00 00 00 02 C2 F2
			15 01 00 00 00 00 02 C3 01
			15 01 00 00 00 00 02 C4 03
			15 01 00 00 00 00 02 C5 01
			15 01 00 00 00 00 02 C6 3B
			15 01 00 00 00 00 02 C7 01
			15 01 00 00 00 00 02 C8 66
			15 01 00 00 00 00 02 C9 01
			15 01 00 00 00 00 02 CA A2
			15 01 00 00 00 00 02 CB 01
			15 01 00 00 00 00 02 CC CF
			15 01 00 00 00 00 02 CD 02
			15 01 00 00 00 00 02 CE 13
			15 01 00 00 00 00 02 CF 02
			15 01 00 00 00 00 02 D0 48
			15 01 00 00 00 00 02 D1 02
			15 01 00 00 00 00 02 D2 4A
			15 01 00 00 00 00 02 D3 02
			15 01 00 00 00 00 02 D4 7D
			15 01 00 00 00 00 02 D5 02
			15 01 00 00 00 00 02 D6 B6
			15 01 00 00 00 00 02 D7 02
			15 01 00 00 00 00 02 D8 DA
			15 01 00 00 00 00 02 D9 03
			15 01 00 00 00 00 02 DA 0A
			15 01 00 00 00 00 02 DB 03
			15 01 00 00 00 00 02 DC 2D
			15 01 00 00 00 00 02 DD 03
			15 01 00 00 00 00 02 DE 5F
			15 01 00 00 00 00 02 DF 03
			15 01 00 00 00 00 02 E0 6E
			15 01 00 00 00 00 02 E1 03
			15 01 00 00 00 00 02 E2 7F
			15 01 00 00 00 00 02 E3 03
			15 01 00 00 00 00 02 E4 92
			15 01 00 00 00 00 02 E5 03
			15 01 00 00 00 00 02 E6 A6
			15 01 00 00 00 00 02 E7 03
			15 01 00 00 00 00 02 E8 BD
			15 01 00 00 00 00 02 E9 03
			15 01 00 00 00 00 02 EA D6
			15 01 00 00 00 00 02 EB 03
			15 01 00 00 00 00 02 EC F1
			15 01 00 00 00 00 02 ED 03
			15 01 00 00 00 00 02 EE FF
			//G(+) MCR cmd
			15 01 00 00 00 00 02 EF 01
			15 01 00 00 00 00 02 F0 48
			15 01 00 00 00 00 02 F1 01
			15 01 00 00 00 00 02 F2 4D
			15 01 00 00 00 00 02 F3 01
			15 01 00 00 00 00 02 F4 57
			15 01 00 00 00 00 02 F5 01
			15 01 00 00 00 00 02 F6 60
			15 01 00 00 00 00 02 F7 01
			15 01 00 00 00 00 02 F8 68
			15 01 00 00 00 00 02 F9 01
			15 01 00 00 00 00 02 FA 70
			//page selection cmd start
			15 01 00 00 00 00 02 FB 01
			15 01 00 00 00 00 02 FF 21
			//page selection cmd end
			15 01 00 00 00 00 02 00 01
			15 01 00 00 00 00 02 01 78
			15 01 00 00 00 00 02 02 01
			15 01 00 00 00 00 02 03 7F
			15 01 00 00 00 00 02 04 01
			15 01 00 00 00 00 02 05 86
			15 01 00 00 00 00 02 06 01
			15 01 00 00 00 00 02 07 A0
			15 01 00 00 00 00 02 08 01
			15 01 00 00 00 00 02 09 B6
			15 01 00 00 00 00 02 0A 01
			15 01 00 00 00 00 02 0B DC
			15 01 00 00 00 00 02 0C 01
			15 01 00 00 00 00 02 0D FB
			15 01 00 00 00 00 02 0E 02
			15 01 00 00 00 00 02 0F 30
			15 01 00 00 00 00 02 10 02
			15 01 00 00 00 00 02 11 5D
			15 01 00 00 00 00 02 12 02
			15 01 00 00 00 00 02 13 5E
			15 01 00 00 00 00 02 14 02
			15 01 00 00 00 00 02 15 8C
			15 01 00 00 00 00 02 16 02
			15 01 00 00 00 00 02 17 C3
			15 01 00 00 00 00 02 18 02
			15 01 00 00 00 00 02 19 E7
			15 01 00 00 00 00 02 1A 03
			15 01 00 00 00 00 02 1B 16
			15 01 00 00 00 00 02 1C 03
			15 01 00 00 00 00 02 1D 38
			15 01 00 00 00 00 02 1E 03
			15 01 00 00 00 00 02 1F 68
			15 01 00 00 00 00 02 20 03
			15 01 00 00 00 00 02 21 77
			15 01 00 00 00 00 02 22 03
			15 01 00 00 00 00 02 23 87
			15 01 00 00 00 00 02 24 03
			15 01 00 00 00 00 02 25 99
			15 01 00 00 00 00 02 26 03
			15 01 00 00 00 00 02 27 AC
			15 01 00 00 00 00 02 28 03
			15 01 00 00 00 00 02 29 C1
			15 01 00 00 00 00 02 2A 03
			15 01 00 00 00 00 02 2B D8
			15 01 00 00 00 00 02 2D 03
			15 01 00 00 00 00 02 2F F2
			15 01 00 00 00 00 02 30 03
			15 01 00 00 00 00 02 31 FF
			//G(-) MCR cmd
			15 01 00 00 00 00 02 32 01
			15 01 00 00 00 00 02 33 48
			15 01 00 00 00 00 02 34 01
			15 01 00 00 00 00 02 35 4D
			15 01 00 00 00 00 02 36 01
			15 01 00 00 00 00 02 37 57
			15 01 00 00 00 00 02 38 01
			15 01 00 00 00 00 02 39 60
			15 01 00 00 00 00 02 3A 01
			15 01 00 00 00 00 02 3B 68
			15 01 00 00 00 00 02 3D 01
			15 01 00 00 00 00 02 3F 70
			15 01 00 00 00 00 02 40 01
			15 01 00 00 00 00 02 41 78
			15 01 00 00 00 00 02 42 01
			15 01 00 00 00 00 02 43 7F
			15 01 00 00 00 00 02 44 01
			15 01 00 00 00 00 02 45 86
			15 01 00 00 00 00 02 46 01
			15 01 00 00 00 00 02 47 A0
			15 01 00 00 00 00 02 48 01
			15 01 00 00 00 00 02 49 B6
			15 01 00 00 00 00 02 4A 01
			15 01 00 00 00 00 02 4B DC
			15 01 00 00 00 00 02 4C 01
			15 01 00 00 00 00 02 4D FB
			15 01 00 00 00 00 02 4E 02
			15 01 00 00 00 00 02 4F 30
			15 01 00 00 00 00 02 50 02
			15 01 00 00 00 00 02 51 5D
			15 01 00 00 00 00 02 52 02
			15 01 00 00 00 00 02 53 5E
			15 01 00 00 00 00 02 54 02
			15 01 00 00 00 00 02 55 8C
			15 01 00 00 00 00 02 56 02
			15 01 00 00 00 00 02 58 C3
			15 01 00 00 00 00 02 59 02
			15 01 00 00 00 00 02 5A E7
			15 01 00 00 00 00 02 5B 03
			15 01 00 00 00 00 02 5C 16
			15 01 00 00 00 00 02 5D 03
			15 01 00 00 00 00 02 5E 38
			15 01 00 00 00 00 02 5F 03
			15 01 00 00 00 00 02 60 68
			15 01 00 00 00 00 02 61 03
			15 01 00 00 00 00 02 62 77
			15 01 00 00 00 00 02 63 03
			15 01 00 00 00 00 02 64 87
			15 01 00 00 00 00 02 65 03
			15 01 00 00 00 00 02 66 99
			15 01 00 00 00 00 02 67 03
			15 01 00 00 00 00 02 68 AC
			15 01 00 00 00 00 02 69 03
			15 01 00 00 00 00 02 6A C1
			15 01 00 00 00 00 02 6B 03
			15 01 00 00 00 00 02 6C D8
			15 01 00 00 00 00 02 6D 03
			15 01 00 00 00 00 02 6E F2
			15 01 00 00 00 00 02 6F 03
			15 01 00 00 00 00 02 70 FF
			//B(+) MCR cmd
			15 01 00 00 00 00 02 71 01
			15 01 00 00 00 00 02 72 E1
			15 01 00 00 00 00 02 73 01
			15 01 00 00 00 00 02 74 E3
			15 01 00 00 00 00 02 75 01
			15 01 00 00 00 00 02 76 E6
			15 01 00 00 00 00 02 77 01
			15 01 00 00 00 00 02 78 EA
			15 01 00 00 00 00 02 79 01
			15 01 00 00 00 00 02 7A ED
			15 01 00 00 00 00 02 7B 01
			15 01 00 00 00 00 02 7C F0
			15 01 00 00 00 00 02 7D 01
			15 01 00 00 00 00 02 7E F3
			15 01 00 00 00 00 02 7F 01
			15 01 00 00 00 00 02 80 F6
			15 01 00 00 00 00 02 81 01
			15 01 00 00 00 00 02 82 F9
			15 01 00 00 00 00 02 83 02
			15 01 00 00 00 00 02 84 04
			15 01 00 00 00 00 02 85 02
			15 01 00 00 00 00 02 86 10
			15 01 00 00 00 00 02 87 02
			15 01 00 00 00 00 02 88 24
			15 01 00 00 00 00 02 89 02
			15 01 00 00 00 00 02 8A 37
			15 01 00 00 00 00 02 8B 02
			15 01 00 00 00 00 02 8C 5B
			15 01 00 00 00 00 02 8D 02
			15 01 00 00 00 00 02 8E 80
			15 01 00 00 00 00 02 8F 02
			15 01 00 00 00 00 02 90 81
			15 01 00 00 00 00 02 91 02
			15 01 00 00 00 00 02 92 AA
			15 01 00 00 00 00 02 93 02
			15 01 00 00 00 00 02 94 DE
			15 01 00 00 00 00 02 95 02
			15 01 00 00 00 00 02 96 FF
			15 01 00 00 00 00 02 97 03
			15 01 00 00 00 00 02 98 2C
			15 01 00 00 00 00 02 99 03
			15 01 00 00 00 00 02 9A 4B
			15 01 00 00 00 00 02 9B 03
			15 01 00 00 00 00 02 9C 75
			15 01 00 00 00 00 02 9D 03
			15 01 00 00 00 00 02 9E 83
			15 01 00 00 00 00 02 9F 03
			15 01 00 00 00 00 02 A0 91
			15 01 00 00 00 00 02 A2 03
			15 01 00 00 00 00 02 A3 A2
			15 01 00 00 00 00 02 A4 03
			15 01 00 00 00 00 02 A5 B3
			15 01 00 00 00 00 02 A6 03
			15 01 00 00 00 00 02 A7 C6
			15 01 00 00 00 00 02 A9 03
			15 01 00 00 00 00 02 AA DC
			15 01 00 00 00 00 02 AB 03
			15 01 00 00 00 00 02 AC F3
			15 01 00 00 00 00 02 AD 03
			15 01 00 00 00 00 02 AE FF
			//B(-) MCR cmd
			15 01 00 00 00 00 02 AF 01
			15 01 00 00 00 00 02 B0 E1
			15 01 00 00 00 00 02 B1 01
			15 01 00 00 00 00 02 B2 E3
			15 01 00 00 00 00 02 B3 01
			15 01 00 00 00 00 02 B4 E6
			15 01 00 00 00 00 02 B5 01
			15 01 00 00 00 00 02 B6 EA
			15 01 00 00 00 00 02 B7 01
			15 01 00 00 00 00 02 B8 ED
			15 01 00 00 00 00 02 B9 01
			15 01 00 00 00 00 02 BA F0
			15 01 00 00 00 00 02 BB 01
			15 01 00 00 00 00 02 BC F3
			15 01 00 00 00 00 02 BD 01
			15 01 00 00 00 00 02 BE F6
			15 01 00 00 00 00 02 BF 01
			15 01 00 00 00 00 02 C0 F9
			15 01 00 00 00 00 02 C1 02
			15 01 00 00 00 00 02 C2 04
			15 01 00 00 00 00 02 C3 02
			15 01 00 00 00 00 02 C4 10
			15 01 00 00 00 00 02 C5 02
			15 01 00 00 00 00 02 C6 24
			15 01 00 00 00 00 02 C7 02
			15 01 00 00 00 00 02 C8 37
			15 01 00 00 00 00 02 C9 02
			15 01 00 00 00 00 02 CA 5B
			15 01 00 00 00 00 02 CB 02
			15 01 00 00 00 00 02 CC 80
			15 01 00 00 00 00 02 CD 02
			15 01 00 00 00 00 02 CE 81
			15 01 00 00 00 00 02 CF 02
			15 01 00 00 00 00 02 D0 AA
			15 01 00 00 00 00 02 D1 02
			15 01 00 00 00 00 02 D2 DE
			15 01 00 00 00 00 02 D3 02
			15 01 00 00 00 00 02 D4 FF
			15 01 00 00 00 00 02 D5 03
			15 01 00 00 00 00 02 D6 2C
			15 01 00 00 00 00 02 D7 03
			15 01 00 00 00 00 02 D8 4B
			15 01 00 00 00 00 02 D9 03
			15 01 00 00 00 00 02 DA 75
			15 01 00 00 00 00 02 DB 03
			15 01 00 00 00 00 02 DC 83
			15 01 00 00 00 00 02 DD 03
			15 01 00 00 00 00 02 DE 91
			15 01 00 00 00 00 02 DF 03
			15 01 00 00 00 00 02 E0 A2
			15 01 00 00 00 00 02 E1 03
			15 01 00 00 00 00 02 E2 B3
			15 01 00 00 00 00 02 E3 03
			15 01 00 00 00 00 02 E4 C6
			15 01 00 00 00 00 02 E5 03
			15 01 00 00 00 00 02 E6 DC
			15 01 00 00 00 00 02 E7 03
			15 01 00 00 00 00 02 E8 F3
			15 01 00 00 00 00 02 E9 03
			15 01 00 00 00 00 02 EA FF
			//page selection cmd start
			15 01 00 00 00 00 02 FB 01
			15 01 00 00 00 00 02 FF 10
			//page selection cmd end
		];
		qcom,panel-reader-mode-step3-command = [
			//page selection cmd start
			15 00 00 00 00 00 02 FF 20
			//R(+) MCR cmd
			15 00 00 00 00 00 02 75 00
			15 00 00 00 00 00 02 76 00
			15 00 00 00 00 00 02 77 00
			15 00 00 00 00 00 02 78 24
			15 00 00 00 00 00 02 79 00
			15 00 00 00 00 00 02 7A 64
			15 00 00 00 00 00 02 7B 00
			15 00 00 00 00 00 02 7C 8F
			15 00 00 00 00 00 02 7D 00
			15 00 00 00 00 00 02 7E AD
			15 00 00 00 00 00 02 7F 00
			15 00 00 00 00 00 02 80 C7
			15 00 00 00 00 00 02 81 00
			15 00 00 00 00 00 02 82 DE
			15 00 00 00 00 00 02 83 00
			15 00 00 00 00 00 02 84 F2
			15 00 00 00 00 00 02 85 01
			15 00 00 00 00 00 02 86 03
			15 00 00 00 00 00 02 87 01
			15 00 00 00 00 00 02 88 3B
			15 00 00 00 00 00 02 89 01
			15 00 00 00 00 00 02 8A 66
			15 00 00 00 00 00 02 8B 01
			15 00 00 00 00 00 02 8C A2
			15 00 00 00 00 00 02 8D 01
			15 00 00 00 00 00 02 8E CF
			15 00 00 00 00 00 02 8F 02
			15 00 00 00 00 00 02 90 13
			15 00 00 00 00 00 02 91 02
			15 00 00 00 00 00 02 92 48
			15 00 00 00 00 00 02 93 02
			15 00 00 00 00 00 02 94 4A
			15 00 00 00 00 00 02 95 02
			15 00 00 00 00 00 02 96 7D
			15 00 00 00 00 00 02 97 02
			15 00 00 00 00 00 02 98 B6
			15 00 00 00 00 00 02 99 02
			15 00 00 00 00 00 02 9A DA
			15 00 00 00 00 00 02 9B 03
			15 00 00 00 00 00 02 9C 0A
			15 00 00 00 00 00 02 9D 03
			15 00 00 00 00 00 02 9E 2D
			15 00 00 00 00 00 02 9F 03
			15 00 00 00 00 00 02 A0 5F
			15 00 00 00 00 00 02 A2 03
			15 00 00 00 00 00 02 A3 6E
			15 00 00 00 00 00 02 A4 03
			15 00 00 00 00 00 02 A5 7F
			15 00 00 00 00 00 02 A6 03
			15 00 00 00 00 00 02 A7 92
			15 00 00 00 00 00 02 A9 03
			15 00 00 00 00 00 02 AA A6
			15 00 00 00 00 00 02 AB 03
			15 00 00 00 00 00 02 AC BD
			15 00 00 00 00 00 02 AD 03
			15 00 00 00 00 00 02 AE D6
			15 00 00 00 00 00 02 AF 03
			15 00 00 00 00 00 02 B0 F1
			15 00 00 00 00 00 02 B1 03
			15 01 00 00 00 00 02 B2 FF
			//R(-) MCR cmd
			15 00 00 00 00 00 02 B3 00
			15 00 00 00 00 00 02 B4 00
			15 00 00 00 00 00 02 B5 00
			15 00 00 00 00 00 02 B6 24
			15 00 00 00 00 00 02 B7 00
			15 00 00 00 00 00 02 B8 64
			15 00 00 00 00 00 02 B9 00
			15 00 00 00 00 00 02 BA 8F
			15 00 00 00 00 00 02 BB 00
			15 00 00 00 00 00 02 BC AD
			15 00 00 00 00 00 02 BD 00
			15 00 00 00 00 00 02 BE C7
			15 00 00 00 00 00 02 BF 00
			15 00 00 00 00 00 02 C0 DE
			15 00 00 00 00 00 02 C1 00
			15 00 00 00 00 00 02 C2 F2
			15 00 00 00 00 00 02 C3 01
			15 00 00 00 00 00 02 C4 03
			15 00 00 00 00 00 02 C5 01
			15 00 00 00 00 00 02 C6 3B
			15 00 00 00 00 00 02 C7 01
			15 00 00 00 00 00 02 C8 66
			15 00 00 00 00 00 02 C9 01
			15 00 00 00 00 00 02 CA A2
			15 00 00 00 00 00 02 CB 01
			15 00 00 00 00 00 02 CC CF
			15 00 00 00 00 00 02 CD 02
			15 00 00 00 00 00 02 CE 13
			15 00 00 00 00 00 02 CF 02
			15 00 00 00 00 00 02 D0 48
			15 00 00 00 00 00 02 D1 02
			15 00 00 00 00 00 02 D2 4A
			15 00 00 00 00 00 02 D3 02
			15 00 00 00 00 00 02 D4 7D
			15 00 00 00 00 00 02 D5 02
			15 00 00 00 00 00 02 D6 B6
			15 00 00 00 00 00 02 D7 02
			15 00 00 00 00 00 02 D8 DA
			15 00 00 00 00 00 02 D9 03
			15 00 00 00 00 00 02 DA 0A
			15 00 00 00 00 00 02 DB 03
			15 00 00 00 00 00 02 DC 2D
			15 00 00 00 00 00 02 DD 03
			15 00 00 00 00 00 02 DE 5F
			15 00 00 00 00 00 02 DF 03
			15 00 00 00 00 00 02 E0 6E
			15 00 00 00 00 00 02 E1 03
			15 00 00 00 00 00 02 E2 7F
			15 00 00 00 00 00 02 E3 03
			15 00 00 00 00 00 02 E4 92
			15 00 00 00 00 00 02 E5 03
			15 00 00 00 00 00 02 E6 A6
			15 00 00 00 00 00 02 E7 03
			15 00 00 00 00 00 02 E8 BD
			15 00 00 00 00 00 02 E9 03
			15 00 00 00 00 00 02 EA D6
			15 00 00 00 00 00 02 EB 03
			15 00 00 00 00 00 02 EC F1
			15 00 00 00 00 00 02 ED 03
			15 01 00 00 00 00 02 EE FF
			//G(+) MCR cmd
			15 00 00 00 00 00 02 EF 01
			15 00 00 00 00 00 02 F0 48
			15 00 00 00 00 00 02 F1 01
			15 00 00 00 00 00 02 F2 4D
			15 00 00 00 00 00 02 F3 01
			15 00 00 00 00 00 02 F4 57
			15 00 00 00 00 00 02 F5 01
			15 00 00 00 00 00 02 F6 60
			15 00 00 00 00 00 02 F7 01
			15 00 00 00 00 00 02 F8 68
			15 00 00 00 00 00 02 F9 01
			15 00 00 00 00 00 02 FA 70
			//page selection cmd start
			15 00 00 00 00 00 02 FB 01
			15 00 00 00 00 00 02 FF 21
			//page selection cmd end
			15 00 00 00 00 00 02 00 01
			15 00 00 00 00 00 02 01 78
			15 00 00 00 00 00 02 02 01
			15 00 00 00 00 00 02 03 7F
			15 00 00 00 00 00 02 04 01
			15 00 00 00 00 00 02 05 86
			15 00 00 00 00 00 02 06 01
			15 00 00 00 00 00 02 07 A0
			15 00 00 00 00 00 02 08 01
			15 00 00 00 00 00 02 09 B6
			15 00 00 00 00 00 02 0A 01
			15 00 00 00 00 00 02 0B DC
			15 00 00 00 00 00 02 0C 01
			15 00 00 00 00 00 02 0D FB
			15 00 00 00 00 00 02 0E 02
			15 00 00 00 00 00 02 0F 30
			15 00 00 00 00 00 02 10 02
			15 00 00 00 00 00 02 11 5D
			15 00 00 00 00 00 02 12 02
			15 00 00 00 00 00 02 13 5E
			15 00 00 00 00 00 02 14 02
			15 00 00 00 00 00 02 15 8C
			15 00 00 00 00 00 02 16 02
			15 00 00 00 00 00 02 17 C3
			15 00 00 00 00 00 02 18 02
			15 00 00 00 00 00 02 19 E7
			15 00 00 00 00 00 02 1A 03
			15 00 00 00 00 00 02 1B 16
			15 00 00 00 00 00 02 1C 03
			15 00 00 00 00 00 02 1D 38
			15 00 00 00 00 00 02 1E 03
			15 00 00 00 00 00 02 1F 68
			15 00 00 00 00 00 02 20 03
			15 00 00 00 00 00 02 21 77
			15 00 00 00 00 00 02 22 03
			15 00 00 00 00 00 02 23 87
			15 00 00 00 00 00 02 24 03
			15 00 00 00 00 00 02 25 99
			15 00 00 00 00 00 02 26 03
			15 00 00 00 00 00 02 27 AC
			15 00 00 00 00 00 02 28 03
			15 00 00 00 00 00 02 29 C1
			15 00 00 00 00 00 02 2A 03
			15 00 00 00 00 00 02 2B D8
			15 00 00 00 00 00 02 2D 03
			15 00 00 00 00 00 02 2F F2
			15 00 00 00 00 00 02 30 03
			15 01 00 00 00 00 02 31 FF
			//G(-) MCR cmd
			15 00 00 00 00 00 02 32 01
			15 00 00 00 00 00 02 33 48
			15 00 00 00 00 00 02 34 01
			15 00 00 00 00 00 02 35 4D
			15 00 00 00 00 00 02 36 01
			15 00 00 00 00 00 02 37 57
			15 00 00 00 00 00 02 38 01
			15 00 00 00 00 00 02 39 60
			15 00 00 00 00 00 02 3A 01
			15 00 00 00 00 00 02 3B 68
			15 00 00 00 00 00 02 3D 01
			15 00 00 00 00 00 02 3F 70
			15 00 00 00 00 00 02 40 01
			15 00 00 00 00 00 02 41 78
			15 00 00 00 00 00 02 42 01
			15 00 00 00 00 00 02 43 7F
			15 00 00 00 00 00 02 44 01
			15 00 00 00 00 00 02 45 86
			15 00 00 00 00 00 02 46 01
			15 00 00 00 00 00 02 47 A0
			15 00 00 00 00 00 02 48 01
			15 00 00 00 00 00 02 49 B6
			15 00 00 00 00 00 02 4A 01
			15 00 00 00 00 00 02 4B DC
			15 00 00 00 00 00 02 4C 01
			15 00 00 00 00 00 02 4D FB
			15 00 00 00 00 00 02 4E 02
			15 00 00 00 00 00 02 4F 30
			15 00 00 00 00 00 02 50 02
			15 00 00 00 00 00 02 51 5D
			15 00 00 00 00 00 02 52 02
			15 00 00 00 00 00 02 53 5E
			15 00 00 00 00 00 02 54 02
			15 00 00 00 00 00 02 55 8C
			15 00 00 00 00 00 02 56 02
			15 00 00 00 00 00 02 58 C3
			15 00 00 00 00 00 02 59 02
			15 00 00 00 00 00 02 5A E7
			15 00 00 00 00 00 02 5B 03
			15 00 00 00 00 00 02 5C 16
			15 00 00 00 00 00 02 5D 03
			15 00 00 00 00 00 02 5E 38
			15 00 00 00 00 00 02 5F 03
			15 00 00 00 00 00 02 60 68
			15 00 00 00 00 00 02 61 03
			15 00 00 00 00 00 02 62 77
			15 00 00 00 00 00 02 63 03
			15 00 00 00 00 00 02 64 87
			15 00 00 00 00 00 02 65 03
			15 00 00 00 00 00 02 66 99
			15 00 00 00 00 00 02 67 03
			15 00 00 00 00 00 02 68 AC
			15 00 00 00 00 00 02 69 03
			15 00 00 00 00 00 02 6A C1
			15 00 00 00 00 00 02 6B 03
			15 00 00 00 00 00 02 6C D8
			15 00 00 00 00 00 02 6D 03
			15 00 00 00 00 00 02 6E F2
			15 00 00 00 00 00 02 6F 03
			15 01 00 00 00 00 02 70 FF
			//B(+) MCR cmd
			15 00 00 00 00 00 02 71 01
			15 00 00 00 00 00 02 72 E1
			15 00 00 00 00 00 02 73 01
			15 00 00 00 00 00 02 74 E3
			15 00 00 00 00 00 02 75 01
			15 00 00 00 00 00 02 76 E6
			15 00 00 00 00 00 02 77 01
			15 00 00 00 00 00 02 78 EA
			15 00 00 00 00 00 02 79 01
			15 00 00 00 00 00 02 7A ED
			15 00 00 00 00 00 02 7B 01
			15 00 00 00 00 00 02 7C F0
			15 00 00 00 00 00 02 7D 01
			15 00 00 00 00 00 02 7E F3
			15 00 00 00 00 00 02 7F 01
			15 00 00 00 00 00 02 80 F6
			15 00 00 00 00 00 02 81 01
			15 00 00 00 00 00 02 82 F9
			15 00 00 00 00 00 02 83 02
			15 00 00 00 00 00 02 84 04
			15 00 00 00 00 00 02 85 02
			15 00 00 00 00 00 02 86 10
			15 00 00 00 00 00 02 87 02
			15 00 00 00 00 00 02 88 24
			15 00 00 00 00 00 02 89 02
			15 00 00 00 00 00 02 8A 37
			15 00 00 00 00 00 02 8B 02
			15 00 00 00 00 00 02 8C 5B
			15 00 00 00 00 00 02 8D 02
			15 00 00 00 00 00 02 8E 80
			15 00 00 00 00 00 02 8F 02
			15 00 00 00 00 00 02 90 81
			15 00 00 00 00 00 02 91 02
			15 00 00 00 00 00 02 92 AA
			15 00 00 00 00 00 02 93 02
			15 00 00 00 00 00 02 94 DE
			15 00 00 00 00 00 02 95 02
			15 00 00 00 00 00 02 96 FF
			15 00 00 00 00 00 02 97 03
			15 00 00 00 00 00 02 98 2C
			15 00 00 00 00 00 02 99 03
			15 00 00 00 00 00 02 9A 4B
			15 00 00 00 00 00 02 9B 03
			15 00 00 00 00 00 02 9C 75
			15 00 00 00 00 00 02 9D 03
			15 00 00 00 00 00 02 9E 83
			15 00 00 00 00 00 02 9F 03
			15 00 00 00 00 00 02 A0 91
			15 00 00 00 00 00 02 A2 03
			15 00 00 00 00 00 02 A3 A2
			15 00 00 00 00 00 02 A4 03
			15 00 00 00 00 00 02 A5 B3
			15 00 00 00 00 00 02 A6 03
			15 00 00 00 00 00 02 A7 C6
			15 00 00 00 00 00 02 A9 03
			15 00 00 00 00 00 02 AA DC
			15 00 00 00 00 00 02 AB 03
			15 00 00 00 00 00 02 AC F3
			15 00 00 00 00 00 02 AD 03
			15 01 00 00 00 00 02 AE FF
			//B(-) MCR cmd
			15 00 00 00 00 00 02 AF 01
			15 00 00 00 00 00 02 B0 E1
			15 00 00 00 00 00 02 B1 01
			15 00 00 00 00 00 02 B2 E3
			15 00 00 00 00 00 02 B3 01
			15 00 00 00 00 00 02 B4 E6
			15 00 00 00 00 00 02 B5 01
			15 00 00 00 00 00 02 B6 EA
			15 00 00 00 00 00 02 B7 01
			15 00 00 00 00 00 02 B8 ED
			15 00 00 00 00 00 02 B9 01
			15 00 00 00 00 00 02 BA F0
			15 00 00 00 00 00 02 BB 01
			15 00 00 00 00 00 02 BC F3
			15 00 00 00 00 00 02 BD 01
			15 00 00 00 00 00 02 BE F6
			15 00 00 00 00 00 02 BF 01
			15 00 00 00 00 00 02 C0 F9
			15 00 00 00 00 00 02 C1 02
			15 00 00 00 00 00 02 C2 04
			15 00 00 00 00 00 02 C3 02
			15 00 00 00 00 00 02 C4 10
			15 00 00 00 00 00 02 C5 02
			15 00 00 00 00 00 02 C6 24
			15 00 00 00 00 00 02 C7 02
			15 00 00 00 00 00 02 C8 37
			15 00 00 00 00 00 02 C9 02
			15 00 00 00 00 00 02 CA 5B
			15 00 00 00 00 00 02 CB 02
			15 00 00 00 00 00 02 CC 80
			15 00 00 00 00 00 02 CD 02
			15 00 00 00 00 00 02 CE 81
			15 00 00 00 00 00 02 CF 02
			15 00 00 00 00 00 02 D0 AA
			15 00 00 00 00 00 02 D1 02
			15 00 00 00 00 00 02 D2 DE
			15 00 00 00 00 00 02 D3 02
			15 00 00 00 00 00 02 D4 FF
			15 00 00 00 00 00 02 D5 03
			15 00 00 00 00 00 02 D6 2C
			15 00 00 00 00 00 02 D7 03
			15 00 00 00 00 00 02 D8 4B
			15 00 00 00 00 00 02 D9 03
			15 00 00 00 00 00 02 DA 75
			15 00 00 00 00 00 02 DB 03
			15 00 00 00 00 00 02 DC 83
			15 00 00 00 00 00 02 DD 03
			15 00 00 00 00 00 02 DE 91
			15 00 00 00 00 00 02 DF 03
			15 00 00 00 00 00 02 E0 A2
			15 00 00 00 00 00 02 E1 03
			15 00 00 00 00 00 02 E2 B3
			15 00 00 00 00 00 02 E3 03
			15 00 00 00 00 00 02 E4 C6
			15 00 00 00 00 00 02 E5 03
			15 00 00 00 00 00 02 E6 DC
			15 00 00 00 00 00 02 E7 03
			15 00 00 00 00 00 02 E8 F3
			15 00 00 00 00 00 02 E9 03
			15 00 00 00 00 00 02 EA FF
			//page selection cmd start
			15 00 00 00 00 00 02 FB 01
			15 01 00 00 00 00 02 FF 10
			//page selection cmd end
		];

		qcom,panel-reader-mode-off-command  = [
			//page selection cmd start
			15 00 00 00 00 00 02 FF	20
			//R(+) MCR cmd
			15 00 00 00 00 00 02 75	00
			15 00 00 00 00 00 02 76	6B
			15 00 00 00 00 00 02 77	00
			15 00 00 00 00 00 02 78	7E
			15 00 00 00 00 00 02 79	00
			15 00 00 00 00 00 02 7A	A1
			15 00 00 00 00 00 02 7B	00
			15 00 00 00 00 00 02 7C	BE
			15 00 00 00 00 00 02 7D	00
			15 00 00 00 00 00 02 7E	D6
			15 00 00 00 00 00 02 7F	00
			15 00 00 00 00 00 02 80	EB
			15 00 00 00 00 00 02 81	00
			15 00 00 00 00 00 02 82	FD
			15 00 00 00 00 00 02 83	01
			15 00 00 00 00 00 02 84	0D
			15 00 00 00 00 00 02 85	01
			15 00 00 00 00 00 02 86	1C
			15 00 00 00 00 00 02 87	01
			15 00 00 00 00 00 02 88	4E
			15 00 00 00 00 00 02 89	01
			15 00 00 00 00 00 02 8A	73
			15 00 00 00 00 00 02 8B	01
			15 00 00 00 00 00 02 8C	AC
			15 00 00 00 00 00 02 8D	01
			15 00 00 00 00 00 02 8E	D7
			15 00 00 00 00 00 02 8F	02
			15 00 00 00 00 00 02 90	19
			15 00 00 00 00 00 02 91	02
			15 00 00 00 00 00 02 92	4D
			15 00 00 00 00 00 02 93	02
			15 00 00 00 00 00 02 94	4F
			15 00 00 00 00 00 02 95	02
			15 00 00 00 00 00 02 96	81
			15 00 00 00 00 00 02 97	02
			15 00 00 00 00 00 02 98	B9
			15 00 00 00 00 00 02 99	02
			15 00 00 00 00 00 02 9A	DE
			15 00 00 00 00 00 02 9B	03
			15 00 00 00 00 00 02 9C	0E
			15 00 00 00 00 00 02 9D	03
			15 00 00 00 00 00 02 9E	30
			15 00 00 00 00 00 02 9F	03
			15 00 00 00 00 00 02 A0	61
			15 00 00 00 00 00 02 A2	03
			15 00 00 00 00 00 02 A3	70
			15 00 00 00 00 00 02 A4	03
			15 00 00 00 00 00 02 A5	81
			15 00 00 00 00 00 02 A6	03
			15 00 00 00 00 00 02 A7	93
			15 00 00 00 00 00 02 A9	03
			15 00 00 00 00 00 02 AA	A8
			15 00 00 00 00 00 02 AB	03
			15 00 00 00 00 00 02 AC	BE
			15 00 00 00 00 00 02 AD	03
			15 00 00 00 00 00 02 AE	D6
			15 00 00 00 00 00 02 AF	03
			15 00 00 00 00 00 02 B0	F1
			15 00 00 00 00 00 02 B1	03
			15 01 00 00 00 00 02 B2	FF
			//R(-) MCR cmd
			15 00 00 00 00 00 02 B3	00
			15 00 00 00 00 00 02 B4	6B
			15 00 00 00 00 00 02 B5	00
			15 00 00 00 00 00 02 B6	7E
			15 00 00 00 00 00 02 B7	00
			15 00 00 00 00 00 02 B8	A1
			15 00 00 00 00 00 02 B9	00
			15 00 00 00 00 00 02 BA	BE
			15 00 00 00 00 00 02 BB	00
			15 00 00 00 00 00 02 BC	D6
			15 00 00 00 00 00 02 BD	00
			15 00 00 00 00 00 02 BE	EB
			15 00 00 00 00 00 02 BF	00
			15 00 00 00 00 00 02 C0	FD
			15 00 00 00 00 00 02 C1	01
			15 00 00 00 00 00 02 C2	0D
			15 00 00 00 00 00 02 C3	01
			15 00 00 00 00 00 02 C4	1C
			15 00 00 00 00 00 02 C5	01
			15 00 00 00 00 00 02 C6	4E
			15 00 00 00 00 00 02 C7	01
			15 00 00 00 00 00 02 C8	73
			15 00 00 00 00 00 02 C9	01
			15 00 00 00 00 00 02 CA	AC
			15 00 00 00 00 00 02 CB	01
			15 00 00 00 00 00 02 CC	D7
			15 00 00 00 00 00 02 CD	02
			15 00 00 00 00 00 02 CE	19
			15 00 00 00 00 00 02 CF	02
			15 00 00 00 00 00 02 D0	4D
			15 00 00 00 00 00 02 D1	02
			15 00 00 00 00 00 02 D2	4F
			15 00 00 00 00 00 02 D3	02
			15 00 00 00 00 00 02 D4	81
			15 00 00 00 00 00 02 D5	02
			15 00 00 00 00 00 02 D6	B9
			15 00 00 00 00 00 02 D7	02
			15 00 00 00 00 00 02 D8	DE
			15 00 00 00 00 00 02 D9	03
			15 00 00 00 00 00 02 DA	0E
			15 00 00 00 00 00 02 DB	03
			15 00 00 00 00 00 02 DC	30
			15 00 00 00 00 00 02 DD	03
			15 00 00 00 00 00 02 DE	61
			15 00 00 00 00 00 02 DF	03
			15 00 00 00 00 00 02 E0	70
			15 00 00 00 00 00 02 E1	03
			15 00 00 00 00 00 02 E2	81
			15 00 00 00 00 00 02 E3	03
			15 00 00 00 00 00 02 E4	93
			15 00 00 00 00 00 02 E5	03
			15 00 00 00 00 00 02 E6	A8
			15 00 00 00 00 00 02 E7	03
			15 00 00 00 00 00 02 E8	BE
			15 00 00 00 00 00 02 E9	03
			15 00 00 00 00 00 02 EA	D6
			15 00 00 00 00 00 02 EB	03
			15 00 00 00 00 00 02 EC	F1
			15 00 00 00 00 00 02 ED	03
			15 01 00 00 00 00 02 EE	FF
			//G(+) MCR cmd
			15 00 00 00 00 00 02 EF	00
			15 00 00 00 00 00 02 F0	CB
			15 00 00 00 00 00 02 F1	00
			15 00 00 00 00 00 02 F2	D7
			15 00 00 00 00 00 02 F3	00
			15 00 00 00 00 00 02 F4	ED
			15 00 00 00 00 00 02 F5	01
			15 00 00 00 00 00 02 F6	00
			15 00 00 00 00 00 02 F7	01
			15 00 00 00 00 00 02 F8	10
			15 00 00 00 00 00 02 F9	01
			15 00 00 00 00 00 02 FA	1F
			//page selection cmd start
			15 00 00 00 00 00 02 FB	01
			15 00 00 00 00 00 02 FF	21
			//page selection cmd end
			15 00 00 00 00 00 02 00	01
			15 00 00 00 00 00 02 01	2C
			15 00 00 00 00 00 02 02	01
			15 00 00 00 00 00 02 03	39
			15 00 00 00 00 00 02 04	01
			15 00 00 00 00 00 02 05	45
			15 00 00 00 00 00 02 06	01
			15 00 00 00 00 00 02 07	6C
			15 00 00 00 00 00 02 08	01
			15 00 00 00 00 00 02 09	8B
			15 00 00 00 00 00 02 0A	01
			15 00 00 00 00 00 02 0B	BD
			15 00 00 00 00 00 02 0C	01
			15 00 00 00 00 00 02 0D	E4
			15 00 00 00 00 00 02 0E	02
			15 00 00 00 00 00 02 0F	21
			15 00 00 00 00 00 02 10	02
			15 00 00 00 00 00 02 11	52
			15 00 00 00 00 00 02 12	02
			15 00 00 00 00 00 02 13	54
			15 00 00 00 00 00 02 14	02
			15 00 00 00 00 00 02 15	84
			15 00 00 00 00 00 02 16	02
			15 00 00 00 00 00 02 17	BD
			15 00 00 00 00 00 02 18	02
			15 00 00 00 00 00 02 19	E1
			15 00 00 00 00 00 02 1A	03
			15 00 00 00 00 00 02 1B	10
			15 00 00 00 00 00 02 1C	03
			15 00 00 00 00 00 02 1D	32
			15 00 00 00 00 00 02 1E	03
			15 00 00 00 00 00 02 1F	62
			15 00 00 00 00 00 02 20	03
			15 00 00 00 00 00 02 21	71
			15 00 00 00 00 00 02 22	03
			15 00 00 00 00 00 02 23	82
			15 00 00 00 00 00 02 24	03
			15 00 00 00 00 00 02 25	94
			15 00 00 00 00 00 02 26	03
			15 00 00 00 00 00 02 27	A8
			15 00 00 00 00 00 02 28	03
			15 00 00 00 00 00 02 29	BE
			15 00 00 00 00 00 02 2A	03
			15 00 00 00 00 00 02 2B	D7
			15 00 00 00 00 00 02 2D	03
			15 00 00 00 00 00 02 2F	F1
			15 00 00 00 00 00 02 30	03
			15 01 00 00 00 00 02 31	FF
			//G(-) MCR cmd
			15 00 00 00 00 00 02 32	00
			15 00 00 00 00 00 02 33	CB
			15 00 00 00 00 00 02 34	00
			15 00 00 00 00 00 02 35	D7
			15 00 00 00 00 00 02 36	00
			15 00 00 00 00 00 02 37	ED
			15 00 00 00 00 00 02 38	01
			15 00 00 00 00 00 02 39	00
			15 00 00 00 00 00 02 3A	01
			15 00 00 00 00 00 02 3B	10
			15 00 00 00 00 00 02 3D	01
			15 00 00 00 00 00 02 3F	1F
			15 00 00 00 00 00 02 40	01
			15 00 00 00 00 00 02 41	2C
			15 00 00 00 00 00 02 42	01
			15 00 00 00 00 00 02 43	39
			15 00 00 00 00 00 02 44	01
			15 00 00 00 00 00 02 45	45
			15 00 00 00 00 00 02 46	01
			15 00 00 00 00 00 02 47	6C
			15 00 00 00 00 00 02 48	01
			15 00 00 00 00 00 02 49	8B
			15 00 00 00 00 00 02 4A	01
			15 00 00 00 00 00 02 4B	BD
			15 00 00 00 00 00 02 4C	01
			15 00 00 00 00 00 02 4D	E4
			15 00 00 00 00 00 02 4E	02
			15 00 00 00 00 00 02 4F	21
			15 00 00 00 00 00 02 50	02
			15 00 00 00 00 00 02 51	52
			15 00 00 00 00 00 02 52	02
			15 00 00 00 00 00 02 53	54
			15 00 00 00 00 00 02 54	02
			15 00 00 00 00 00 02 55	84
			15 00 00 00 00 00 02 56	02
			15 00 00 00 00 00 02 58	BD
			15 00 00 00 00 00 02 59	02
			15 00 00 00 00 00 02 5A	E1
			15 00 00 00 00 00 02 5B	03
			15 00 00 00 00 00 02 5C	10
			15 00 00 00 00 00 02 5D	03
			15 00 00 00 00 00 02 5E	32
			15 00 00 00 00 00 02 5F	03
			15 00 00 00 00 00 02 60	62
			15 00 00 00 00 00 02 61	03
			15 00 00 00 00 00 02 62	71
			15 00 00 00 00 00 02 63	03
			15 00 00 00 00 00 02 64	82
			15 00 00 00 00 00 02 65	03
			15 00 00 00 00 00 02 66	94
			15 00 00 00 00 00 02 67	03
			15 00 00 00 00 00 02 68	A8
			15 00 00 00 00 00 02 69	03
			15 00 00 00 00 00 02 6A	BE
			15 00 00 00 00 00 02 6B	03
			15 00 00 00 00 00 02 6C	D7
			15 00 00 00 00 00 02 6D	03
			15 00 00 00 00 00 02 6E	F1
			15 00 00 00 00 00 02 6F	03
			15 01 00 00 00 00 02 70	FF
			//B(+) MCR cmd
			15 00 00 00 00 00 02 71	00
			15 00 00 00 00 00 02 72	00
			15 00 00 00 00 00 02 73	00
			15 00 00 00 00 00 02 74	35
			15 00 00 00 00 00 02 75	00
			15 00 00 00 00 00 02 76	8F
			15 00 00 00 00 00 02 77	00
			15 00 00 00 00 00 02 78	BF
			15 00 00 00 00 00 02 79	00
			15 00 00 00 00 00 02 7A	D7
			15 00 00 00 00 00 02 7B	00
			15 00 00 00 00 00 02 7C	ED
			15 00 00 00 00 00 02 7D	01
			15 00 00 00 00 00 02 7E	04
			15 00 00 00 00 00 02 7F	01
			15 00 00 00 00 00 02 80	17
			15 00 00 00 00 00 02 81	01
			15 00 00 00 00 00 02 82	26
			15 00 00 00 00 00 02 83	01
			15 00 00 00 00 00 02 84	58
			15 00 00 00 00 00 02 85	01
			15 00 00 00 00 00 02 86	7D
			15 00 00 00 00 00 02 87	01
			15 00 00 00 00 00 02 88	B5
			15 00 00 00 00 00 02 89	01
			15 00 00 00 00 00 02 8A	DF
			15 00 00 00 00 00 02 8B	02
			15 00 00 00 00 00 02 8C	1E
			15 00 00 00 00 00 02 8D	02
			15 00 00 00 00 00 02 8E	51
			15 00 00 00 00 00 02 8F	02
			15 00 00 00 00 00 02 90	52
			15 00 00 00 00 00 02 91	02
			15 00 00 00 00 00 02 92	83
			15 00 00 00 00 00 02 93	02
			15 00 00 00 00 00 02 94	BB
			15 00 00 00 00 00 02 95	02
			15 00 00 00 00 00 02 96	DF
			15 00 00 00 00 00 02 97	03
			15 00 00 00 00 00 02 98	0F
			15 00 00 00 00 00 02 99	03
			15 00 00 00 00 00 02 9A	31
			15 00 00 00 00 00 02 9B	03
			15 00 00 00 00 00 02 9C	61
			15 00 00 00 00 00 02 9D	03
			15 00 00 00 00 00 02 9E	70
			15 00 00 00 00 00 02 9F	03
			15 00 00 00 00 00 02 A0	81
			15 00 00 00 00 00 02 A2	03
			15 00 00 00 00 00 02 A3	94
			15 00 00 00 00 00 02 A4	03
			15 00 00 00 00 00 02 A5	A8
			15 00 00 00 00 00 02 A6	03
			15 00 00 00 00 00 02 A7	BE
			15 00 00 00 00 00 02 A9	03
			15 00 00 00 00 00 02 AA	D6
			15 00 00 00 00 00 02 AB	03
			15 00 00 00 00 00 02 AC	F1
			15 00 00 00 00 00 02 AD	03
			15 01 00 00 00 00 02 AE	FF
			//B(-) MCR cmd
			15 00 00 00 00 00 02 AF	00
			15 00 00 00 00 00 02 B0	00
			15 00 00 00 00 00 02 B1	00
			15 00 00 00 00 00 02 B2	35
			15 00 00 00 00 00 02 B3	00
			15 00 00 00 00 00 02 B4	8F
			15 00 00 00 00 00 02 B5	00
			15 00 00 00 00 00 02 B6	BF
			15 00 00 00 00 00 02 B7	00
			15 00 00 00 00 00 02 B8	D7
			15 00 00 00 00 00 02 B9	00
			15 00 00 00 00 00 02 BA	ED
			15 00 00 00 00 00 02 BB	01
			15 00 00 00 00 00 02 BC	04
			15 00 00 00 00 00 02 BD	01
			15 00 00 00 00 00 02 BE	17
			15 00 00 00 00 00 02 BF	01
			15 00 00 00 00 00 02 C0	26
			15 00 00 00 00 00 02 C1	01
			15 00 00 00 00 00 02 C2	58
			15 00 00 00 00 00 02 C3	01
			15 00 00 00 00 00 02 C4	7D
			15 00 00 00 00 00 02 C5	01
			15 00 00 00 00 00 02 C6	B5
			15 00 00 00 00 00 02 C7	01
			15 00 00 00 00 00 02 C8	DF
			15 00 00 00 00 00 02 C9	02
			15 00 00 00 00 00 02 CA	1E
			15 00 00 00 00 00 02 CB	02
			15 00 00 00 00 00 02 CC	51
			15 00 00 00 00 00 02 CD	02
			15 00 00 00 00 00 02 CE	52
			15 00 00 00 00 00 02 CF	02
			15 00 00 00 00 00 02 D0	83
			15 00 00 00 00 00 02 D1	02
			15 00 00 00 00 00 02 D2	BB
			15 00 00 00 00 00 02 D3	02
			15 00 00 00 00 00 02 D4	DF
			15 00 00 00 00 00 02 D5	03
			15 00 00 00 00 00 02 D6	0F
			15 00 00 00 00 00 02 D7	03
			15 00 00 00 00 00 02 D8	31
			15 00 00 00 00 00 02 D9	03
			15 00 00 00 00 00 02 DA	61
			15 00 00 00 00 00 02 DB	03
			15 00 00 00 00 00 02 DC	70
			15 00 00 00 00 00 02 DD	03
			15 00 00 00 00 00 02 DE	81
			15 00 00 00 00 00 02 DF	03
			15 00 00 00 00 00 02 E0	94
			15 00 00 00 00 00 02 E1	03
			15 00 00 00 00 00 02 E2	A8
			15 00 00 00 00 00 02 E3	03
			15 00 00 00 00 00 02 E4	BE
			15 00 00 00 00 00 02 E5	03
			15 00 00 00 00 00 02 E6	D6
			15 00 00 00 00 00 02 E7	03
			15 00 00 00 00 00 02 E8	F1
			15 00 00 00 00 00 02 E9	03
			15 00 00 00 00 00 02 EA	FF
			//page selection cmd start
			15 00 00 00 00 00 02 FB	01
			15 01 00 00 00 00 02 FF 10
			//page selection cmd end
		];

		qcom,panel-reader-mode-mono-enable-command = [
			15 01 00 00 00 00 02 FF 10
			15 01 00 00 00 00 02 55 80
		];

		qcom,panel-reader-mode-mono-disable-command = [
			15 01 00 00 00 00 02 FF 10
			15 01 00 00 00 00 02 55 00
		];

		qcom,mdss-dsi-on-command-state = "dsi_lp_mode";
		qcom,mdss-dsi-off-command-state = "dsi_hs_mode";
		qcom,mdss-dsi-reader-mode-command-state = "dsi_hs_mode";
		qcom,mdss-dsi-h-sync-pulse = <0>;
		qcom,mdss-dsi-lane-map = "lane_map_0123";
		qcom,mdss-dsi-bllp-eof-power-mode;
		qcom,mdss-dsi-bllp-power-mode;
		qcom,mdss-dsi-lane-0-state;
		qcom,mdss-dsi-lane-1-state;
		qcom,mdss-dsi-lane-2-state;
		qcom,mdss-dsi-lane-3-state;
		qcom,mdss-dsi-panel-timings = [DC 34 22 00 64 66
			28 38 32 03 04 00]; /* TLPX is 62.5ns */

		qcom,mdss-dsi-reset-sequence = <1 10>, <1 12>, <1 5>; /* reset is always HIGH */
		qcom,mdss-dsi-t-clk-post = <0x3>;
		qcom,mdss-dsi-t-clk-pre = <0x2A>;
		qcom,mdss-dsi-dma-trigger = "trigger_sw";

		/* KYH 20150904 modified from none to trigger_sw */
		qcom,mdss-dsi-mdp-trigger = "trigger_sw";

		qcom,cont-splash-enabled;
		//qcom,mdss-dsi-force-clock-lane-hs;

		qcom,mdss-dsi-traffic-mode = "non_burst_sync_event";

		qcom,mdss-dsi-post-init-delay = <1>;

		lge,blmap-size = <256>;
		lge,blmap = <
			0 25 25 25 25 25 25 25 25 25 				/* 0 ~ 9 */
			25 25 25 26 26 26 27 27 28 28				/* 10 ~ 19 */
			28 29 29 30 31 32 33 35 36 37				/* 20 ~ 29 */
			38 40 41 42 43 45 47 50 52 55				/* 30 ~ 39 */
			57 60 62 65 67 70 72 75 77 80				/* 40 ~ 49 */
			85 90 95 100 105 110 115 120 125 130			/* 50 ~ 59 */
			134 139 143 148 153 157 162 167 171 176			/* 60 ~ 69 */
			181 185 190 195 202 210 217 225 232 240			/* 70 ~ 79 */
			247 255 262 270 277 285 293 302 311 319			/* 80 ~ 89 */
			328 337 345 354 363 371 380 389 398 408			/* 90 ~ 99 */
			418 429 439 450 460 471 481 492 502 513			/* 100 ~ 109 */
			523 534 545 556 567 578 589 600 611 622			/* 110 ~ 119 */
			633 644 655 665 676 687 698 709 720 731			/* 120 ~ 129 */
			742 753 764 775 817 833 850 866 883 900			/* 130 ~ 139 */
			916 933 950 966 983 1000 1015 1030 1046 1061		/* 140 ~ 149 */
			1076 1092 1107 1123 1138 1153 1169 1184 1200 1219	/* 150 ~ 159 */
			1239 1258 1278 1297 1317 1337 1356 1376 1395 1415	/* 160 ~ 169 */
			1435 1454 1474 1493 1513 1533 1552 1572 1591 1611	/* 170 ~ 179 */
			1631 1650 1670 1690 1713 1737 1761 1785 1808 1832	/* 180 ~ 189 */
			1856 1880 1903 1927 1951 1975 1999 2023 2047 2071	/* 190 ~ 199 */
			2096 2120 2144 2168 2193 2217 2241 2265 2290 2320	/* 200 ~ 209 */
			2350 2380 2410 2440 2470 2500 2530 2560 2590 2620	/* 210 ~ 219 */
			2647 2675 2703 2730 2758 2786 2813 2841 2869 2896	/* 220 ~ 229 */
			2924 2952 2980 3012 3045 3077 3110 3142 3175 3207	/* 230 ~ 239 */
			3240 3272 3305 3337 3370 3409 3448 3487 3526 3565	/* 240 ~ 249 */
			3604 3643 3682 3721 3760 3800>;				/* 250 ~ 255 */
	};
};
