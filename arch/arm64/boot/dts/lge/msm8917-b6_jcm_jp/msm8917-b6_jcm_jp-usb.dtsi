/*
 * Copyright (c) 2016, The Linux Foundation. All rights reserved.
 *
 * This program is free software; you can redistribute it and/or modify
 * it under the terms of the GNU General Public License version 2 and
 * only version 2 as published by the Free Software Foundation.
 *
 * This program is distributed in the hope that it will be useful,
 * but WITHOUT ANY WARRANTY; without even the implied warranty of
 * MERCHANTABILITY or FITNESS FOR A PARTICULAR PURPOSE.  See the
 * GNU General Public License for more details.
 */

&pmi8950_vadc {
	interrupts = <0x2 0x31 0x0>,
			   <0x2 0x31 0x3>,
			   <0x2 0x31 0x4>;
	interrupt-names = "eoc-int-en-set",
		"high-thr-en-set",
		"low-thr-en-set";
	qcom,vadc-meas-int-mode;
};

&usb_otg {
        qcom,hsusb-otg-mode = <3>;
	qcom,hsusb-otg-otg-control = <2>;
	qcom,hsusb-otg-mpm-dpsehv-int = <49>;
	qcom,hsusb-otg-mpm-dmsehv-int = <58>;
	qcom,huben-gpio = <&tlmm 46 0x0>;
	qcom,hubres-gpio = <&tlmm 45 0x0>;
	qcom,phy-otg-vadc = <&pmi8950_vadc>;
	qcom,hsusb-otg-phy-init-seq =
                <0x44 0x80 0x3F 0x81 0x3C 0x82 0x1F 0x83 0xffffffff>;
	qcom,hsusb-otg-phy-init-host-seq =
		<0x44 0x80 0x75 0x81 0x3C 0x82 0x1F 0x83 0xffffffff>;
};
