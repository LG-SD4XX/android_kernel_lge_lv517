/* Copyright (c) 2014, Code Aurora Forum. All rights reserved.
 *
 * This program is free software; you can redistribute it and/or modify
 * it under the terms of the GNU General Public License version 2 and
 * only version 2 as published by the Free Software Foundation.
 *
 * This program is distributed in the hope that it will be useful,
 * but WITHOUT ANY WARRANTY; without even the implied warranty of
 * MERCHANTABILITY or FITNESS FOR A PARTICULAR PURPOSE.  See the
 * GNU General Public License for more details.
 */

&mdss_mdp {
	dsi_sharp_nt35596_vid: qcom,mdss_dsi_sharp_nt35596_fhd_video {
		compatible = "qcom,mdss-dsi-panel";
		qcom,mdss-dsi-panel-name = "SHARP FHD video mode dsi panel";
		qcom,mdss-dsi-panel-controller = <&mdss_dsi0>;
		qcom,mdss-dsi-panel-type = "dsi_video_mode";
		qcom,mdss-dsi-panel-destination = "display_1";
		qcom,mdss-dsi-panel-framerate = <60>;
		qcom,mdss-dsi-virtual-channel-id = <0>;
		qcom,mdss-dsi-stream = <0>;

		qcom,mdss-dsi-panel-width = <1080>;
		qcom,mdss-dsi-panel-height = <1920>;
		qcom,mdss-dsi-h-front-porch = <128>;
		qcom,mdss-dsi-h-back-porch = <76>;
		qcom,mdss-dsi-h-pulse-width = <4>;
		qcom,mdss-dsi-h-sync-skew = <0>;
		qcom,mdss-dsi-v-back-porch = <4>;
		qcom,mdss-dsi-v-front-porch = <4>;
		qcom,mdss-dsi-v-pulse-width = <6>;


		qcom,mdss-pan-physical-width-dimension = <73>;
		qcom,mdss-pan-physical-height-dimension = <125>;

		qcom,mdss-dsi-h-left-border = <0>;
		qcom,mdss-dsi-h-right-border = <0>;
		qcom,mdss-dsi-v-top-border = <0>;
		qcom,mdss-dsi-v-bottom-border = <0>;
		qcom,mdss-dsi-bpp = <24>;
		qcom,mdss-dsi-color-order = "rgb_swap_rgb";
		qcom,mdss-dsi-underflow-color = <0xff>;
		qcom,mdss-dsi-border-color = <0xff>;

		qcom,mdss-dsi-on-command = [
			/*  OSC restart funtion */
			15 01 00 00 00 00 02 FF EE
			15 01 00 00 0A 00 02 18 40
			15 01 00 00 14 00 02 18 00

			/* Initial Setting  */
			15 01 00 00 00 00 02 FF 00
			15 01 00 00 00 00 02 D3 0A
			15 01 00 00 00 00 02 D4 04
			15 01 00 00 00 00 02 FF 01
			15 01 00 00 00 00 02 FB 01
			15 01 00 00 00 00 02 6D 77
			15 01 00 00 00 00 02 FF 05
			15 01 00 00 00 00 02 FB 01
			15 01 00 00 00 00 02 24 55
			15 01 00 00 00 00 02 35 4F
			15 01 00 00 00 00 02 7E 02
			15 01 00 00 00 00 02 7F 12
			15 01 00 00 00 00 02 81 07
			15 01 00 00 00 00 02 84 06
			15 01 00 00 00 00 02 85 07
			15 01 00 00 00 00 02 94 0A
			15 01 00 00 00 00 02 FF 00

			/* Sleep out */
			05 01 00 00 50 00 01 11
			/* Display On */
			05 01 00 00 00 00 01 29
		];

		qcom,mdss-dsi-off-command = [
			/* CMD1 Page Select */
			15 01 00 00 00 00 02 FF 00
			/* Display off */
			05 01 00 00 32 00 01 28
			/* Sleep in */
			05 01 00 00 3C 00 01 10
		];

		qcom,panel-reader-mode-initial-step1-command = [
			//page selection cmd start
			15 01 00 00 00 00 02 FF 01
			15 01 00 00 00 00 02 FB 01
			//page selection cmd end
			//R(+) MCR cmd
			15 01 00 00 00 00 02 75 00
			15 01 00 00 00 00 02 76 28
			15 01 00 00 00 00 02 77 00
			15 01 00 00 00 00 02 78 3B
			15 01 00 00 00 00 02 79 00
			15 01 00 00 00 00 02 7A 6E
			15 01 00 00 00 00 02 7B 00
			15 01 00 00 00 00 02 7C 8F
			15 01 00 00 00 00 02 7D 00
			15 01 00 00 00 00 02 7E AD
			15 01 00 00 00 00 02 7F 00
			15 01 00 00 00 00 02 80 C5
			15 01 00 00 00 00 02 81 00
			15 01 00 00 00 00 02 82 DB
			15 01 00 00 00 00 02 83 00
			15 01 00 00 00 00 02 84 EE
			15 01 00 00 00 00 02 85 00
			15 01 00 00 00 00 02 86 FF
			15 01 00 00 00 00 02 87 01
			15 01 00 00 00 00 02 88 35
			15 01 00 00 00 00 02 89 01
			15 01 00 00 00 00 02 8A 60
			15 01 00 00 00 00 02 8B 01
			15 01 00 00 00 00 02 8C A0
			15 01 00 00 00 00 02 8D 01
			15 01 00 00 00 00 02 8E CE
			15 01 00 00 00 00 02 8F 02
			15 01 00 00 00 00 02 90 15
			15 01 00 00 00 00 02 91 02
			15 01 00 00 00 00 02 92 4A
			15 01 00 00 00 00 02 93 02
			15 01 00 00 00 00 02 94 4C
			15 01 00 00 00 00 02 95 02
			15 01 00 00 00 00 02 96 7F
			15 01 00 00 00 00 02 97 02
			15 01 00 00 00 00 02 98 B7
			15 01 00 00 00 00 02 99 02
			15 01 00 00 00 00 02 9A DC
			15 01 00 00 00 00 02 9B 03
			15 01 00 00 00 00 02 9C 0C
			15 01 00 00 00 00 02 9D 03
			15 01 00 00 00 00 02 9E 31
			15 01 00 00 00 00 02 9F 03
			15 01 00 00 00 00 02 A0 5F
			15 01 00 00 00 00 02 A2 03
			15 01 00 00 00 00 02 A3 6D
			15 01 00 00 00 00 02 A4 03
			15 01 00 00 00 00 02 A5 7C
			15 01 00 00 00 00 02 A6 03
			15 01 00 00 00 00 02 A7 8A
			15 01 00 00 00 00 02 A9 03
			15 01 00 00 00 00 02 AA 9F
			15 01 00 00 00 00 02 AB 03
			15 01 00 00 00 00 02 AC B5
			15 01 00 00 00 00 02 AD 03
			15 01 00 00 00 00 02 AE DD
			15 01 00 00 00 00 02 AF 03
			15 01 00 00 00 00 02 B0 EF
			15 01 00 00 00 00 02 B1 03
			15 01 00 00 00 00 02 B2 F0
			//R(-) MCR cmd
			15 01 00 00 00 00 02 B3 00
			15 01 00 00 00 00 02 B4 38
			15 01 00 00 00 00 02 B5 00
			15 01 00 00 00 00 02 B6 4C
			15 01 00 00 00 00 02 B7 00
			15 01 00 00 00 00 02 B8 7F
			15 01 00 00 00 00 02 B9 00
			15 01 00 00 00 00 02 BA 9E
			15 01 00 00 00 00 02 BB 00
			15 01 00 00 00 00 02 BC BC
			15 01 00 00 00 00 02 BD 00
			15 01 00 00 00 00 02 BE D4
			15 01 00 00 00 00 02 BF 00
			15 01 00 00 00 00 02 C0 EA
			15 01 00 00 00 00 02 C1 00
			15 01 00 00 00 00 02 C2 FD
			15 01 00 00 00 00 02 C3 01
			15 01 00 00 00 00 02 C4 0C
			15 01 00 00 00 00 02 C5 01
			15 01 00 00 00 00 02 C6 42
			15 01 00 00 00 00 02 C7 01
			15 01 00 00 00 00 02 C8 6B
			15 01 00 00 00 00 02 C9 01
			15 01 00 00 00 00 02 CA A7
			15 01 00 00 00 00 02 CB 01
			15 01 00 00 00 00 02 CC D3
			15 01 00 00 00 00 02 CD 02
			15 01 00 00 00 00 02 CE 15
			15 01 00 00 00 00 02 CF 02
			15 01 00 00 00 00 02 D0 4A
			15 01 00 00 00 00 02 D1 02
			15 01 00 00 00 00 02 D2 4C
			15 01 00 00 00 00 02 D3 02
			15 01 00 00 00 00 02 D4 7F
			15 01 00 00 00 00 02 D5 02
			15 01 00 00 00 00 02 D6 B7
			15 01 00 00 00 00 02 D7 02
			15 01 00 00 00 00 02 D8 DC
			15 01 00 00 00 00 02 D9 03
			15 01 00 00 00 00 02 DA 0C
			15 01 00 00 00 00 02 DB 03
			15 01 00 00 00 00 02 DC 24
			15 01 00 00 00 00 02 DD 03
			15 01 00 00 00 00 02 DE 46
			15 01 00 00 00 00 02 DF 03
			15 01 00 00 00 00 02 E0 52
			15 01 00 00 00 00 02 E1 03
			15 01 00 00 00 00 02 E2 5D
			15 01 00 00 00 00 02 E3 03
			15 01 00 00 00 00 02 E4 69
			15 01 00 00 00 00 02 E5 03
			15 01 00 00 00 00 02 E6 7A
			15 01 00 00 00 00 02 E7 03
			15 01 00 00 00 00 02 E8 8D
			15 01 00 00 00 00 02 E9 03
			15 01 00 00 00 00 02 EA B2
			15 01 00 00 00 00 02 EB 03
			15 01 00 00 00 00 02 EC C0
			15 01 00 00 00 00 02 ED 03
			15 01 00 00 00 00 02 EE C1
			//G(+) MCR cmd
			15 01 00 00 00 00 02 EF 01
			15 01 00 00 00 00 02 F0 08
			15 01 00 00 00 00 02 F1 01
			15 01 00 00 00 00 02 F2 0E
			15 01 00 00 00 00 02 F3 01
			15 01 00 00 00 00 02 F4 1C
			15 01 00 00 00 00 02 F5 01
			15 01 00 00 00 00 02 F6 29
			15 01 00 00 00 00 02 F7 01
			15 01 00 00 00 00 02 F8 34
			15 01 00 00 00 00 02 F9 01
			15 01 00 00 00 00 02 FA 3F
			//page selection cmd start
			15 01 00 00 00 00 02 FF 02
			15 01 00 00 00 00 02 FB 01
			//page selection cmd end
			15 01 00 00 00 00 02 00 01
			15 01 00 00 00 00 02 01 49
			15 01 00 00 00 00 02 02 01
			15 01 00 00 00 00 02 03 53
			15 01 00 00 00 00 02 04 01
			15 01 00 00 00 00 02 05 5D
			15 01 00 00 00 00 02 06 01
			15 01 00 00 00 00 02 07 7D
			15 01 00 00 00 00 02 08 01
			15 01 00 00 00 00 02 09 99
			15 01 00 00 00 00 02 0A 01
			15 01 00 00 00 00 02 0B C6
			15 01 00 00 00 00 02 0C 01
			15 01 00 00 00 00 02 0D EC
			15 01 00 00 00 00 02 0E 02
			15 01 00 00 00 00 02 0F 27
			15 01 00 00 00 00 02 10 02
			15 01 00 00 00 00 02 11 57
			15 01 00 00 00 00 02 12 02
			15 01 00 00 00 00 02 13 59
			15 01 00 00 00 00 02 14 02
			15 01 00 00 00 00 02 15 88
			15 01 00 00 00 00 02 16 02
			15 01 00 00 00 00 02 17 C0
			15 01 00 00 00 00 02 18 02
			15 01 00 00 00 00 02 19 E3
			15 01 00 00 00 00 02 1A 03
			15 01 00 00 00 00 02 1B 12
			15 01 00 00 00 00 02 1C 03
			15 01 00 00 00 00 02 1D 37
			15 01 00 00 00 00 02 1E 03
			15 01 00 00 00 00 02 1F 65
			15 01 00 00 00 00 02 20 03
			15 01 00 00 00 00 02 21 72
			15 01 00 00 00 00 02 22 03
			15 01 00 00 00 00 02 23 81
			15 01 00 00 00 00 02 24 03
			15 01 00 00 00 00 02 25 90
			15 01 00 00 00 00 02 26 03
			15 01 00 00 00 00 02 27 A3
			15 01 00 00 00 00 02 28 03
			15 01 00 00 00 00 02 29 B5
			15 01 00 00 00 00 02 2A 03
			15 01 00 00 00 00 02 2B CE
			15 01 00 00 00 00 02 2D 03
			15 01 00 00 00 00 02 2F EF
			15 01 00 00 00 00 02 30 03
			15 01 00 00 00 00 02 31 F0
			//G(-) MCR cmd
			15 01 00 00 00 00 02 32 01
			15 01 00 00 00 00 02 33 19
			15 01 00 00 00 00 02 34 01
			15 01 00 00 00 00 02 35 1F
			15 01 00 00 00 00 02 36 01
			15 01 00 00 00 00 02 37 2D
			15 01 00 00 00 00 02 38 01
			15 01 00 00 00 00 02 39 38
			15 01 00 00 00 00 02 3A 01
			15 01 00 00 00 00 02 3B 43
			15 01 00 00 00 00 02 3D 01
			15 01 00 00 00 00 02 3F 4E
			15 01 00 00 00 00 02 40 01
			15 01 00 00 00 00 02 41 58
			15 01 00 00 00 00 02 42 01
			15 01 00 00 00 00 02 43 62
			15 01 00 00 00 00 02 44 01
			15 01 00 00 00 00 02 45 6A
			15 01 00 00 00 00 02 46 01
			15 01 00 00 00 00 02 47 8A
			15 01 00 00 00 00 02 48 01
			15 01 00 00 00 00 02 49 A4
			15 01 00 00 00 00 02 4A 01
			15 01 00 00 00 00 02 4B CD
			15 01 00 00 00 00 02 4C 01
			15 01 00 00 00 00 02 4D F0
			15 01 00 00 00 00 02 4E 02
			15 01 00 00 00 00 02 4F 27
			15 01 00 00 00 00 02 50 02
			15 01 00 00 00 00 02 51 57
			15 01 00 00 00 00 02 52 02
			15 01 00 00 00 00 02 53 59
			15 01 00 00 00 00 02 54 02
			15 01 00 00 00 00 02 55 88
			15 01 00 00 00 00 02 56 02
			15 01 00 00 00 00 02 58 C0
			15 01 00 00 00 00 02 59 02
			15 01 00 00 00 00 02 5A E3
			15 01 00 00 00 00 02 5B 03
			15 01 00 00 00 00 02 5C 12
			15 01 00 00 00 00 02 5D 03
			15 01 00 00 00 00 02 5E 2A
			15 01 00 00 00 00 02 5F 03
			15 01 00 00 00 00 02 60 4C
			15 01 00 00 00 00 02 61 03
			15 01 00 00 00 00 02 62 57
			15 01 00 00 00 00 02 63 03
			15 01 00 00 00 00 02 64 62
			15 01 00 00 00 00 02 65 03
			15 01 00 00 00 00 02 66 6F
			15 01 00 00 00 00 02 67 03
			15 01 00 00 00 00 02 68 7E
			15 01 00 00 00 00 02 69 03
			15 01 00 00 00 00 02 6A 8D
			15 01 00 00 00 00 02 6B 03
			15 01 00 00 00 00 02 6C A3
			15 01 00 00 00 00 02 6D 03
			15 01 00 00 00 00 02 6E C0
			15 01 00 00 00 00 02 6F 03
			15 01 00 00 00 00 02 70 C1
			//B(+) MCR cmd
			15 01 00 00 00 00 02 71 01
			15 01 00 00 00 00 02 72 96
			15 01 00 00 00 00 02 73 01
			15 01 00 00 00 00 02 74 98
			15 01 00 00 00 00 02 75 01
			15 01 00 00 00 00 02 76 9D
			15 01 00 00 00 00 02 77 01
			15 01 00 00 00 00 02 78 A3
			15 01 00 00 00 00 02 79 01
			15 01 00 00 00 00 02 7A A8
			15 01 00 00 00 00 02 7B 01
			15 01 00 00 00 00 02 7C AD
			15 01 00 00 00 00 02 7D 01
			15 01 00 00 00 00 02 7E B2
			15 01 00 00 00 00 02 7F 01
			15 01 00 00 00 00 02 80 B7
			15 01 00 00 00 00 02 81 01
			15 01 00 00 00 00 02 82 BC
			15 01 00 00 00 00 02 83 01
			15 01 00 00 00 00 02 84 CE
			15 01 00 00 00 00 02 85 01
			15 01 00 00 00 00 02 86 DF
			15 01 00 00 00 00 02 87 01
			15 01 00 00 00 00 02 88 FD
			15 01 00 00 00 00 02 89 02
			15 01 00 00 00 00 02 8A 17
			15 01 00 00 00 00 02 8B 02
			15 01 00 00 00 00 02 8C 46
			15 01 00 00 00 00 02 8D 02
			15 01 00 00 00 00 02 8E 6F
			15 01 00 00 00 00 02 8F 02
			15 01 00 00 00 00 02 90 71
			15 01 00 00 00 00 02 91 02
			15 01 00 00 00 00 02 92 9C
			15 01 00 00 00 00 02 93 02
			15 01 00 00 00 00 02 94 D2
			15 01 00 00 00 00 02 95 02
			15 01 00 00 00 00 02 96 F4
			15 01 00 00 00 00 02 97 03
			15 01 00 00 00 00 02 98 21
			15 01 00 00 00 00 02 99 03
			15 01 00 00 00 00 02 9A 44
			15 01 00 00 00 00 02 9B 03
			15 01 00 00 00 00 02 9C 71
			15 01 00 00 00 00 02 9D 03
			15 01 00 00 00 00 02 9E 7B
			15 01 00 00 00 00 02 9F 03
			15 01 00 00 00 00 02 A0 8B
			15 01 00 00 00 00 02 A2 03
			15 01 00 00 00 00 02 A3 97
			15 01 00 00 00 00 02 A4 03
			15 01 00 00 00 00 02 A5 A9
			15 01 00 00 00 00 02 A6 03
			15 01 00 00 00 00 02 A7 BA
			15 01 00 00 00 00 02 A9 03
			15 01 00 00 00 00 02 AA E4
			15 01 00 00 00 00 02 AB 03
			15 01 00 00 00 00 02 AC EF
			15 01 00 00 00 00 02 AD 03
			15 01 00 00 00 00 02 AE F0
			//B(-) MCR cmd
			15 01 00 00 00 00 02 AF 01
			15 01 00 00 00 00 02 B0 A7
			15 01 00 00 00 00 02 B1 01
			15 01 00 00 00 00 02 B2 A9
			15 01 00 00 00 00 02 B3 01
			15 01 00 00 00 00 02 B4 AE
			15 01 00 00 00 00 02 B5 01
			15 01 00 00 00 00 02 B6 B2
			15 01 00 00 00 00 02 B7 01
			15 01 00 00 00 00 02 B8 B7
			15 01 00 00 00 00 02 B9 01
			15 01 00 00 00 00 02 BA BC
			15 01 00 00 00 00 02 BB 01
			15 01 00 00 00 00 02 BC C1
			15 01 00 00 00 00 02 BD 01
			15 01 00 00 00 00 02 BE C6
			15 01 00 00 00 00 02 BF 01
			15 01 00 00 00 00 02 C0 C9
			15 01 00 00 00 00 02 C1 01
			15 01 00 00 00 00 02 C2 DB
			15 01 00 00 00 00 02 C3 01
			15 01 00 00 00 00 02 C4 EA
			15 01 00 00 00 00 02 C5 02
			15 01 00 00 00 00 02 C6 04
			15 01 00 00 00 00 02 C7 02
			15 01 00 00 00 00 02 C8 1B
			15 01 00 00 00 00 02 C9 02
			15 01 00 00 00 00 02 CA 46
			15 01 00 00 00 00 02 CB 02
			15 01 00 00 00 00 02 CC 6F
			15 01 00 00 00 00 02 CD 02
			15 01 00 00 00 00 02 CE 71
			15 01 00 00 00 00 02 CF 02
			15 01 00 00 00 00 02 D0 9C
			15 01 00 00 00 00 02 D1 02
			15 01 00 00 00 00 02 D2 D2
			15 01 00 00 00 00 02 D3 02
			15 01 00 00 00 00 02 D4 F4
			15 01 00 00 00 00 02 D5 03
			15 01 00 00 00 00 02 D6 21
			15 01 00 00 00 00 02 D7 03
			15 01 00 00 00 00 02 D8 37
			15 01 00 00 00 00 02 D9 03
			15 01 00 00 00 00 02 DA 58
			15 01 00 00 00 00 02 DB 03
			15 01 00 00 00 00 02 DC 60
			15 01 00 00 00 00 02 DD 03
			15 01 00 00 00 00 02 DE 6C
			15 01 00 00 00 00 02 DF 03
			15 01 00 00 00 00 02 E0 76
			15 01 00 00 00 00 02 E1 03
			15 01 00 00 00 00 02 E2 84
			15 01 00 00 00 00 02 E3 03
			15 01 00 00 00 00 02 E4 92
			15 01 00 00 00 00 02 E5 03
			15 01 00 00 00 00 02 E6 B9
			15 01 00 00 00 00 02 E7 03
			15 01 00 00 00 00 02 E8 C0
			15 01 00 00 00 00 02 E9 03
			15 01 00 00 00 00 02 EA C1
			15 01 00 00 00 00 02 FF 00
		];

		qcom,panel-reader-mode-step1-command = [
			//page selection cmd start
			15 00 00 00 00 00 02 FF 01
			15 00 00 00 00 00 02 FB 01
			//page selection cmd end
			//R(+) MCR cmd
			15 00 00 00 00 00 02 75 00
			15 00 00 00 00 00 02 76 28
			15 00 00 00 00 00 02 77 00
			15 00 00 00 00 00 02 78 3B
			15 00 00 00 00 00 02 79 00
			15 00 00 00 00 00 02 7A 6E
			15 00 00 00 00 00 02 7B 00
			15 00 00 00 00 00 02 7C 8F
			15 00 00 00 00 00 02 7D 00
			15 00 00 00 00 00 02 7E AD
			15 00 00 00 00 00 02 7F 00
			15 00 00 00 00 00 02 80 C5
			15 00 00 00 00 00 02 81 00
			15 00 00 00 00 00 02 82 DB
			15 00 00 00 00 00 02 83 00
			15 00 00 00 00 00 02 84 EE
			15 00 00 00 00 00 02 85 00
			15 00 00 00 00 00 02 86 FF
			15 00 00 00 00 00 02 87 01
			15 00 00 00 00 00 02 88 35
			15 00 00 00 00 00 02 89 01
			15 00 00 00 00 00 02 8A 60
			15 00 00 00 00 00 02 8B 01
			15 00 00 00 00 00 02 8C A0
			15 00 00 00 00 00 02 8D 01
			15 00 00 00 00 00 02 8E CE
			15 00 00 00 00 00 02 8F 02
			15 00 00 00 00 00 02 90 15
			15 00 00 00 00 00 02 91 02
			15 00 00 00 00 00 02 92 4A
			15 00 00 00 00 00 02 93 02
			15 00 00 00 00 00 02 94 4C
			15 00 00 00 00 00 02 95 02
			15 00 00 00 00 00 02 96 7F
			15 00 00 00 00 00 02 97 02
			15 00 00 00 00 00 02 98 B7
			15 00 00 00 00 00 02 99 02
			15 00 00 00 00 00 02 9A DC
			15 00 00 00 00 00 02 9B 03
			15 00 00 00 00 00 02 9C 0C
			15 00 00 00 00 00 02 9D 03
			15 00 00 00 00 00 02 9E 31
			15 00 00 00 00 00 02 9F 03
			15 00 00 00 00 00 02 A0 5F
			15 00 00 00 00 00 02 A2 03
			15 00 00 00 00 00 02 A3 6D
			15 00 00 00 00 00 02 A4 03
			15 00 00 00 00 00 02 A5 7C
			15 00 00 00 00 00 02 A6 03
			15 00 00 00 00 00 02 A7 8A
			15 00 00 00 00 00 02 A9 03
			15 00 00 00 00 00 02 AA 9F
			15 00 00 00 00 00 02 AB 03
			15 00 00 00 00 00 02 AC B5
			15 00 00 00 00 00 02 AD 03
			15 00 00 00 00 00 02 AE DD
			15 00 00 00 00 00 02 AF 03
			15 00 00 00 00 00 02 B0 EF
			15 00 00 00 00 00 02 B1 03
			15 01 00 00 00 00 02 B2 F0
			//R(-) MCR cmd
			15 00 00 00 00 00 02 B3 00
			15 00 00 00 00 00 02 B4 38
			15 00 00 00 00 00 02 B5 00
			15 00 00 00 00 00 02 B6 4C
			15 00 00 00 00 00 02 B7 00
			15 00 00 00 00 00 02 B8 7F
			15 00 00 00 00 00 02 B9 00
			15 00 00 00 00 00 02 BA 9E
			15 00 00 00 00 00 02 BB 00
			15 00 00 00 00 00 02 BC BC
			15 00 00 00 00 00 02 BD 00
			15 00 00 00 00 00 02 BE D4
			15 00 00 00 00 00 02 BF 00
			15 00 00 00 00 00 02 C0 EA
			15 00 00 00 00 00 02 C1 00
			15 00 00 00 00 00 02 C2 FD
			15 00 00 00 00 00 02 C3 01
			15 00 00 00 00 00 02 C4 0C
			15 00 00 00 00 00 02 C5 01
			15 00 00 00 00 00 02 C6 42
			15 00 00 00 00 00 02 C7 01
			15 00 00 00 00 00 02 C8 6B
			15 00 00 00 00 00 02 C9 01
			15 00 00 00 00 00 02 CA A7
			15 00 00 00 00 00 02 CB 01
			15 00 00 00 00 00 02 CC D3
			15 00 00 00 00 00 02 CD 02
			15 00 00 00 00 00 02 CE 15
			15 00 00 00 00 00 02 CF 02
			15 00 00 00 00 00 02 D0 4A
			15 00 00 00 00 00 02 D1 02
			15 00 00 00 00 00 02 D2 4C
			15 00 00 00 00 00 02 D3 02
			15 00 00 00 00 00 02 D4 7F
			15 00 00 00 00 00 02 D5 02
			15 00 00 00 00 00 02 D6 B7
			15 00 00 00 00 00 02 D7 02
			15 00 00 00 00 00 02 D8 DC
			15 00 00 00 00 00 02 D9 03
			15 00 00 00 00 00 02 DA 0C
			15 00 00 00 00 00 02 DB 03
			15 00 00 00 00 00 02 DC 24
			15 00 00 00 00 00 02 DD 03
			15 00 00 00 00 00 02 DE 46
			15 00 00 00 00 00 02 DF 03
			15 00 00 00 00 00 02 E0 52
			15 00 00 00 00 00 02 E1 03
			15 00 00 00 00 00 02 E2 5D
			15 00 00 00 00 00 02 E3 03
			15 00 00 00 00 00 02 E4 69
			15 00 00 00 00 00 02 E5 03
			15 00 00 00 00 00 02 E6 7A
			15 00 00 00 00 00 02 E7 03
			15 00 00 00 00 00 02 E8 8D
			15 00 00 00 00 00 02 E9 03
			15 00 00 00 00 00 02 EA B2
			15 00 00 00 00 00 02 EB 03
			15 00 00 00 00 00 02 EC C0
			15 00 00 00 00 00 02 ED 03
			15 01 00 00 00 00 02 EE C1
			//G(+) MCR cmd
			15 00 00 00 00 00 02 EF 01
			15 00 00 00 00 00 02 F0 08
			15 00 00 00 00 00 02 F1 01
			15 00 00 00 00 00 02 F2 0E
			15 00 00 00 00 00 02 F3 01
			15 00 00 00 00 00 02 F4 1C
			15 00 00 00 00 00 02 F5 01
			15 00 00 00 00 00 02 F6 29
			15 00 00 00 00 00 02 F7 01
			15 00 00 00 00 00 02 F8 34
			15 00 00 00 00 00 02 F9 01
			15 00 00 00 00 00 02 FA 3F
			//page selection cmd start
			15 00 00 00 00 00 02 FF 02
			15 00 00 00 00 00 02 FB 01
			//page selection cmd end
			15 00 00 00 00 00 02 00 01
			15 00 00 00 00 00 02 01 49
			15 00 00 00 00 00 02 02 01
			15 00 00 00 00 00 02 03 53
			15 00 00 00 00 00 02 04 01
			15 00 00 00 00 00 02 05 5D
			15 00 00 00 00 00 02 06 01
			15 00 00 00 00 00 02 07 7D
			15 00 00 00 00 00 02 08 01
			15 00 00 00 00 00 02 09 99
			15 00 00 00 00 00 02 0A 01
			15 00 00 00 00 00 02 0B C6
			15 00 00 00 00 00 02 0C 01
			15 00 00 00 00 00 02 0D EC
			15 00 00 00 00 00 02 0E 02
			15 00 00 00 00 00 02 0F 27
			15 00 00 00 00 00 02 10 02
			15 00 00 00 00 00 02 11 57
			15 00 00 00 00 00 02 12 02
			15 00 00 00 00 00 02 13 59
			15 00 00 00 00 00 02 14 02
			15 00 00 00 00 00 02 15 88
			15 00 00 00 00 00 02 16 02
			15 00 00 00 00 00 02 17 C0
			15 00 00 00 00 00 02 18 02
			15 00 00 00 00 00 02 19 E3
			15 00 00 00 00 00 02 1A 03
			15 00 00 00 00 00 02 1B 12
			15 00 00 00 00 00 02 1C 03
			15 00 00 00 00 00 02 1D 37
			15 00 00 00 00 00 02 1E 03
			15 00 00 00 00 00 02 1F 65
			15 00 00 00 00 00 02 20 03
			15 00 00 00 00 00 02 21 72
			15 00 00 00 00 00 02 22 03
			15 00 00 00 00 00 02 23 81
			15 00 00 00 00 00 02 24 03
			15 00 00 00 00 00 02 25 90
			15 00 00 00 00 00 02 26 03
			15 00 00 00 00 00 02 27 A3
			15 00 00 00 00 00 02 28 03
			15 00 00 00 00 00 02 29 B5
			15 00 00 00 00 00 02 2A 03
			15 00 00 00 00 00 02 2B CE
			15 00 00 00 00 00 02 2D 03
			15 00 00 00 00 00 02 2F EF
			15 00 00 00 00 00 02 30 03
			15 01 00 00 00 00 02 31 F0
			//G(-) MCR cmd
			15 00 00 00 00 00 02 32 01
			15 00 00 00 00 00 02 33 19
			15 00 00 00 00 00 02 34 01
			15 00 00 00 00 00 02 35 1F
			15 00 00 00 00 00 02 36 01
			15 00 00 00 00 00 02 37 2D
			15 00 00 00 00 00 02 38 01
			15 00 00 00 00 00 02 39 38
			15 00 00 00 00 00 02 3A 01
			15 00 00 00 00 00 02 3B 43
			15 00 00 00 00 00 02 3D 01
			15 00 00 00 00 00 02 3F 4E
			15 00 00 00 00 00 02 40 01
			15 00 00 00 00 00 02 41 58
			15 00 00 00 00 00 02 42 01
			15 00 00 00 00 00 02 43 62
			15 00 00 00 00 00 02 44 01
			15 00 00 00 00 00 02 45 6A
			15 00 00 00 00 00 02 46 01
			15 00 00 00 00 00 02 47 8A
			15 00 00 00 00 00 02 48 01
			15 00 00 00 00 00 02 49 A4
			15 00 00 00 00 00 02 4A 01
			15 00 00 00 00 00 02 4B CD
			15 00 00 00 00 00 02 4C 01
			15 00 00 00 00 00 02 4D F0
			15 00 00 00 00 00 02 4E 02
			15 00 00 00 00 00 02 4F 27
			15 00 00 00 00 00 02 50 02
			15 00 00 00 00 00 02 51 57
			15 00 00 00 00 00 02 52 02
			15 00 00 00 00 00 02 53 59
			15 00 00 00 00 00 02 54 02
			15 00 00 00 00 00 02 55 88
			15 00 00 00 00 00 02 56 02
			15 00 00 00 00 00 02 58 C0
			15 00 00 00 00 00 02 59 02
			15 00 00 00 00 00 02 5A E3
			15 00 00 00 00 00 02 5B 03
			15 00 00 00 00 00 02 5C 12
			15 00 00 00 00 00 02 5D 03
			15 00 00 00 00 00 02 5E 2A
			15 00 00 00 00 00 02 5F 03
			15 00 00 00 00 00 02 60 4C
			15 00 00 00 00 00 02 61 03
			15 00 00 00 00 00 02 62 57
			15 00 00 00 00 00 02 63 03
			15 00 00 00 00 00 02 64 62
			15 00 00 00 00 00 02 65 03
			15 00 00 00 00 00 02 66 6F
			15 00 00 00 00 00 02 67 03
			15 00 00 00 00 00 02 68 7E
			15 00 00 00 00 00 02 69 03
			15 00 00 00 00 00 02 6A 8D
			15 00 00 00 00 00 02 6B 03
			15 00 00 00 00 00 02 6C A3
			15 00 00 00 00 00 02 6D 03
			15 00 00 00 00 00 02 6E C0
			15 00 00 00 00 00 02 6F 03
			15 01 00 00 00 00 02 70 C1
			//B(+) MCR cmd
			15 00 00 00 00 00 02 71 01
			15 00 00 00 00 00 02 72 96
			15 00 00 00 00 00 02 73 01
			15 00 00 00 00 00 02 74 98
			15 00 00 00 00 00 02 75 01
			15 00 00 00 00 00 02 76 9D
			15 00 00 00 00 00 02 77 01
			15 00 00 00 00 00 02 78 A3
			15 00 00 00 00 00 02 79 01
			15 00 00 00 00 00 02 7A A8
			15 00 00 00 00 00 02 7B 01
			15 00 00 00 00 00 02 7C AD
			15 00 00 00 00 00 02 7D 01
			15 00 00 00 00 00 02 7E B2
			15 00 00 00 00 00 02 7F 01
			15 00 00 00 00 00 02 80 B7
			15 00 00 00 00 00 02 81 01
			15 00 00 00 00 00 02 82 BC
			15 00 00 00 00 00 02 83 01
			15 00 00 00 00 00 02 84 CE
			15 00 00 00 00 00 02 85 01
			15 00 00 00 00 00 02 86 DF
			15 00 00 00 00 00 02 87 01
			15 00 00 00 00 00 02 88 FD
			15 00 00 00 00 00 02 89 02
			15 00 00 00 00 00 02 8A 17
			15 00 00 00 00 00 02 8B 02
			15 00 00 00 00 00 02 8C 46
			15 00 00 00 00 00 02 8D 02
			15 00 00 00 00 00 02 8E 6F
			15 00 00 00 00 00 02 8F 02
			15 00 00 00 00 00 02 90 71
			15 00 00 00 00 00 02 91 02
			15 00 00 00 00 00 02 92 9C
			15 00 00 00 00 00 02 93 02
			15 00 00 00 00 00 02 94 D2
			15 00 00 00 00 00 02 95 02
			15 00 00 00 00 00 02 96 F4
			15 00 00 00 00 00 02 97 03
			15 00 00 00 00 00 02 98 21
			15 00 00 00 00 00 02 99 03
			15 00 00 00 00 00 02 9A 44
			15 00 00 00 00 00 02 9B 03
			15 00 00 00 00 00 02 9C 71
			15 00 00 00 00 00 02 9D 03
			15 00 00 00 00 00 02 9E 7B
			15 00 00 00 00 00 02 9F 03
			15 00 00 00 00 00 02 A0 8B
			15 00 00 00 00 00 02 A2 03
			15 00 00 00 00 00 02 A3 97
			15 00 00 00 00 00 02 A4 03
			15 00 00 00 00 00 02 A5 A9
			15 00 00 00 00 00 02 A6 03
			15 00 00 00 00 00 02 A7 BA
			15 00 00 00 00 00 02 A9 03
			15 00 00 00 00 00 02 AA E4
			15 00 00 00 00 00 02 AB 03
			15 00 00 00 00 00 02 AC EF
			15 00 00 00 00 00 02 AD 03
			15 01 00 00 00 00 02 AE F0
			//B(-) MCR cmd
			15 00 00 00 00 00 02 AF 01
			15 00 00 00 00 00 02 B0 A7
			15 00 00 00 00 00 02 B1 01
			15 00 00 00 00 00 02 B2 A9
			15 00 00 00 00 00 02 B3 01
			15 00 00 00 00 00 02 B4 AE
			15 00 00 00 00 00 02 B5 01
			15 00 00 00 00 00 02 B6 B2
			15 00 00 00 00 00 02 B7 01
			15 00 00 00 00 00 02 B8 B7
			15 00 00 00 00 00 02 B9 01
			15 00 00 00 00 00 02 BA BC
			15 00 00 00 00 00 02 BB 01
			15 00 00 00 00 00 02 BC C1
			15 00 00 00 00 00 02 BD 01
			15 00 00 00 00 00 02 BE C6
			15 00 00 00 00 00 02 BF 01
			15 00 00 00 00 00 02 C0 C9
			15 00 00 00 00 00 02 C1 01
			15 00 00 00 00 00 02 C2 DB
			15 00 00 00 00 00 02 C3 01
			15 00 00 00 00 00 02 C4 EA
			15 00 00 00 00 00 02 C5 02
			15 00 00 00 00 00 02 C6 04
			15 00 00 00 00 00 02 C7 02
			15 00 00 00 00 00 02 C8 1B
			15 00 00 00 00 00 02 C9 02
			15 00 00 00 00 00 02 CA 46
			15 00 00 00 00 00 02 CB 02
			15 00 00 00 00 00 02 CC 6F
			15 00 00 00 00 00 02 CD 02
			15 00 00 00 00 00 02 CE 71
			15 00 00 00 00 00 02 CF 02
			15 00 00 00 00 00 02 D0 9C
			15 00 00 00 00 00 02 D1 02
			15 00 00 00 00 00 02 D2 D2
			15 00 00 00 00 00 02 D3 02
			15 00 00 00 00 00 02 D4 F4
			15 00 00 00 00 00 02 D5 03
			15 00 00 00 00 00 02 D6 21
			15 00 00 00 00 00 02 D7 03
			15 00 00 00 00 00 02 D8 37
			15 00 00 00 00 00 02 D9 03
			15 00 00 00 00 00 02 DA 58
			15 00 00 00 00 00 02 DB 03
			15 00 00 00 00 00 02 DC 60
			15 00 00 00 00 00 02 DD 03
			15 00 00 00 00 00 02 DE 6C
			15 00 00 00 00 00 02 DF 03
			15 00 00 00 00 00 02 E0 76
			15 00 00 00 00 00 02 E1 03
			15 00 00 00 00 00 02 E2 84
			15 00 00 00 00 00 02 E3 03
			15 00 00 00 00 00 02 E4 92
			15 00 00 00 00 00 02 E5 03
			15 00 00 00 00 00 02 E6 B9
			15 00 00 00 00 00 02 E7 03
			15 00 00 00 00 00 02 E8 C0
			15 00 00 00 00 00 02 E9 03
			15 00 00 00 00 00 02 EA C1
			15 01 00 00 00 00 02 FF 00
		];

		qcom,panel-reader-mode-initial-step2-command = [
			//page selection cmd start
			15 01 00 00 00 00 02 FF 01
			15 01 00 00 00 00 02 FB 01
			//page selection cmd end
			//R(+) MCR cmd
			15 01 00 00 00 00 02 75 00
			15 01 00 00 00 00 02 76 28
			15 01 00 00 00 00 02 77 00
			15 01 00 00 00 00 02 78 3B
			15 01 00 00 00 00 02 79 00
			15 01 00 00 00 00 02 7A 6E
			15 01 00 00 00 00 02 7B 00
			15 01 00 00 00 00 02 7C 8F
			15 01 00 00 00 00 02 7D 00
			15 01 00 00 00 00 02 7E AD
			15 01 00 00 00 00 02 7F 00
			15 01 00 00 00 00 02 80 C5
			15 01 00 00 00 00 02 81 00
			15 01 00 00 00 00 02 82 DB
			15 01 00 00 00 00 02 83 00
			15 01 00 00 00 00 02 84 EE
			15 01 00 00 00 00 02 85 00
			15 01 00 00 00 00 02 86 FF
			15 01 00 00 00 00 02 87 01
			15 01 00 00 00 00 02 88 35
			15 01 00 00 00 00 02 89 01
			15 01 00 00 00 00 02 8A 60
			15 01 00 00 00 00 02 8B 01
			15 01 00 00 00 00 02 8C A0
			15 01 00 00 00 00 02 8D 01
			15 01 00 00 00 00 02 8E CE
			15 01 00 00 00 00 02 8F 02
			15 01 00 00 00 00 02 90 15
			15 01 00 00 00 00 02 91 02
			15 01 00 00 00 00 02 92 4A
			15 01 00 00 00 00 02 93 02
			15 01 00 00 00 00 02 94 4C
			15 01 00 00 00 00 02 95 02
			15 01 00 00 00 00 02 96 7F
			15 01 00 00 00 00 02 97 02
			15 01 00 00 00 00 02 98 B7
			15 01 00 00 00 00 02 99 02
			15 01 00 00 00 00 02 9A DC
			15 01 00 00 00 00 02 9B 03
			15 01 00 00 00 00 02 9C 0C
			15 01 00 00 00 00 02 9D 03
			15 01 00 00 00 00 02 9E 31
			15 01 00 00 00 00 02 9F 03
			15 01 00 00 00 00 02 A0 5F
			15 01 00 00 00 00 02 A2 03
			15 01 00 00 00 00 02 A3 6D
			15 01 00 00 00 00 02 A4 03
			15 01 00 00 00 00 02 A5 7C
			15 01 00 00 00 00 02 A6 03
			15 01 00 00 00 00 02 A7 8A
			15 01 00 00 00 00 02 A9 03
			15 01 00 00 00 00 02 AA 9F
			15 01 00 00 00 00 02 AB 03
			15 01 00 00 00 00 02 AC B5
			15 01 00 00 00 00 02 AD 03
			15 01 00 00 00 00 02 AE DD
			15 01 00 00 00 00 02 AF 03
			15 01 00 00 00 00 02 B0 EF
			15 01 00 00 00 00 02 B1 03
			15 01 00 00 00 00 02 B2 F0
			//R(-) MCR cmd
			15 01 00 00 00 00 02 B3 00
			15 01 00 00 00 00 02 B4 38
			15 01 00 00 00 00 02 B5 00
			15 01 00 00 00 00 02 B6 4C
			15 01 00 00 00 00 02 B7 00
			15 01 00 00 00 00 02 B8 7F
			15 01 00 00 00 00 02 B9 00
			15 01 00 00 00 00 02 BA 9E
			15 01 00 00 00 00 02 BB 00
			15 01 00 00 00 00 02 BC BC
			15 01 00 00 00 00 02 BD 00
			15 01 00 00 00 00 02 BE D4
			15 01 00 00 00 00 02 BF 00
			15 01 00 00 00 00 02 C0 EA
			15 01 00 00 00 00 02 C1 00
			15 01 00 00 00 00 02 C2 FD
			15 01 00 00 00 00 02 C3 01
			15 01 00 00 00 00 02 C4 0C
			15 01 00 00 00 00 02 C5 01
			15 01 00 00 00 00 02 C6 42
			15 01 00 00 00 00 02 C7 01
			15 01 00 00 00 00 02 C8 6B
			15 01 00 00 00 00 02 C9 01
			15 01 00 00 00 00 02 CA A7
			15 01 00 00 00 00 02 CB 01
			15 01 00 00 00 00 02 CC D3
			15 01 00 00 00 00 02 CD 02
			15 01 00 00 00 00 02 CE 15
			15 01 00 00 00 00 02 CF 02
			15 01 00 00 00 00 02 D0 4A
			15 01 00 00 00 00 02 D1 02
			15 01 00 00 00 00 02 D2 4C
			15 01 00 00 00 00 02 D3 02
			15 01 00 00 00 00 02 D4 7F
			15 01 00 00 00 00 02 D5 02
			15 01 00 00 00 00 02 D6 B7
			15 01 00 00 00 00 02 D7 02
			15 01 00 00 00 00 02 D8 DC
			15 01 00 00 00 00 02 D9 03
			15 01 00 00 00 00 02 DA 0C
			15 01 00 00 00 00 02 DB 03
			15 01 00 00 00 00 02 DC 24
			15 01 00 00 00 00 02 DD 03
			15 01 00 00 00 00 02 DE 46
			15 01 00 00 00 00 02 DF 03
			15 01 00 00 00 00 02 E0 52
			15 01 00 00 00 00 02 E1 03
			15 01 00 00 00 00 02 E2 5D
			15 01 00 00 00 00 02 E3 03
			15 01 00 00 00 00 02 E4 69
			15 01 00 00 00 00 02 E5 03
			15 01 00 00 00 00 02 E6 7A
			15 01 00 00 00 00 02 E7 03
			15 01 00 00 00 00 02 E8 8D
			15 01 00 00 00 00 02 E9 03
			15 01 00 00 00 00 02 EA B2
			15 01 00 00 00 00 02 EB 03
			15 01 00 00 00 00 02 EC C0
			15 01 00 00 00 00 02 ED 03
			15 01 00 00 00 00 02 EE C1
			//G(+) MCR cmd
			15 01 00 00 00 00 02 EF 01
			15 01 00 00 00 00 02 F0 3E
			15 01 00 00 00 00 02 F1 01
			15 01 00 00 00 00 02 F2 43
			15 01 00 00 00 00 02 F3 01
			15 01 00 00 00 00 02 F4 4D
			15 01 00 00 00 00 02 F5 01
			15 01 00 00 00 00 02 F6 57
			15 01 00 00 00 00 02 F7 01
			15 01 00 00 00 00 02 F8 5F
			15 01 00 00 00 00 02 F9 01
			15 01 00 00 00 00 02 FA 67
			//page selection cmd start
			15 01 00 00 00 00 02 FF 02
			15 01 00 00 00 00 02 FB 01
			//page selection cmd end
			15 01 00 00 00 00 02 00 01
			15 01 00 00 00 00 02 01 6E
			15 01 00 00 00 00 02 02 01
			15 01 00 00 00 00 02 03 76
			15 01 00 00 00 00 02 04 01
			15 01 00 00 00 00 02 05 7E
			15 01 00 00 00 00 02 06 01
			15 01 00 00 00 00 02 07 98
			15 01 00 00 00 00 02 08 01
			15 01 00 00 00 00 02 09 AF
			15 01 00 00 00 00 02 0A 01
			15 01 00 00 00 00 02 0B D7
			15 01 00 00 00 00 02 0C 01
			15 01 00 00 00 00 02 0D F8
			15 01 00 00 00 00 02 0E 02
			15 01 00 00 00 00 02 0F 30
			15 01 00 00 00 00 02 10 02
			15 01 00 00 00 00 02 11 5D
			15 01 00 00 00 00 02 12 02
			15 01 00 00 00 00 02 13 5F
			15 01 00 00 00 00 02 14 02
			15 01 00 00 00 00 02 15 8E
			15 01 00 00 00 00 02 16 02
			15 01 00 00 00 00 02 17 C4
			15 01 00 00 00 00 02 18 02
			15 01 00 00 00 00 02 19 E8
			15 01 00 00 00 00 02 1A 03
			15 01 00 00 00 00 02 1B 17
			15 01 00 00 00 00 02 1C 03
			15 01 00 00 00 00 02 1D 3B
			15 01 00 00 00 00 02 1E 03
			15 01 00 00 00 00 02 1F 68
			15 01 00 00 00 00 02 20 03
			15 01 00 00 00 00 02 21 74
			15 01 00 00 00 00 02 22 03
			15 01 00 00 00 00 02 23 84
			15 01 00 00 00 00 02 24 03
			15 01 00 00 00 00 02 25 92
			15 01 00 00 00 00 02 26 03
			15 01 00 00 00 00 02 27 A5
			15 01 00 00 00 00 02 28 03
			15 01 00 00 00 00 02 29 B6
			15 01 00 00 00 00 02 2A 03
			15 01 00 00 00 00 02 2B D3
			15 01 00 00 00 00 02 2D 03
			15 01 00 00 00 00 02 2F EF
			15 01 00 00 00 00 02 30 03
			15 01 00 00 00 00 02 31 F0
			//G(-) MCR cmd
			15 01 00 00 00 00 02 32 01
			15 01 00 00 00 00 02 33 4F
			15 01 00 00 00 00 02 34 01
			15 01 00 00 00 00 02 35 54
			15 01 00 00 00 00 02 36 01
			15 01 00 00 00 00 02 37 5E
			15 01 00 00 00 00 02 38 01
			15 01 00 00 00 00 02 39 66
			15 01 00 00 00 00 02 3A 01
			15 01 00 00 00 00 02 3B 6E
			15 01 00 00 00 00 02 3D 01
			15 01 00 00 00 00 02 3F 76
			15 01 00 00 00 00 02 40 01
			15 01 00 00 00 00 02 41 7D
			15 01 00 00 00 00 02 42 01
			15 01 00 00 00 00 02 43 85
			15 01 00 00 00 00 02 44 01
			15 01 00 00 00 00 02 45 8B
			15 01 00 00 00 00 02 46 01
			15 01 00 00 00 00 02 47 A5
			15 01 00 00 00 00 02 48 01
			15 01 00 00 00 00 02 49 BA
			15 01 00 00 00 00 02 4A 01
			15 01 00 00 00 00 02 4B DE
			15 01 00 00 00 00 02 4C 01
			15 01 00 00 00 00 02 4D FC
			15 01 00 00 00 00 02 4E 02
			15 01 00 00 00 00 02 4F 30
			15 01 00 00 00 00 02 50 02
			15 01 00 00 00 00 02 51 5D
			15 01 00 00 00 00 02 52 02
			15 01 00 00 00 00 02 53 5F
			15 01 00 00 00 00 02 54 02
			15 01 00 00 00 00 02 55 8E
			15 01 00 00 00 00 02 56 02
			15 01 00 00 00 00 02 58 C4
			15 01 00 00 00 00 02 59 02
			15 01 00 00 00 00 02 5A E8
			15 01 00 00 00 00 02 5B 03
			15 01 00 00 00 00 02 5C 17
			15 01 00 00 00 00 02 5D 03
			15 01 00 00 00 00 02 5E 2E
			15 01 00 00 00 00 02 5F 03
			15 01 00 00 00 00 02 60 4F
			15 01 00 00 00 00 02 61 03
			15 01 00 00 00 00 02 62 59
			15 01 00 00 00 00 02 63 03
			15 01 00 00 00 00 02 64 65
			15 01 00 00 00 00 02 65 03
			15 01 00 00 00 00 02 66 71
			15 01 00 00 00 00 02 67 03
			15 01 00 00 00 00 02 68 80
			15 01 00 00 00 00 02 69 03
			15 01 00 00 00 00 02 6A 8E
			15 01 00 00 00 00 02 6B 03
			15 01 00 00 00 00 02 6C A8
			15 01 00 00 00 00 02 6D 03
			15 01 00 00 00 00 02 6E C0
			15 01 00 00 00 00 02 6F 03
			15 01 00 00 00 00 02 70 C1
			//B(+) MCR cmd
			15 01 00 00 00 00 02 71 01
			15 01 00 00 00 00 02 72 CA
			15 01 00 00 00 00 02 73 01
			15 01 00 00 00 00 02 74 CB
			15 01 00 00 00 00 02 75 01
			15 01 00 00 00 00 02 76 CF
			15 01 00 00 00 00 02 77 01
			15 01 00 00 00 00 02 78 D3
			15 01 00 00 00 00 02 79 01
			15 01 00 00 00 00 02 7A D7
			15 01 00 00 00 00 02 7B 01
			15 01 00 00 00 00 02 7C DB
			15 01 00 00 00 00 02 7D 01
			15 01 00 00 00 00 02 7E DE
			15 01 00 00 00 00 02 7F 01
			15 01 00 00 00 00 02 80 E2
			15 01 00 00 00 00 02 81 01
			15 01 00 00 00 00 02 82 E6
			15 01 00 00 00 00 02 83 01
			15 01 00 00 00 00 02 84 F3
			15 01 00 00 00 00 02 85 02
			15 01 00 00 00 00 02 86 00
			15 01 00 00 00 00 02 87 02
			15 01 00 00 00 00 02 88 19
			15 01 00 00 00 00 02 89 02
			15 01 00 00 00 00 02 8A 2E
			15 01 00 00 00 00 02 8B 02
			15 01 00 00 00 00 02 8C 58
			15 01 00 00 00 00 02 8D 02
			15 01 00 00 00 00 02 8E 7D
			15 01 00 00 00 00 02 8F 02
			15 01 00 00 00 00 02 90 7E
			15 01 00 00 00 00 02 91 02
			15 01 00 00 00 00 02 92 A8
			15 01 00 00 00 00 02 93 02
			15 01 00 00 00 00 02 94 DB
			15 01 00 00 00 00 02 95 02
			15 01 00 00 00 00 02 96 FD
			15 01 00 00 00 00 02 97 03
			15 01 00 00 00 00 02 98 2A
			15 01 00 00 00 00 02 99 03
			15 01 00 00 00 00 02 9A 4D
			15 01 00 00 00 00 02 9B 03
			15 01 00 00 00 00 02 9C 76
			15 01 00 00 00 00 02 9D 03
			15 01 00 00 00 00 02 9E 83
			15 01 00 00 00 00 02 9F 03
			15 01 00 00 00 00 02 A0 90
			15 01 00 00 00 00 02 A2 03
			15 01 00 00 00 00 02 A3 9D
			15 01 00 00 00 00 02 A4 03
			15 01 00 00 00 00 02 A5 AD
			15 01 00 00 00 00 02 A6 03
			15 01 00 00 00 00 02 A7 BE
			15 01 00 00 00 00 02 A9 03
			15 01 00 00 00 00 02 AA E9
			15 01 00 00 00 00 02 AB 03
			15 01 00 00 00 00 02 AC EF
			15 01 00 00 00 00 02 AD 03
			15 01 00 00 00 00 02 AE F0
			//B(-) MCR cmd
			15 01 00 00 00 00 02 AF 01
			15 01 00 00 00 00 02 B0 DB
			15 01 00 00 00 00 02 B1 01
			15 01 00 00 00 00 02 B2 DC
			15 01 00 00 00 00 02 B3 01
			15 01 00 00 00 00 02 B4 E0
			15 01 00 00 00 00 02 B5 01
			15 01 00 00 00 00 02 B6 E2
			15 01 00 00 00 00 02 B7 01
			15 01 00 00 00 00 02 B8 E6
			15 01 00 00 00 00 02 B9 01
			15 01 00 00 00 00 02 BA EA
			15 01 00 00 00 00 02 BB 01
			15 01 00 00 00 00 02 BC ED
			15 01 00 00 00 00 02 BD 01
			15 01 00 00 00 00 02 BE F1
			15 01 00 00 00 00 02 BF 01
			15 01 00 00 00 00 02 C0 F4
			15 01 00 00 00 00 02 C1 02
			15 01 00 00 00 00 02 C2 00
			15 01 00 00 00 00 02 C3 02
			15 01 00 00 00 00 02 C4 0B
			15 01 00 00 00 00 02 C5 02
			15 01 00 00 00 00 02 C6 20
			15 01 00 00 00 00 02 C7 02
			15 01 00 00 00 00 02 C8 33
			15 01 00 00 00 00 02 C9 02
			15 01 00 00 00 00 02 CA 58
			15 01 00 00 00 00 02 CB 02
			15 01 00 00 00 00 02 CC 7D
			15 01 00 00 00 00 02 CD 02
			15 01 00 00 00 00 02 CE 7E
			15 01 00 00 00 00 02 CF 02
			15 01 00 00 00 00 02 D0 A8
			15 01 00 00 00 00 02 D1 02
			15 01 00 00 00 00 02 D2 DB
			15 01 00 00 00 00 02 D3 02
			15 01 00 00 00 00 02 D4 FD
			15 01 00 00 00 00 02 D5 03
			15 01 00 00 00 00 02 D6 2A
			15 01 00 00 00 00 02 D7 03
			15 01 00 00 00 00 02 D8 40
			15 01 00 00 00 00 02 D9 03
			15 01 00 00 00 00 02 DA 5D
			15 01 00 00 00 00 02 DB 03
			15 01 00 00 00 00 02 DC 68
			15 01 00 00 00 00 02 DD 03
			15 01 00 00 00 00 02 DE 71
			15 01 00 00 00 00 02 DF 03
			15 01 00 00 00 00 02 E0 7C
			15 01 00 00 00 00 02 E1 03
			15 01 00 00 00 00 02 E2 88
			15 01 00 00 00 00 02 E3 03
			15 01 00 00 00 00 02 E4 96
			15 01 00 00 00 00 02 E5 03
			15 01 00 00 00 00 02 E6 BE
			15 01 00 00 00 00 02 E7 03
			15 01 00 00 00 00 02 E8 C0
			15 01 00 00 00 00 02 E9 03
			15 01 00 00 00 00 02 EA C1
			15 01 00 00 00 00 02 FF 00
		];

		qcom,panel-reader-mode-step2-command = [
			//page selection cmd start
			15 00 00 00 00 00 02 FF 01
			15 00 00 00 00 00 02 FB 01
			//page selection cmd end
			//R(+) MCR cmd
			15 00 00 00 00 00 02 75 00
			15 00 00 00 00 00 02 76 28
			15 00 00 00 00 00 02 77 00
			15 00 00 00 00 00 02 78 3B
			15 00 00 00 00 00 02 79 00
			15 00 00 00 00 00 02 7A 6E
			15 00 00 00 00 00 02 7B 00
			15 00 00 00 00 00 02 7C 8F
			15 00 00 00 00 00 02 7D 00
			15 00 00 00 00 00 02 7E AD
			15 00 00 00 00 00 02 7F 00
			15 00 00 00 00 00 02 80 C5
			15 00 00 00 00 00 02 81 00
			15 00 00 00 00 00 02 82 DB
			15 00 00 00 00 00 02 83 00
			15 00 00 00 00 00 02 84 EE
			15 00 00 00 00 00 02 85 00
			15 00 00 00 00 00 02 86 FF
			15 00 00 00 00 00 02 87 01
			15 00 00 00 00 00 02 88 35
			15 00 00 00 00 00 02 89 01
			15 00 00 00 00 00 02 8A 60
			15 00 00 00 00 00 02 8B 01
			15 00 00 00 00 00 02 8C A0
			15 00 00 00 00 00 02 8D 01
			15 00 00 00 00 00 02 8E CE
			15 00 00 00 00 00 02 8F 02
			15 00 00 00 00 00 02 90 15
			15 00 00 00 00 00 02 91 02
			15 00 00 00 00 00 02 92 4A
			15 00 00 00 00 00 02 93 02
			15 00 00 00 00 00 02 94 4C
			15 00 00 00 00 00 02 95 02
			15 00 00 00 00 00 02 96 7F
			15 00 00 00 00 00 02 97 02
			15 00 00 00 00 00 02 98 B7
			15 00 00 00 00 00 02 99 02
			15 00 00 00 00 00 02 9A DC
			15 00 00 00 00 00 02 9B 03
			15 00 00 00 00 00 02 9C 0C
			15 00 00 00 00 00 02 9D 03
			15 00 00 00 00 00 02 9E 31
			15 00 00 00 00 00 02 9F 03
			15 00 00 00 00 00 02 A0 5F
			15 00 00 00 00 00 02 A2 03
			15 00 00 00 00 00 02 A3 6D
			15 00 00 00 00 00 02 A4 03
			15 00 00 00 00 00 02 A5 7C
			15 00 00 00 00 00 02 A6 03
			15 00 00 00 00 00 02 A7 8A
			15 00 00 00 00 00 02 A9 03
			15 00 00 00 00 00 02 AA 9F
			15 00 00 00 00 00 02 AB 03
			15 00 00 00 00 00 02 AC B5
			15 00 00 00 00 00 02 AD 03
			15 00 00 00 00 00 02 AE DD
			15 00 00 00 00 00 02 AF 03
			15 00 00 00 00 00 02 B0 EF
			15 00 00 00 00 00 02 B1 03
			15 01 00 00 00 00 02 B2 F0
			//R(-) MCR cmd
			15 00 00 00 00 00 02 B3 00
			15 00 00 00 00 00 02 B4 38
			15 00 00 00 00 00 02 B5 00
			15 00 00 00 00 00 02 B6 4C
			15 00 00 00 00 00 02 B7 00
			15 00 00 00 00 00 02 B8 7F
			15 00 00 00 00 00 02 B9 00
			15 00 00 00 00 00 02 BA 9E
			15 00 00 00 00 00 02 BB 00
			15 00 00 00 00 00 02 BC BC
			15 00 00 00 00 00 02 BD 00
			15 00 00 00 00 00 02 BE D4
			15 00 00 00 00 00 02 BF 00
			15 00 00 00 00 00 02 C0 EA
			15 00 00 00 00 00 02 C1 00
			15 00 00 00 00 00 02 C2 FD
			15 00 00 00 00 00 02 C3 01
			15 00 00 00 00 00 02 C4 0C
			15 00 00 00 00 00 02 C5 01
			15 00 00 00 00 00 02 C6 42
			15 00 00 00 00 00 02 C7 01
			15 00 00 00 00 00 02 C8 6B
			15 00 00 00 00 00 02 C9 01
			15 00 00 00 00 00 02 CA A7
			15 00 00 00 00 00 02 CB 01
			15 00 00 00 00 00 02 CC D3
			15 00 00 00 00 00 02 CD 02
			15 00 00 00 00 00 02 CE 15
			15 00 00 00 00 00 02 CF 02
			15 00 00 00 00 00 02 D0 4A
			15 00 00 00 00 00 02 D1 02
			15 00 00 00 00 00 02 D2 4C
			15 00 00 00 00 00 02 D3 02
			15 00 00 00 00 00 02 D4 7F
			15 00 00 00 00 00 02 D5 02
			15 00 00 00 00 00 02 D6 B7
			15 00 00 00 00 00 02 D7 02
			15 00 00 00 00 00 02 D8 DC
			15 00 00 00 00 00 02 D9 03
			15 00 00 00 00 00 02 DA 0C
			15 00 00 00 00 00 02 DB 03
			15 00 00 00 00 00 02 DC 24
			15 00 00 00 00 00 02 DD 03
			15 00 00 00 00 00 02 DE 46
			15 00 00 00 00 00 02 DF 03
			15 00 00 00 00 00 02 E0 52
			15 00 00 00 00 00 02 E1 03
			15 00 00 00 00 00 02 E2 5D
			15 00 00 00 00 00 02 E3 03
			15 00 00 00 00 00 02 E4 69
			15 00 00 00 00 00 02 E5 03
			15 00 00 00 00 00 02 E6 7A
			15 00 00 00 00 00 02 E7 03
			15 00 00 00 00 00 02 E8 8D
			15 00 00 00 00 00 02 E9 03
			15 00 00 00 00 00 02 EA B2
			15 00 00 00 00 00 02 EB 03
			15 00 00 00 00 00 02 EC C0
			15 00 00 00 00 00 02 ED 03
			15 01 00 00 00 00 02 EE C1
			//G(+) MCR cmd
			15 00 00 00 00 00 02 EF 01
			15 00 00 00 00 00 02 F0 3E
			15 00 00 00 00 00 02 F1 01
			15 00 00 00 00 00 02 F2 43
			15 00 00 00 00 00 02 F3 01
			15 00 00 00 00 00 02 F4 4D
			15 00 00 00 00 00 02 F5 01
			15 00 00 00 00 00 02 F6 57
			15 00 00 00 00 00 02 F7 01
			15 00 00 00 00 00 02 F8 5F
			15 00 00 00 00 00 02 F9 01
			15 00 00 00 00 00 02 FA 67
			//page selection cmd start
			15 00 00 00 00 00 02 FF 02
			15 00 00 00 00 00 02 FB 01
			//page selection cmd end
			15 00 00 00 00 00 02 00 01
			15 00 00 00 00 00 02 01 6E
			15 00 00 00 00 00 02 02 01
			15 00 00 00 00 00 02 03 76
			15 00 00 00 00 00 02 04 01
			15 00 00 00 00 00 02 05 7E
			15 00 00 00 00 00 02 06 01
			15 00 00 00 00 00 02 07 98
			15 00 00 00 00 00 02 08 01
			15 00 00 00 00 00 02 09 AF
			15 00 00 00 00 00 02 0A 01
			15 00 00 00 00 00 02 0B D7
			15 00 00 00 00 00 02 0C 01
			15 00 00 00 00 00 02 0D F8
			15 00 00 00 00 00 02 0E 02
			15 00 00 00 00 00 02 0F 30
			15 00 00 00 00 00 02 10 02
			15 00 00 00 00 00 02 11 5D
			15 00 00 00 00 00 02 12 02
			15 00 00 00 00 00 02 13 5F
			15 00 00 00 00 00 02 14 02
			15 00 00 00 00 00 02 15 8E
			15 00 00 00 00 00 02 16 02
			15 00 00 00 00 00 02 17 C4
			15 00 00 00 00 00 02 18 02
			15 00 00 00 00 00 02 19 E8
			15 00 00 00 00 00 02 1A 03
			15 00 00 00 00 00 02 1B 17
			15 00 00 00 00 00 02 1C 03
			15 00 00 00 00 00 02 1D 3B
			15 00 00 00 00 00 02 1E 03
			15 00 00 00 00 00 02 1F 68
			15 00 00 00 00 00 02 20 03
			15 00 00 00 00 00 02 21 74
			15 00 00 00 00 00 02 22 03
			15 00 00 00 00 00 02 23 84
			15 00 00 00 00 00 02 24 03
			15 00 00 00 00 00 02 25 92
			15 00 00 00 00 00 02 26 03
			15 00 00 00 00 00 02 27 A5
			15 00 00 00 00 00 02 28 03
			15 00 00 00 00 00 02 29 B6
			15 00 00 00 00 00 02 2A 03
			15 00 00 00 00 00 02 2B D3
			15 00 00 00 00 00 02 2D 03
			15 00 00 00 00 00 02 2F EF
			15 00 00 00 00 00 02 30 03
			15 01 00 00 00 00 02 31 F0
			//G(-) MCR cmd
			15 00 00 00 00 00 02 32 01
			15 00 00 00 00 00 02 33 4F
			15 00 00 00 00 00 02 34 01
			15 00 00 00 00 00 02 35 54
			15 00 00 00 00 00 02 36 01
			15 00 00 00 00 00 02 37 5E
			15 00 00 00 00 00 02 38 01
			15 00 00 00 00 00 02 39 66
			15 00 00 00 00 00 02 3A 01
			15 00 00 00 00 00 02 3B 6E
			15 00 00 00 00 00 02 3D 01
			15 00 00 00 00 00 02 3F 76
			15 00 00 00 00 00 02 40 01
			15 00 00 00 00 00 02 41 7D
			15 00 00 00 00 00 02 42 01
			15 00 00 00 00 00 02 43 85
			15 00 00 00 00 00 02 44 01
			15 00 00 00 00 00 02 45 8B
			15 00 00 00 00 00 02 46 01
			15 00 00 00 00 00 02 47 A5
			15 00 00 00 00 00 02 48 01
			15 00 00 00 00 00 02 49 BA
			15 00 00 00 00 00 02 4A 01
			15 00 00 00 00 00 02 4B DE
			15 00 00 00 00 00 02 4C 01
			15 00 00 00 00 00 02 4D FC
			15 00 00 00 00 00 02 4E 02
			15 00 00 00 00 00 02 4F 30
			15 00 00 00 00 00 02 50 02
			15 00 00 00 00 00 02 51 5D
			15 00 00 00 00 00 02 52 02
			15 00 00 00 00 00 02 53 5F
			15 00 00 00 00 00 02 54 02
			15 00 00 00 00 00 02 55 8E
			15 00 00 00 00 00 02 56 02
			15 00 00 00 00 00 02 58 C4
			15 00 00 00 00 00 02 59 02
			15 00 00 00 00 00 02 5A E8
			15 00 00 00 00 00 02 5B 03
			15 00 00 00 00 00 02 5C 17
			15 00 00 00 00 00 02 5D 03
			15 00 00 00 00 00 02 5E 2E
			15 00 00 00 00 00 02 5F 03
			15 00 00 00 00 00 02 60 4F
			15 00 00 00 00 00 02 61 03
			15 00 00 00 00 00 02 62 59
			15 00 00 00 00 00 02 63 03
			15 00 00 00 00 00 02 64 65
			15 00 00 00 00 00 02 65 03
			15 00 00 00 00 00 02 66 71
			15 00 00 00 00 00 02 67 03
			15 00 00 00 00 00 02 68 80
			15 00 00 00 00 00 02 69 03
			15 00 00 00 00 00 02 6A 8E
			15 00 00 00 00 00 02 6B 03
			15 00 00 00 00 00 02 6C A8
			15 00 00 00 00 00 02 6D 03
			15 00 00 00 00 00 02 6E C0
			15 00 00 00 00 00 02 6F 03
			15 01 00 00 00 00 02 70 C1
			//B(+) MCR cmd
			15 00 00 00 00 00 02 71 01
			15 00 00 00 00 00 02 72 CA
			15 00 00 00 00 00 02 73 01
			15 00 00 00 00 00 02 74 CB
			15 00 00 00 00 00 02 75 01
			15 00 00 00 00 00 02 76 CF
			15 00 00 00 00 00 02 77 01
			15 00 00 00 00 00 02 78 D3
			15 00 00 00 00 00 02 79 01
			15 00 00 00 00 00 02 7A D7
			15 00 00 00 00 00 02 7B 01
			15 00 00 00 00 00 02 7C DB
			15 00 00 00 00 00 02 7D 01
			15 00 00 00 00 00 02 7E DE
			15 00 00 00 00 00 02 7F 01
			15 00 00 00 00 00 02 80 E2
			15 00 00 00 00 00 02 81 01
			15 00 00 00 00 00 02 82 E6
			15 00 00 00 00 00 02 83 01
			15 00 00 00 00 00 02 84 F3
			15 00 00 00 00 00 02 85 02
			15 00 00 00 00 00 02 86 00
			15 00 00 00 00 00 02 87 02
			15 00 00 00 00 00 02 88 19
			15 00 00 00 00 00 02 89 02
			15 00 00 00 00 00 02 8A 2E
			15 00 00 00 00 00 02 8B 02
			15 00 00 00 00 00 02 8C 58
			15 00 00 00 00 00 02 8D 02
			15 00 00 00 00 00 02 8E 7D
			15 00 00 00 00 00 02 8F 02
			15 00 00 00 00 00 02 90 7E
			15 00 00 00 00 00 02 91 02
			15 00 00 00 00 00 02 92 A8
			15 00 00 00 00 00 02 93 02
			15 00 00 00 00 00 02 94 DB
			15 00 00 00 00 00 02 95 02
			15 00 00 00 00 00 02 96 FD
			15 00 00 00 00 00 02 97 03
			15 00 00 00 00 00 02 98 2A
			15 00 00 00 00 00 02 99 03
			15 00 00 00 00 00 02 9A 4D
			15 00 00 00 00 00 02 9B 03
			15 00 00 00 00 00 02 9C 76
			15 00 00 00 00 00 02 9D 03
			15 00 00 00 00 00 02 9E 83
			15 00 00 00 00 00 02 9F 03
			15 00 00 00 00 00 02 A0 90
			15 00 00 00 00 00 02 A2 03
			15 00 00 00 00 00 02 A3 9D
			15 00 00 00 00 00 02 A4 03
			15 00 00 00 00 00 02 A5 AD
			15 00 00 00 00 00 02 A6 03
			15 00 00 00 00 00 02 A7 BE
			15 00 00 00 00 00 02 A9 03
			15 00 00 00 00 00 02 AA E9
			15 00 00 00 00 00 02 AB 03
			15 00 00 00 00 00 02 AC EF
			15 00 00 00 00 00 02 AD 03
			15 01 00 00 00 00 02 AE F0
			//B(-) MCR cmd
			15 00 00 00 00 00 02 AF 01
			15 00 00 00 00 00 02 B0 DB
			15 00 00 00 00 00 02 B1 01
			15 00 00 00 00 00 02 B2 DC
			15 00 00 00 00 00 02 B3 01
			15 00 00 00 00 00 02 B4 E0
			15 00 00 00 00 00 02 B5 01
			15 00 00 00 00 00 02 B6 E2
			15 00 00 00 00 00 02 B7 01
			15 00 00 00 00 00 02 B8 E6
			15 00 00 00 00 00 02 B9 01
			15 00 00 00 00 00 02 BA EA
			15 00 00 00 00 00 02 BB 01
			15 00 00 00 00 00 02 BC ED
			15 00 00 00 00 00 02 BD 01
			15 00 00 00 00 00 02 BE F1
			15 00 00 00 00 00 02 BF 01
			15 00 00 00 00 00 02 C0 F4
			15 00 00 00 00 00 02 C1 02
			15 00 00 00 00 00 02 C2 00
			15 00 00 00 00 00 02 C3 02
			15 00 00 00 00 00 02 C4 0B
			15 00 00 00 00 00 02 C5 02
			15 00 00 00 00 00 02 C6 20
			15 00 00 00 00 00 02 C7 02
			15 00 00 00 00 00 02 C8 33
			15 00 00 00 00 00 02 C9 02
			15 00 00 00 00 00 02 CA 58
			15 00 00 00 00 00 02 CB 02
			15 00 00 00 00 00 02 CC 7D
			15 00 00 00 00 00 02 CD 02
			15 00 00 00 00 00 02 CE 7E
			15 00 00 00 00 00 02 CF 02
			15 00 00 00 00 00 02 D0 A8
			15 00 00 00 00 00 02 D1 02
			15 00 00 00 00 00 02 D2 DB
			15 00 00 00 00 00 02 D3 02
			15 00 00 00 00 00 02 D4 FD
			15 00 00 00 00 00 02 D5 03
			15 00 00 00 00 00 02 D6 2A
			15 00 00 00 00 00 02 D7 03
			15 00 00 00 00 00 02 D8 40
			15 00 00 00 00 00 02 D9 03
			15 00 00 00 00 00 02 DA 5D
			15 00 00 00 00 00 02 DB 03
			15 00 00 00 00 00 02 DC 68
			15 00 00 00 00 00 02 DD 03
			15 00 00 00 00 00 02 DE 71
			15 00 00 00 00 00 02 DF 03
			15 00 00 00 00 00 02 E0 7C
			15 00 00 00 00 00 02 E1 03
			15 00 00 00 00 00 02 E2 88
			15 00 00 00 00 00 02 E3 03
			15 00 00 00 00 00 02 E4 96
			15 00 00 00 00 00 02 E5 03
			15 00 00 00 00 00 02 E6 BE
			15 00 00 00 00 00 02 E7 03
			15 00 00 00 00 00 02 E8 C0
			15 00 00 00 00 00 02 E9 03
			15 00 00 00 00 00 02 EA C1
			15 01 00 00 00 00 02 FF 00
		];

		qcom,panel-reader-mode-initial-step3-command = [
			//page selection cmd start
			15 01 00 00 00 00 02 FF 01
			15 01 00 00 00 00 02 FB 01
			//page selection cmd end
			//R(+) MCR cmd
			15 01 00 00 00 00 02 75 00
			15 01 00 00 00 00 02 76 28
			15 01 00 00 00 00 02 77 00
			15 01 00 00 00 00 02 78 3B
			15 01 00 00 00 00 02 79 00
			15 01 00 00 00 00 02 7A 6E
			15 01 00 00 00 00 02 7B 00
			15 01 00 00 00 00 02 7C 8F
			15 01 00 00 00 00 02 7D 00
			15 01 00 00 00 00 02 7E AD
			15 01 00 00 00 00 02 7F 00
			15 01 00 00 00 00 02 80 C5
			15 01 00 00 00 00 02 81 00
			15 01 00 00 00 00 02 82 DB
			15 01 00 00 00 00 02 83 00
			15 01 00 00 00 00 02 84 EE
			15 01 00 00 00 00 02 85 00
			15 01 00 00 00 00 02 86 FF
			15 01 00 00 00 00 02 87 01
			15 01 00 00 00 00 02 88 35
			15 01 00 00 00 00 02 89 01
			15 01 00 00 00 00 02 8A 60
			15 01 00 00 00 00 02 8B 01
			15 01 00 00 00 00 02 8C A0
			15 01 00 00 00 00 02 8D 01
			15 01 00 00 00 00 02 8E CE
			15 01 00 00 00 00 02 8F 02
			15 01 00 00 00 00 02 90 15
			15 01 00 00 00 00 02 91 02
			15 01 00 00 00 00 02 92 4A
			15 01 00 00 00 00 02 93 02
			15 01 00 00 00 00 02 94 4C
			15 01 00 00 00 00 02 95 02
			15 01 00 00 00 00 02 96 7F
			15 01 00 00 00 00 02 97 02
			15 01 00 00 00 00 02 98 B7
			15 01 00 00 00 00 02 99 02
			15 01 00 00 00 00 02 9A DC
			15 01 00 00 00 00 02 9B 03
			15 01 00 00 00 00 02 9C 0C
			15 01 00 00 00 00 02 9D 03
			15 01 00 00 00 00 02 9E 31
			15 01 00 00 00 00 02 9F 03
			15 01 00 00 00 00 02 A0 5F
			15 01 00 00 00 00 02 A2 03
			15 01 00 00 00 00 02 A3 6D
			15 01 00 00 00 00 02 A4 03
			15 01 00 00 00 00 02 A5 7C
			15 01 00 00 00 00 02 A6 03
			15 01 00 00 00 00 02 A7 8A
			15 01 00 00 00 00 02 A9 03
			15 01 00 00 00 00 02 AA 9F
			15 01 00 00 00 00 02 AB 03
			15 01 00 00 00 00 02 AC B5
			15 01 00 00 00 00 02 AD 03
			15 01 00 00 00 00 02 AE DD
			15 01 00 00 00 00 02 AF 03
			15 01 00 00 00 00 02 B0 EF
			15 01 00 00 00 00 02 B1 03
			15 01 00 00 00 00 02 B2 F0
			//R(-) MCR cmd
			15 01 00 00 00 00 02 B3 00
			15 01 00 00 00 00 02 B4 38
			15 01 00 00 00 00 02 B5 00
			15 01 00 00 00 00 02 B6 4C
			15 01 00 00 00 00 02 B7 00
			15 01 00 00 00 00 02 B8 7F
			15 01 00 00 00 00 02 B9 00
			15 01 00 00 00 00 02 BA 9E
			15 01 00 00 00 00 02 BB 00
			15 01 00 00 00 00 02 BC BC
			15 01 00 00 00 00 02 BD 00
			15 01 00 00 00 00 02 BE D4
			15 01 00 00 00 00 02 BF 00
			15 01 00 00 00 00 02 C0 EA
			15 01 00 00 00 00 02 C1 00
			15 01 00 00 00 00 02 C2 FD
			15 01 00 00 00 00 02 C3 01
			15 01 00 00 00 00 02 C4 0C
			15 01 00 00 00 00 02 C5 01
			15 01 00 00 00 00 02 C6 42
			15 01 00 00 00 00 02 C7 01
			15 01 00 00 00 00 02 C8 6B
			15 01 00 00 00 00 02 C9 01
			15 01 00 00 00 00 02 CA A7
			15 01 00 00 00 00 02 CB 01
			15 01 00 00 00 00 02 CC D3
			15 01 00 00 00 00 02 CD 02
			15 01 00 00 00 00 02 CE 15
			15 01 00 00 00 00 02 CF 02
			15 01 00 00 00 00 02 D0 4A
			15 01 00 00 00 00 02 D1 02
			15 01 00 00 00 00 02 D2 4C
			15 01 00 00 00 00 02 D3 02
			15 01 00 00 00 00 02 D4 7F
			15 01 00 00 00 00 02 D5 02
			15 01 00 00 00 00 02 D6 B7
			15 01 00 00 00 00 02 D7 02
			15 01 00 00 00 00 02 D8 DC
			15 01 00 00 00 00 02 D9 03
			15 01 00 00 00 00 02 DA 0C
			15 01 00 00 00 00 02 DB 03
			15 01 00 00 00 00 02 DC 24
			15 01 00 00 00 00 02 DD 03
			15 01 00 00 00 00 02 DE 46
			15 01 00 00 00 00 02 DF 03
			15 01 00 00 00 00 02 E0 52
			15 01 00 00 00 00 02 E1 03
			15 01 00 00 00 00 02 E2 5D
			15 01 00 00 00 00 02 E3 03
			15 01 00 00 00 00 02 E4 69
			15 01 00 00 00 00 02 E5 03
			15 01 00 00 00 00 02 E6 7A
			15 01 00 00 00 00 02 E7 03
			15 01 00 00 00 00 02 E8 8D
			15 01 00 00 00 00 02 E9 03
			15 01 00 00 00 00 02 EA B2
			15 01 00 00 00 00 02 EB 03
			15 01 00 00 00 00 02 EC C0
			15 01 00 00 00 00 02 ED 03
			15 01 00 00 00 00 02 EE C1
			//G(+) MCR cmd
			15 01 00 00 00 00 02 EF 01
			15 01 00 00 00 00 02 F0 60
			15 01 00 00 00 00 02 F1 01
			15 01 00 00 00 00 02 F2 63
			15 01 00 00 00 00 02 F3 01
			15 01 00 00 00 00 02 F4 6B
			15 01 00 00 00 00 02 F5 01
			15 01 00 00 00 00 02 F6 73
			15 01 00 00 00 00 02 F7 01
			15 01 00 00 00 00 02 F8 7A
			15 01 00 00 00 00 02 F9 01
			15 01 00 00 00 00 02 FA 81
			//page selection cmd start
			15 01 00 00 00 00 02 FF 02
			15 01 00 00 00 00 02 FB 01
			//page selection cmd end
			15 01 00 00 00 00 02 00 01
			15 01 00 00 00 00 02 01 87
			15 01 00 00 00 00 02 02 01
			15 01 00 00 00 00 02 03 8D
			15 01 00 00 00 00 02 04 01
			15 01 00 00 00 00 02 05 95
			15 01 00 00 00 00 02 06 01
			15 01 00 00 00 00 02 07 AB
			15 01 00 00 00 00 02 08 01
			15 01 00 00 00 00 02 09 C0
			15 01 00 00 00 00 02 0A 01
			15 01 00 00 00 00 02 0B E4
			15 01 00 00 00 00 02 0C 02
			15 01 00 00 00 00 02 0D 03
			15 01 00 00 00 00 02 0E 02
			15 01 00 00 00 00 02 0F 37
			15 01 00 00 00 00 02 10 02
			15 01 00 00 00 00 02 11 63
			15 01 00 00 00 00 02 12 02
			15 01 00 00 00 00 02 13 64
			15 01 00 00 00 00 02 14 02
			15 01 00 00 00 00 02 15 92
			15 01 00 00 00 00 02 16 02
			15 01 00 00 00 00 02 17 C8
			15 01 00 00 00 00 02 18 02
			15 01 00 00 00 00 02 19 EB
			15 01 00 00 00 00 02 1A 03
			15 01 00 00 00 00 02 1B 1A
			15 01 00 00 00 00 02 1C 03
			15 01 00 00 00 00 02 1D 3E
			15 01 00 00 00 00 02 1E 03
			15 01 00 00 00 00 02 1F 6B
			15 01 00 00 00 00 02 20 03
			15 01 00 00 00 00 02 21 77
			15 01 00 00 00 00 02 22 03
			15 01 00 00 00 00 02 23 86
			15 01 00 00 00 00 02 24 03
			15 01 00 00 00 00 02 25 94
			15 01 00 00 00 00 02 26 03
			15 01 00 00 00 00 02 27 A7
			15 01 00 00 00 00 02 28 03
			15 01 00 00 00 00 02 29 B8
			15 01 00 00 00 00 02 2A 03
			15 01 00 00 00 00 02 2B D7
			15 01 00 00 00 00 02 2D 03
			15 01 00 00 00 00 02 2F EF
			15 01 00 00 00 00 02 30 03
			15 01 00 00 00 00 02 31 F0
			//G(-) MCR cmd
			15 01 00 00 00 00 02 32 01
			15 01 00 00 00 00 02 33 71
			15 01 00 00 00 00 02 34 01
			15 01 00 00 00 00 02 35 74
			15 01 00 00 00 00 02 36 01
			15 01 00 00 00 00 02 37 7C
			15 01 00 00 00 00 02 38 01
			15 01 00 00 00 00 02 39 82
			15 01 00 00 00 00 02 3A 01
			15 01 00 00 00 00 02 3B 89
			15 01 00 00 00 00 02 3D 01
			15 01 00 00 00 00 02 3F 90
			15 01 00 00 00 00 02 40 01
			15 01 00 00 00 00 02 41 96
			15 01 00 00 00 00 02 42 01
			15 01 00 00 00 00 02 43 9C
			15 01 00 00 00 00 02 44 01
			15 01 00 00 00 00 02 45 A2
			15 01 00 00 00 00 02 46 01
			15 01 00 00 00 00 02 47 B8
			15 01 00 00 00 00 02 48 01
			15 01 00 00 00 00 02 49 CB
			15 01 00 00 00 00 02 4A 01
			15 01 00 00 00 00 02 4B EB
			15 01 00 00 00 00 02 4C 02
			15 01 00 00 00 00 02 4D 07
			15 01 00 00 00 00 02 4E 02
			15 01 00 00 00 00 02 4F 37
			15 01 00 00 00 00 02 50 02
			15 01 00 00 00 00 02 51 63
			15 01 00 00 00 00 02 52 02
			15 01 00 00 00 00 02 53 64
			15 01 00 00 00 00 02 54 02
			15 01 00 00 00 00 02 55 92
			15 01 00 00 00 00 02 56 02
			15 01 00 00 00 00 02 58 C8
			15 01 00 00 00 00 02 59 02
			15 01 00 00 00 00 02 5A EB
			15 01 00 00 00 00 02 5B 03
			15 01 00 00 00 00 02 5C 1A
			15 01 00 00 00 00 02 5D 03
			15 01 00 00 00 00 02 5E 31
			15 01 00 00 00 00 02 5F 03
			15 01 00 00 00 00 02 60 52
			15 01 00 00 00 00 02 61 03
			15 01 00 00 00 00 02 62 5C
			15 01 00 00 00 00 02 63 03
			15 01 00 00 00 00 02 64 67
			15 01 00 00 00 00 02 65 03
			15 01 00 00 00 00 02 66 73
			15 01 00 00 00 00 02 67 03
			15 01 00 00 00 00 02 68 82
			15 01 00 00 00 00 02 69 03
			15 01 00 00 00 00 02 6A 90
			15 01 00 00 00 00 02 6B 03
			15 01 00 00 00 00 02 6C AC
			15 01 00 00 00 00 02 6D 03
			15 01 00 00 00 00 02 6E C0
			15 01 00 00 00 00 02 6F 03
			15 01 00 00 00 00 02 70 C1
			//B(+) MCR cmd
			15 01 00 00 00 00 02 71 01
			15 01 00 00 00 00 02 72 ED
			15 01 00 00 00 00 02 73 01
			15 01 00 00 00 00 02 74 EE
			15 01 00 00 00 00 02 75 01
			15 01 00 00 00 00 02 76 F1
			15 01 00 00 00 00 02 77 01
			15 01 00 00 00 00 02 78 F5
			15 01 00 00 00 00 02 79 01
			15 01 00 00 00 00 02 7A F8
			15 01 00 00 00 00 02 7B 01
			15 01 00 00 00 00 02 7C FA
			15 01 00 00 00 00 02 7D 01
			15 01 00 00 00 00 02 7E FD
			15 01 00 00 00 00 02 7F 02
			15 01 00 00 00 00 02 80 00
			15 01 00 00 00 00 02 81 02
			15 01 00 00 00 00 02 82 03
			15 01 00 00 00 00 02 83 02
			15 01 00 00 00 00 02 84 0E
			15 01 00 00 00 00 02 85 02
			15 01 00 00 00 00 02 86 19
			15 01 00 00 00 00 02 87 02
			15 01 00 00 00 00 02 88 2E
			15 01 00 00 00 00 02 89 02
			15 01 00 00 00 00 02 8A 42
			15 01 00 00 00 00 02 8B 02
			15 01 00 00 00 00 02 8C 67
			15 01 00 00 00 00 02 8D 02
			15 01 00 00 00 00 02 8E 8A
			15 01 00 00 00 00 02 8F 02
			15 01 00 00 00 00 02 90 8C
			15 01 00 00 00 00 02 91 02
			15 01 00 00 00 00 02 92 B4
			15 01 00 00 00 00 02 93 02
			15 01 00 00 00 00 02 94 E5
			15 01 00 00 00 00 02 95 03
			15 01 00 00 00 00 02 96 07
			15 01 00 00 00 00 02 97 03
			15 01 00 00 00 00 02 98 32
			15 01 00 00 00 00 02 99 03
			15 01 00 00 00 00 02 9A 54
			15 01 00 00 00 00 02 9B 03
			15 01 00 00 00 00 02 9C 7C
			15 01 00 00 00 00 02 9D 03
			15 01 00 00 00 00 02 9E 89
			15 01 00 00 00 00 02 9F 03
			15 01 00 00 00 00 02 A0 94
			15 01 00 00 00 00 02 A2 03
			15 01 00 00 00 00 02 A3 A3
			15 01 00 00 00 00 02 A4 03
			15 01 00 00 00 00 02 A5 B1
			15 01 00 00 00 00 02 A6 03
			15 01 00 00 00 00 02 A7 C4
			15 01 00 00 00 00 02 A9 03
			15 01 00 00 00 00 02 AA ED
			15 01 00 00 00 00 02 AB 03
			15 01 00 00 00 00 02 AC EF
			15 01 00 00 00 00 02 AD 03
			15 01 00 00 00 00 02 AE F0
			//B(-) MCR cmd
			15 01 00 00 00 00 02 AF 01
			15 01 00 00 00 00 02 B0 FE
			15 01 00 00 00 00 02 B1 01
			15 01 00 00 00 00 02 B2 FF
			15 01 00 00 00 00 02 B3 02
			15 01 00 00 00 00 02 B4 02
			15 01 00 00 00 00 02 B5 02
			15 01 00 00 00 00 02 B6 04
			15 01 00 00 00 00 02 B7 02
			15 01 00 00 00 00 02 B8 07
			15 01 00 00 00 00 02 B9 02
			15 01 00 00 00 00 02 BA 09
			15 01 00 00 00 00 02 BB 02
			15 01 00 00 00 00 02 BC 0C
			15 01 00 00 00 00 02 BD 02
			15 01 00 00 00 00 02 BE 0F
			15 01 00 00 00 00 02 BF 02
			15 01 00 00 00 00 02 C0 10
			15 01 00 00 00 00 02 C1 02
			15 01 00 00 00 00 02 C2 1B
			15 01 00 00 00 00 02 C3 02
			15 01 00 00 00 00 02 C4 24
			15 01 00 00 00 00 02 C5 02
			15 01 00 00 00 00 02 C6 35
			15 01 00 00 00 00 02 C7 02
			15 01 00 00 00 00 02 C8 46
			15 01 00 00 00 00 02 C9 02
			15 01 00 00 00 00 02 CA 67
			15 01 00 00 00 00 02 CB 02
			15 01 00 00 00 00 02 CC 8A
			15 01 00 00 00 00 02 CD 02
			15 01 00 00 00 00 02 CE 8C
			15 01 00 00 00 00 02 CF 02
			15 01 00 00 00 00 02 D0 B4
			15 01 00 00 00 00 02 D1 02
			15 01 00 00 00 00 02 D2 E5
			15 01 00 00 00 00 02 D3 03
			15 01 00 00 00 00 02 D4 07
			15 01 00 00 00 00 02 D5 03
			15 01 00 00 00 00 02 D6 32
			15 01 00 00 00 00 02 D7 03
			15 01 00 00 00 00 02 D8 47
			15 01 00 00 00 00 02 D9 03
			15 01 00 00 00 00 02 DA 63
			15 01 00 00 00 00 02 DB 03
			15 01 00 00 00 00 02 DC 6E
			15 01 00 00 00 00 02 DD 03
			15 01 00 00 00 00 02 DE 75
			15 01 00 00 00 00 02 DF 03
			15 01 00 00 00 00 02 E0 82
			15 01 00 00 00 00 02 E1 03
			15 01 00 00 00 00 02 E2 8C
			15 01 00 00 00 00 02 E3 03
			15 01 00 00 00 00 02 E4 9D
			15 01 00 00 00 00 02 E5 03
			15 01 00 00 00 00 02 E6 C2
			15 01 00 00 00 00 02 E7 03
			15 01 00 00 00 00 02 E8 C0
			15 01 00 00 00 00 02 E9 03
			15 01 00 00 00 00 02 EA C1
			15 01 00 00 00 00 02 FF 00
		];
		qcom,panel-reader-mode-step3-command = [
			//page selection cmd start
			15 00 00 00 00 00 02 FF 01
			15 00 00 00 00 00 02 FB 01
			//page selection cmd end
			//R(+) MCR cmd
			15 00 00 00 00 00 02 75 00
			15 00 00 00 00 00 02 76 28
			15 00 00 00 00 00 02 77 00
			15 00 00 00 00 00 02 78 3B
			15 00 00 00 00 00 02 79 00
			15 00 00 00 00 00 02 7A 6E
			15 00 00 00 00 00 02 7B 00
			15 00 00 00 00 00 02 7C 8F
			15 00 00 00 00 00 02 7D 00
			15 00 00 00 00 00 02 7E AD
			15 00 00 00 00 00 02 7F 00
			15 00 00 00 00 00 02 80 C5
			15 00 00 00 00 00 02 81 00
			15 00 00 00 00 00 02 82 DB
			15 00 00 00 00 00 02 83 00
			15 00 00 00 00 00 02 84 EE
			15 00 00 00 00 00 02 85 00
			15 00 00 00 00 00 02 86 FF
			15 00 00 00 00 00 02 87 01
			15 00 00 00 00 00 02 88 35
			15 00 00 00 00 00 02 89 01
			15 00 00 00 00 00 02 8A 60
			15 00 00 00 00 00 02 8B 01
			15 00 00 00 00 00 02 8C A0
			15 00 00 00 00 00 02 8D 01
			15 00 00 00 00 00 02 8E CE
			15 00 00 00 00 00 02 8F 02
			15 00 00 00 00 00 02 90 15
			15 00 00 00 00 00 02 91 02
			15 00 00 00 00 00 02 92 4A
			15 00 00 00 00 00 02 93 02
			15 00 00 00 00 00 02 94 4C
			15 00 00 00 00 00 02 95 02
			15 00 00 00 00 00 02 96 7F
			15 00 00 00 00 00 02 97 02
			15 00 00 00 00 00 02 98 B7
			15 00 00 00 00 00 02 99 02
			15 00 00 00 00 00 02 9A DC
			15 00 00 00 00 00 02 9B 03
			15 00 00 00 00 00 02 9C 0C
			15 00 00 00 00 00 02 9D 03
			15 00 00 00 00 00 02 9E 31
			15 00 00 00 00 00 02 9F 03
			15 00 00 00 00 00 02 A0 5F
			15 00 00 00 00 00 02 A2 03
			15 00 00 00 00 00 02 A3 6D
			15 00 00 00 00 00 02 A4 03
			15 00 00 00 00 00 02 A5 7C
			15 00 00 00 00 00 02 A6 03
			15 00 00 00 00 00 02 A7 8A
			15 00 00 00 00 00 02 A9 03
			15 00 00 00 00 00 02 AA 9F
			15 00 00 00 00 00 02 AB 03
			15 00 00 00 00 00 02 AC B5
			15 00 00 00 00 00 02 AD 03
			15 00 00 00 00 00 02 AE DD
			15 00 00 00 00 00 02 AF 03
			15 00 00 00 00 00 02 B0 EF
			15 00 00 00 00 00 02 B1 03
			15 01 00 00 00 00 02 B2 F0
			//R(-) MCR cmd
			15 00 00 00 00 00 02 B3 00
			15 00 00 00 00 00 02 B4 38
			15 00 00 00 00 00 02 B5 00
			15 00 00 00 00 00 02 B6 4C
			15 00 00 00 00 00 02 B7 00
			15 00 00 00 00 00 02 B8 7F
			15 00 00 00 00 00 02 B9 00
			15 00 00 00 00 00 02 BA 9E
			15 00 00 00 00 00 02 BB 00
			15 00 00 00 00 00 02 BC BC
			15 00 00 00 00 00 02 BD 00
			15 00 00 00 00 00 02 BE D4
			15 00 00 00 00 00 02 BF 00
			15 00 00 00 00 00 02 C0 EA
			15 00 00 00 00 00 02 C1 00
			15 00 00 00 00 00 02 C2 FD
			15 00 00 00 00 00 02 C3 01
			15 00 00 00 00 00 02 C4 0C
			15 00 00 00 00 00 02 C5 01
			15 00 00 00 00 00 02 C6 42
			15 00 00 00 00 00 02 C7 01
			15 00 00 00 00 00 02 C8 6B
			15 00 00 00 00 00 02 C9 01
			15 00 00 00 00 00 02 CA A7
			15 00 00 00 00 00 02 CB 01
			15 00 00 00 00 00 02 CC D3
			15 00 00 00 00 00 02 CD 02
			15 00 00 00 00 00 02 CE 15
			15 00 00 00 00 00 02 CF 02
			15 00 00 00 00 00 02 D0 4A
			15 00 00 00 00 00 02 D1 02
			15 00 00 00 00 00 02 D2 4C
			15 00 00 00 00 00 02 D3 02
			15 00 00 00 00 00 02 D4 7F
			15 00 00 00 00 00 02 D5 02
			15 00 00 00 00 00 02 D6 B7
			15 00 00 00 00 00 02 D7 02
			15 00 00 00 00 00 02 D8 DC
			15 00 00 00 00 00 02 D9 03
			15 00 00 00 00 00 02 DA 0C
			15 00 00 00 00 00 02 DB 03
			15 00 00 00 00 00 02 DC 24
			15 00 00 00 00 00 02 DD 03
			15 00 00 00 00 00 02 DE 46
			15 00 00 00 00 00 02 DF 03
			15 00 00 00 00 00 02 E0 52
			15 00 00 00 00 00 02 E1 03
			15 00 00 00 00 00 02 E2 5D
			15 00 00 00 00 00 02 E3 03
			15 00 00 00 00 00 02 E4 69
			15 00 00 00 00 00 02 E5 03
			15 00 00 00 00 00 02 E6 7A
			15 00 00 00 00 00 02 E7 03
			15 00 00 00 00 00 02 E8 8D
			15 00 00 00 00 00 02 E9 03
			15 00 00 00 00 00 02 EA B2
			15 00 00 00 00 00 02 EB 03
			15 00 00 00 00 00 02 EC C0
			15 00 00 00 00 00 02 ED 03
			15 01 00 00 00 00 02 EE C1
			//G(+) MCR cmd
			15 00 00 00 00 00 02 EF 01
			15 00 00 00 00 00 02 F0 60
			15 00 00 00 00 00 02 F1 01
			15 00 00 00 00 00 02 F2 63
			15 00 00 00 00 00 02 F3 01
			15 00 00 00 00 00 02 F4 6B
			15 00 00 00 00 00 02 F5 01
			15 00 00 00 00 00 02 F6 73
			15 00 00 00 00 00 02 F7 01
			15 00 00 00 00 00 02 F8 7A
			15 00 00 00 00 00 02 F9 01
			15 00 00 00 00 00 02 FA 81
			//page selection cmd start
			15 00 00 00 00 00 02 FF 02
			15 00 00 00 00 00 02 FB 01
			//page selection cmd end
			15 00 00 00 00 00 02 00 01
			15 00 00 00 00 00 02 01 87
			15 00 00 00 00 00 02 02 01
			15 00 00 00 00 00 02 03 8D
			15 00 00 00 00 00 02 04 01
			15 00 00 00 00 00 02 05 95
			15 00 00 00 00 00 02 06 01
			15 00 00 00 00 00 02 07 AB
			15 00 00 00 00 00 02 08 01
			15 00 00 00 00 00 02 09 C0
			15 00 00 00 00 00 02 0A 01
			15 00 00 00 00 00 02 0B E4
			15 00 00 00 00 00 02 0C 02
			15 00 00 00 00 00 02 0D 03
			15 00 00 00 00 00 02 0E 02
			15 00 00 00 00 00 02 0F 37
			15 00 00 00 00 00 02 10 02
			15 00 00 00 00 00 02 11 63
			15 00 00 00 00 00 02 12 02
			15 00 00 00 00 00 02 13 64
			15 00 00 00 00 00 02 14 02
			15 00 00 00 00 00 02 15 92
			15 00 00 00 00 00 02 16 02
			15 00 00 00 00 00 02 17 C8
			15 00 00 00 00 00 02 18 02
			15 00 00 00 00 00 02 19 EB
			15 00 00 00 00 00 02 1A 03
			15 00 00 00 00 00 02 1B 1A
			15 00 00 00 00 00 02 1C 03
			15 00 00 00 00 00 02 1D 3E
			15 00 00 00 00 00 02 1E 03
			15 00 00 00 00 00 02 1F 6B
			15 00 00 00 00 00 02 20 03
			15 00 00 00 00 00 02 21 77
			15 00 00 00 00 00 02 22 03
			15 00 00 00 00 00 02 23 86
			15 00 00 00 00 00 02 24 03
			15 00 00 00 00 00 02 25 94
			15 00 00 00 00 00 02 26 03
			15 00 00 00 00 00 02 27 A7
			15 00 00 00 00 00 02 28 03
			15 00 00 00 00 00 02 29 B8
			15 00 00 00 00 00 02 2A 03
			15 00 00 00 00 00 02 2B D7
			15 00 00 00 00 00 02 2D 03
			15 00 00 00 00 00 02 2F EF
			15 00 00 00 00 00 02 30 03
			15 01 00 00 00 00 02 31 F0
			//G(-) MCR cmd
			15 00 00 00 00 00 02 32 01
			15 00 00 00 00 00 02 33 71
			15 00 00 00 00 00 02 34 01
			15 00 00 00 00 00 02 35 74
			15 00 00 00 00 00 02 36 01
			15 00 00 00 00 00 02 37 7C
			15 00 00 00 00 00 02 38 01
			15 00 00 00 00 00 02 39 82
			15 00 00 00 00 00 02 3A 01
			15 00 00 00 00 00 02 3B 89
			15 00 00 00 00 00 02 3D 01
			15 00 00 00 00 00 02 3F 90
			15 00 00 00 00 00 02 40 01
			15 00 00 00 00 00 02 41 96
			15 00 00 00 00 00 02 42 01
			15 00 00 00 00 00 02 43 9C
			15 00 00 00 00 00 02 44 01
			15 00 00 00 00 00 02 45 A2
			15 00 00 00 00 00 02 46 01
			15 00 00 00 00 00 02 47 B8
			15 00 00 00 00 00 02 48 01
			15 00 00 00 00 00 02 49 CB
			15 00 00 00 00 00 02 4A 01
			15 00 00 00 00 00 02 4B EB
			15 00 00 00 00 00 02 4C 02
			15 00 00 00 00 00 02 4D 07
			15 00 00 00 00 00 02 4E 02
			15 00 00 00 00 00 02 4F 37
			15 00 00 00 00 00 02 50 02
			15 00 00 00 00 00 02 51 63
			15 00 00 00 00 00 02 52 02
			15 00 00 00 00 00 02 53 64
			15 00 00 00 00 00 02 54 02
			15 00 00 00 00 00 02 55 92
			15 00 00 00 00 00 02 56 02
			15 00 00 00 00 00 02 58 C8
			15 00 00 00 00 00 02 59 02
			15 00 00 00 00 00 02 5A EB
			15 00 00 00 00 00 02 5B 03
			15 00 00 00 00 00 02 5C 1A
			15 00 00 00 00 00 02 5D 03
			15 00 00 00 00 00 02 5E 31
			15 00 00 00 00 00 02 5F 03
			15 00 00 00 00 00 02 60 52
			15 00 00 00 00 00 02 61 03
			15 00 00 00 00 00 02 62 5C
			15 00 00 00 00 00 02 63 03
			15 00 00 00 00 00 02 64 67
			15 00 00 00 00 00 02 65 03
			15 00 00 00 00 00 02 66 73
			15 00 00 00 00 00 02 67 03
			15 00 00 00 00 00 02 68 82
			15 00 00 00 00 00 02 69 03
			15 00 00 00 00 00 02 6A 90
			15 00 00 00 00 00 02 6B 03
			15 00 00 00 00 00 02 6C AC
			15 00 00 00 00 00 02 6D 03
			15 00 00 00 00 00 02 6E C0
			15 00 00 00 00 00 02 6F 03
			15 01 00 00 00 00 02 70 C1
			//B(+) MCR cmd
			15 00 00 00 00 00 02 71 01
			15 00 00 00 00 00 02 72 ED
			15 00 00 00 00 00 02 73 01
			15 00 00 00 00 00 02 74 EE
			15 00 00 00 00 00 02 75 01
			15 00 00 00 00 00 02 76 F1
			15 00 00 00 00 00 02 77 01
			15 00 00 00 00 00 02 78 F5
			15 00 00 00 00 00 02 79 01
			15 00 00 00 00 00 02 7A F8
			15 00 00 00 00 00 02 7B 01
			15 00 00 00 00 00 02 7C FA
			15 00 00 00 00 00 02 7D 01
			15 00 00 00 00 00 02 7E FD
			15 00 00 00 00 00 02 7F 02
			15 00 00 00 00 00 02 80 00
			15 00 00 00 00 00 02 81 02
			15 00 00 00 00 00 02 82 03
			15 00 00 00 00 00 02 83 02
			15 00 00 00 00 00 02 84 0E
			15 00 00 00 00 00 02 85 02
			15 00 00 00 00 00 02 86 19
			15 00 00 00 00 00 02 87 02
			15 00 00 00 00 00 02 88 2E
			15 00 00 00 00 00 02 89 02
			15 00 00 00 00 00 02 8A 42
			15 00 00 00 00 00 02 8B 02
			15 00 00 00 00 00 02 8C 67
			15 00 00 00 00 00 02 8D 02
			15 00 00 00 00 00 02 8E 8A
			15 00 00 00 00 00 02 8F 02
			15 00 00 00 00 00 02 90 8C
			15 00 00 00 00 00 02 91 02
			15 00 00 00 00 00 02 92 B4
			15 00 00 00 00 00 02 93 02
			15 00 00 00 00 00 02 94 E5
			15 00 00 00 00 00 02 95 03
			15 00 00 00 00 00 02 96 07
			15 00 00 00 00 00 02 97 03
			15 00 00 00 00 00 02 98 32
			15 00 00 00 00 00 02 99 03
			15 00 00 00 00 00 02 9A 54
			15 00 00 00 00 00 02 9B 03
			15 00 00 00 00 00 02 9C 7C
			15 00 00 00 00 00 02 9D 03
			15 00 00 00 00 00 02 9E 89
			15 00 00 00 00 00 02 9F 03
			15 00 00 00 00 00 02 A0 94
			15 00 00 00 00 00 02 A2 03
			15 00 00 00 00 00 02 A3 A3
			15 00 00 00 00 00 02 A4 03
			15 00 00 00 00 00 02 A5 B1
			15 00 00 00 00 00 02 A6 03
			15 00 00 00 00 00 02 A7 C4
			15 00 00 00 00 00 02 A9 03
			15 00 00 00 00 00 02 AA ED
			15 00 00 00 00 00 02 AB 03
			15 00 00 00 00 00 02 AC EF
			15 00 00 00 00 00 02 AD 03
			15 01 00 00 00 00 02 AE F0
			//B(-) MCR cmd
			15 00 00 00 00 00 02 AF 01
			15 00 00 00 00 00 02 B0 FE
			15 00 00 00 00 00 02 B1 01
			15 00 00 00 00 00 02 B2 FF
			15 00 00 00 00 00 02 B3 02
			15 00 00 00 00 00 02 B4 02
			15 00 00 00 00 00 02 B5 02
			15 00 00 00 00 00 02 B6 04
			15 00 00 00 00 00 02 B7 02
			15 00 00 00 00 00 02 B8 07
			15 00 00 00 00 00 02 B9 02
			15 00 00 00 00 00 02 BA 09
			15 00 00 00 00 00 02 BB 02
			15 00 00 00 00 00 02 BC 0C
			15 00 00 00 00 00 02 BD 02
			15 00 00 00 00 00 02 BE 0F
			15 00 00 00 00 00 02 BF 02
			15 00 00 00 00 00 02 C0 10
			15 00 00 00 00 00 02 C1 02
			15 00 00 00 00 00 02 C2 1B
			15 00 00 00 00 00 02 C3 02
			15 00 00 00 00 00 02 C4 24
			15 00 00 00 00 00 02 C5 02
			15 00 00 00 00 00 02 C6 35
			15 00 00 00 00 00 02 C7 02
			15 00 00 00 00 00 02 C8 46
			15 00 00 00 00 00 02 C9 02
			15 00 00 00 00 00 02 CA 67
			15 00 00 00 00 00 02 CB 02
			15 00 00 00 00 00 02 CC 8A
			15 00 00 00 00 00 02 CD 02
			15 00 00 00 00 00 02 CE 8C
			15 00 00 00 00 00 02 CF 02
			15 00 00 00 00 00 02 D0 B4
			15 00 00 00 00 00 02 D1 02
			15 00 00 00 00 00 02 D2 E5
			15 00 00 00 00 00 02 D3 03
			15 00 00 00 00 00 02 D4 07
			15 00 00 00 00 00 02 D5 03
			15 00 00 00 00 00 02 D6 32
			15 00 00 00 00 00 02 D7 03
			15 00 00 00 00 00 02 D8 47
			15 00 00 00 00 00 02 D9 03
			15 00 00 00 00 00 02 DA 63
			15 00 00 00 00 00 02 DB 03
			15 00 00 00 00 00 02 DC 6E
			15 00 00 00 00 00 02 DD 03
			15 00 00 00 00 00 02 DE 75
			15 00 00 00 00 00 02 DF 03
			15 00 00 00 00 00 02 E0 82
			15 00 00 00 00 00 02 E1 03
			15 00 00 00 00 00 02 E2 8C
			15 00 00 00 00 00 02 E3 03
			15 00 00 00 00 00 02 E4 9D
			15 00 00 00 00 00 02 E5 03
			15 00 00 00 00 00 02 E6 C2
			15 00 00 00 00 00 02 E7 03
			15 00 00 00 00 00 02 E8 C0
			15 00 00 00 00 00 02 E9 03
			15 00 00 00 00 00 02 EA C1
			15 01 00 00 00 00 02 FF 00
		];

		qcom,panel-reader-mode-off-command  = [
			//CMD2Page0 Select
			15 00 00 00 00 00 02 FF 01
			15 00 00 00 00 00 02 FB 01
			//R(+)
			15 00 00 00 00 00 02 75 00
			15 00 00 00 00 00 02 76 28
			15 00 00 00 00 00 02 77 00
			15 00 00 00 00 00 02 78 3C
			15 00 00 00 00 00 02 79 00
			15 00 00 00 00 00 02 7A 6F
			15 00 00 00 00 00 02 7B 00
			15 00 00 00 00 00 02 7C 91
			15 00 00 00 00 00 02 7D 00
			15 00 00 00 00 00 02 7E AF
			15 00 00 00 00 00 02 7F 00
			15 00 00 00 00 00 02 80 C7
			15 00 00 00 00 00 02 81 00
			15 00 00 00 00 00 02 82 DD
			15 00 00 00 00 00 02 83 00
			15 00 00 00 00 00 02 84 F0
			15 00 00 00 00 00 02 85 01
			15 00 00 00 00 00 02 86 01
			15 00 00 00 00 00 02 87 01
			15 00 00 00 00 00 02 88 36
			15 00 00 00 00 00 02 89 01
			15 00 00 00 00 00 02 8A 60
			15 00 00 00 00 00 02 8B 01
			15 00 00 00 00 00 02 8C 9F
			15 00 00 00 00 00 02 8D 01
			15 00 00 00 00 00 02 8E CD
			15 00 00 00 00 00 02 8F 02
			15 00 00 00 00 00 02 90 13
			15 00 00 00 00 00 02 91 02
			15 00 00 00 00 00 02 92 48
			15 00 00 00 00 00 02 93 02
			15 00 00 00 00 00 02 94 4A
			15 00 00 00 00 00 02 95 02
			15 00 00 00 00 00 02 96 7D
			15 00 00 00 00 00 02 97 02
			15 00 00 00 00 00 02 98 B6
			15 00 00 00 00 00 02 99 02
			15 00 00 00 00 00 02 9A DA
			15 00 00 00 00 00 02 9B 03
			15 00 00 00 00 00 02 9C 0A
			15 00 00 00 00 00 02 9D 03
			15 00 00 00 00 00 02 9E 30
			15 00 00 00 00 00 02 9F 03
			15 00 00 00 00 00 02 A0 5D
			15 00 00 00 00 00 02 A2 03
			15 00 00 00 00 00 02 A3 6C
			15 00 00 00 00 00 02 A4 03
			15 00 00 00 00 00 02 A5 7B
			15 00 00 00 00 00 02 A6 03
			15 00 00 00 00 00 02 A7 89
			15 00 00 00 00 00 02 A9 03
			15 00 00 00 00 00 02 AA 9C
			15 00 00 00 00 00 02 AB 03
			15 00 00 00 00 00 02 AC AF
			15 00 00 00 00 00 02 AD 03
			15 00 00 00 00 00 02 AE C9
			15 00 00 00 00 00 02 AF 03
			15 00 00 00 00 00 02 B0 EF
			15 00 00 00 00 00 02 B1 03
			15 01 00 00 00 00 02 B2 F0
			//R(-)
			15 00 00 00 00 00 02 B3 00
			15 00 00 00 00 00 02 B4 38
			15 00 00 00 00 00 02 B5 00
			15 00 00 00 00 00 02 B6 4D
			15 00 00 00 00 00 02 B7 00
			15 00 00 00 00 00 02 B8 80
			15 00 00 00 00 00 02 B9 00
			15 00 00 00 00 00 02 BA A0
			15 00 00 00 00 00 02 BB 00
			15 00 00 00 00 00 02 BC BE
			15 00 00 00 00 00 02 BD 00
			15 00 00 00 00 00 02 BE D6
			15 00 00 00 00 00 02 BF 00
			15 00 00 00 00 00 02 C0 EC
			15 00 00 00 00 00 02 C1 00
			15 00 00 00 00 00 02 C2 FF
			15 00 00 00 00 00 02 C3 01
			15 00 00 00 00 00 02 C4 0F
			15 00 00 00 00 00 02 C5 01
			15 00 00 00 00 00 02 C6 43
			15 00 00 00 00 00 02 C7 01
			15 00 00 00 00 00 02 C8 6B
			15 00 00 00 00 00 02 C9 01
			15 00 00 00 00 00 02 CA A6
			15 00 00 00 00 00 02 CB 01
			15 00 00 00 00 00 02 CC D2
			15 00 00 00 00 00 02 CD 02
			15 00 00 00 00 00 02 CE 13
			15 00 00 00 00 00 02 CF 02
			15 00 00 00 00 00 02 D0 48
			15 00 00 00 00 00 02 D1 02
			15 00 00 00 00 00 02 D2 4A
			15 00 00 00 00 00 02 D3 02
			15 00 00 00 00 00 02 D4 7D
			15 00 00 00 00 00 02 D5 02
			15 00 00 00 00 00 02 D6 B6
			15 00 00 00 00 00 02 D7 02
			15 00 00 00 00 00 02 D8 DA
			15 00 00 00 00 00 02 D9 03
			15 00 00 00 00 00 02 DA 0A
			15 00 00 00 00 00 02 DB 03
			15 00 00 00 00 00 02 DC 23
			15 00 00 00 00 00 02 DD 03
			15 00 00 00 00 00 02 DE 44
			15 00 00 00 00 00 02 DF 03
			15 00 00 00 00 00 02 E0 51
			15 00 00 00 00 00 02 E1 03
			15 00 00 00 00 00 02 E2 5C
			15 00 00 00 00 00 02 E3 03
			15 00 00 00 00 00 02 E4 68
			15 00 00 00 00 00 02 E5 03
			15 00 00 00 00 00 02 E6 77
			15 00 00 00 00 00 02 E7 03
			15 00 00 00 00 00 02 E8 87
			15 00 00 00 00 00 02 E9 03
			15 00 00 00 00 00 02 EA 9E
			15 00 00 00 00 00 02 EB 03
			15 00 00 00 00 00 02 EC C0
			15 00 00 00 00 00 02 ED 03
			15 01 00 00 00 00 02 EE C1
			//G(+)
			15 00 00 00 00 00 02 EF 00
			15 00 00 00 00 00 02 F0 A6
			15 00 00 00 00 00 02 F1 00
			15 00 00 00 00 00 02 F2 B4
			15 00 00 00 00 00 02 F3 00
			15 00 00 00 00 00 02 F4 CA
			15 00 00 00 00 00 02 F5 00
			15 00 00 00 00 00 02 F6 DF
			15 00 00 00 00 00 02 F7 00
			15 00 00 00 00 00 02 F8 F1
			15 00 00 00 00 00 02 F9 01
			15 00 00 00 00 00 02 FA 01
			//CMD2Page1 Select
			15 00 00 00 00 00 02 FF 02
			15 00 00 00 00 00 02 FB 01
			15 00 00 00 00 00 02 00 01
			15 00 00 00 00 00 02 01 10
			15 00 00 00 00 00 02 02 01
			15 00 00 00 00 00 02 03 1E
			15 00 00 00 00 00 02 04 01
			15 00 00 00 00 00 02 05 2B
			15 00 00 00 00 00 02 06 01
			15 00 00 00 00 00 02 07 55
			15 00 00 00 00 00 02 08 01
			15 00 00 00 00 00 02 09 78
			15 00 00 00 00 00 02 0A 01
			15 00 00 00 00 00 02 0B AF
			15 00 00 00 00 00 02 0C 01
			15 00 00 00 00 00 02 0D D8
			15 00 00 00 00 00 02 0E 02
			15 00 00 00 00 00 02 0F 19
			15 00 00 00 00 00 02 10 02
			15 00 00 00 00 00 02 11 4C
			15 00 00 00 00 00 02 12 02
			15 00 00 00 00 00 02 13 4E
			15 00 00 00 00 00 02 14 02
			15 00 00 00 00 00 02 15 80
			15 00 00 00 00 00 02 16 02
			15 00 00 00 00 00 02 17 B9
			15 00 00 00 00 00 02 18 02
			15 00 00 00 00 00 02 19 DD
			15 00 00 00 00 00 02 1A 03
			15 00 00 00 00 00 02 1B 0D
			15 00 00 00 00 00 02 1C 03
			15 00 00 00 00 00 02 1D 32
			15 00 00 00 00 00 02 1E 03
			15 00 00 00 00 00 02 1F 5F
			15 00 00 00 00 00 02 20 03
			15 00 00 00 00 00 02 21 6F
			15 00 00 00 00 00 02 22 03
			15 00 00 00 00 00 02 23 7C
			15 00 00 00 00 00 02 24 03
			15 00 00 00 00 00 02 25 8B
			15 00 00 00 00 00 02 26 03
			15 00 00 00 00 00 02 27 9D
			15 00 00 00 00 00 02 28 03
			15 00 00 00 00 00 02 29 B2
			15 00 00 00 00 00 02 2A 03
			15 00 00 00 00 00 02 2B CA
			15 00 00 00 00 00 02 2D 03
			15 00 00 00 00 00 02 2F EF
			15 00 00 00 00 00 02 30 03
			15 01 00 00 00 00 02 31 F0
			//G(-)
			15 00 00 00 00 00 02 32 00
			15 00 00 00 00 00 02 33 B7
			15 00 00 00 00 00 02 34 00
			15 00 00 00 00 00 02 35 C5
			15 00 00 00 00 00 02 36 00
			15 00 00 00 00 00 02 37 DB
			15 00 00 00 00 00 02 38 00
			15 00 00 00 00 00 02 39 EE
			15 00 00 00 00 00 02 3A 01
			15 00 00 00 00 00 02 3B 00
			15 00 00 00 00 00 02 3D 01
			15 00 00 00 00 00 02 3F 10
			15 00 00 00 00 00 02 40 01
			15 00 00 00 00 00 02 41 1F
			15 00 00 00 00 00 02 42 01
			15 00 00 00 00 00 02 43 2D
			15 00 00 00 00 00 02 44 01
			15 00 00 00 00 00 02 45 38
			15 00 00 00 00 00 02 46 01
			15 00 00 00 00 00 02 47 62
			15 00 00 00 00 00 02 48 01
			15 00 00 00 00 00 02 49 83
			15 00 00 00 00 00 02 4A 01
			15 00 00 00 00 00 02 4B B6
			15 00 00 00 00 00 02 4C 01
			15 00 00 00 00 00 02 4D DC
			15 00 00 00 00 00 02 4E 02
			15 00 00 00 00 00 02 4F 19
			15 00 00 00 00 00 02 50 02
			15 00 00 00 00 00 02 51 4C
			15 00 00 00 00 00 02 52 02
			15 00 00 00 00 00 02 53 4E
			15 00 00 00 00 00 02 54 02
			15 00 00 00 00 00 02 55 80
			15 00 00 00 00 00 02 56 02
			15 00 00 00 00 00 02 58 B9
			15 00 00 00 00 00 02 59 02
			15 00 00 00 00 00 02 5A DD
			15 00 00 00 00 00 02 5B 03
			15 00 00 00 00 00 02 5C 0D
			15 00 00 00 00 00 02 5D 03
			15 00 00 00 00 00 02 5E 25
			15 00 00 00 00 00 02 5F 03
			15 00 00 00 00 00 02 60 46
			15 00 00 00 00 00 02 61 03
			15 00 00 00 00 00 02 62 54
			15 00 00 00 00 00 02 63 03
			15 00 00 00 00 00 02 64 5D
			15 00 00 00 00 00 02 65 03
			15 00 00 00 00 00 02 66 6A
			15 00 00 00 00 00 02 67 03
			15 00 00 00 00 00 02 68 78
			15 00 00 00 00 00 02 69 03
			15 00 00 00 00 00 02 6A 8A
			15 00 00 00 00 00 02 6B 03
			15 00 00 00 00 00 02 6C 9F
			15 00 00 00 00 00 02 6D 03
			15 00 00 00 00 00 02 6E C0
			15 00 00 00 00 00 02 6F 03
			15 01 00 00 00 00 02 70 C1
			//B(+)
			15 00 00 00 00 00 02 71 01
			15 00 00 00 00 00 02 72 0C
			15 00 00 00 00 00 02 73 01
			15 00 00 00 00 00 02 74 13
			15 00 00 00 00 00 02 75 01
			15 00 00 00 00 00 02 76 20
			15 00 00 00 00 00 02 77 01
			15 00 00 00 00 00 02 78 2D
			15 00 00 00 00 00 02 79 01
			15 00 00 00 00 00 02 7A 39
			15 00 00 00 00 00 02 7B 01
			15 00 00 00 00 00 02 7C 44
			15 00 00 00 00 00 02 7D 01
			15 00 00 00 00 00 02 7E 4E
			15 00 00 00 00 00 02 7F 01
			15 00 00 00 00 00 02 80 57
			15 00 00 00 00 00 02 81 01
			15 00 00 00 00 00 02 82 61
			15 00 00 00 00 00 02 83 01
			15 00 00 00 00 00 02 84 80
			15 00 00 00 00 00 02 85 01
			15 00 00 00 00 00 02 86 9C
			15 00 00 00 00 00 02 87 01
			15 00 00 00 00 00 02 88 C8
			15 00 00 00 00 00 02 89 01
			15 00 00 00 00 00 02 8A EC
			15 00 00 00 00 00 02 8B 02
			15 00 00 00 00 00 02 8C 27
			15 00 00 00 00 00 02 8D 02
			15 00 00 00 00 00 02 8E 57
			15 00 00 00 00 00 02 8F 02
			15 00 00 00 00 00 02 90 59
			15 00 00 00 00 00 02 91 02
			15 00 00 00 00 00 02 92 88
			15 00 00 00 00 00 02 93 02
			15 00 00 00 00 00 02 94 C0
			15 00 00 00 00 00 02 95 02
			15 00 00 00 00 00 02 96 E3
			15 00 00 00 00 00 02 97 03
			15 00 00 00 00 00 02 98 12
			15 00 00 00 00 00 02 99 03
			15 00 00 00 00 00 02 9A 37
			15 00 00 00 00 00 02 9B 03
			15 00 00 00 00 00 02 9C 63
			15 00 00 00 00 00 02 9D 03
			15 00 00 00 00 00 02 9E 72
			15 00 00 00 00 00 02 9F 03
			15 00 00 00 00 00 02 A0 7F
			15 00 00 00 00 00 02 A2 03
			15 00 00 00 00 00 02 A3 8F
			15 00 00 00 00 00 02 A4 03
			15 00 00 00 00 00 02 A5 9F
			15 00 00 00 00 00 02 A6 03
			15 00 00 00 00 00 02 A7 B0
			15 00 00 00 00 00 02 A9 03
			15 00 00 00 00 00 02 AA C8
			15 00 00 00 00 00 02 AB 03
			15 00 00 00 00 00 02 AC EF
			15 00 00 00 00 00 02 AD 03
			15 01 00 00 00 00 02 AE F0
			//B(-)
			15 00 00 00 00 00 02 AF 01
			15 00 00 00 00 00 02 B0 1D
			15 00 00 00 00 00 02 B1 01
			15 00 00 00 00 00 02 B2 24
			15 00 00 00 00 00 02 B3 01
			15 00 00 00 00 00 02 B4 31
			15 00 00 00 00 00 02 B5 01
			15 00 00 00 00 00 02 B6 3C
			15 00 00 00 00 00 02 B7 01
			15 00 00 00 00 00 02 B8 48
			15 00 00 00 00 00 02 B9 01
			15 00 00 00 00 00 02 BA 53
			15 00 00 00 00 00 02 BB 01
			15 00 00 00 00 00 02 BC 5D
			15 00 00 00 00 00 02 BD 01
			15 00 00 00 00 00 02 BE 66
			15 00 00 00 00 00 02 BF 01
			15 00 00 00 00 00 02 C0 6E
			15 00 00 00 00 00 02 C1 01
			15 00 00 00 00 00 02 C2 8D
			15 00 00 00 00 00 02 C3 01
			15 00 00 00 00 00 02 C4 A7
			15 00 00 00 00 00 02 C5 01
			15 00 00 00 00 00 02 C6 CF
			15 00 00 00 00 00 02 C7 01
			15 00 00 00 00 00 02 C8 F1
			15 00 00 00 00 00 02 C9 02
			15 00 00 00 00 00 02 CA 27
			15 00 00 00 00 00 02 CB 02
			15 00 00 00 00 00 02 CC 57
			15 00 00 00 00 00 02 CD 02
			15 00 00 00 00 00 02 CE 59
			15 00 00 00 00 00 02 CF 02
			15 00 00 00 00 00 02 D0 88
			15 00 00 00 00 00 02 D1 02
			15 00 00 00 00 00 02 D2 C0
			15 00 00 00 00 00 02 D3 02
			15 00 00 00 00 00 02 D4 E3
			15 00 00 00 00 00 02 D5 03
			15 00 00 00 00 00 02 D6 12
			15 00 00 00 00 00 02 D7 03
			15 00 00 00 00 00 02 D8 2A
			15 00 00 00 00 00 02 D9 03
			15 00 00 00 00 00 02 DA 4A
			15 00 00 00 00 00 02 DB 03
			15 00 00 00 00 00 02 DC 57
			15 00 00 00 00 00 02 DD 03
			15 00 00 00 00 00 02 DE 60
			15 00 00 00 00 00 02 DF 03
			15 00 00 00 00 00 02 E0 6E
			15 00 00 00 00 00 02 E1 03
			15 00 00 00 00 00 02 E2 7A
			15 00 00 00 00 00 02 E3 03
			15 00 00 00 00 00 02 E4 88
			15 00 00 00 00 00 02 E5 03
			15 00 00 00 00 00 02 E6 9D
			15 00 00 00 00 00 02 E7 03
			15 00 00 00 00 00 02 E8 C0
			15 00 00 00 00 00 02 E9 03
			15 00 00 00 00 00 02 EA C1
			//Enter CMD1
			15 01 00 00 00 00 02 FF 00
		];

		qcom,mdss-dsi-on-command-state = "dsi_lp_mode";
		qcom,mdss-dsi-off-command-state = "dsi_hs_mode";
		qcom,mdss-dsi-reader-mode-command-state = "dsi_hs_mode";
		qcom,mdss-dsi-h-sync-pulse = <0>;
		qcom,mdss-dsi-lane-map = "lane_map_0123";
		qcom,mdss-dsi-bllp-eof-power-mode;
		qcom,mdss-dsi-bllp-power-mode;
		qcom,mdss-dsi-lane-0-state;
		qcom,mdss-dsi-lane-1-state;
		qcom,mdss-dsi-lane-2-state;
		qcom,mdss-dsi-lane-3-state;
		qcom,mdss-dsi-panel-timings = [EC 38 26 00 68 6C
			2A 3C 36 03 04 00]; /* TLPX is 62.5ns */

		qcom,mdss-dsi-reset-sequence = <1 5>, <0 5>, <1 5>, <0 5>, <1 11>;
		qcom,mdss-dsi-t-clk-post = <0x2>;
		qcom,mdss-dsi-t-clk-pre = <0x2D>;
		qcom,mdss-dsi-dma-trigger = "trigger_sw";
		qcom,mdss-dsi-mdp-trigger = "trigger_sw";

		qcom,cont-splash-enabled;
		//qcom,mdss-dsi-force-clock-lane-hs;

		/* Sharp Incell Panel be set DSI_NON_BURST_SYNCH_EVENT */
		qcom,mdss-dsi-traffic-mode = "non_burst_sync_event";

		qcom,mdss-dsi-lp11-init;

		lge,blmap-size = <256>;
		lge,blmap = <
			0 25 25 25 25 25 25 25 25 25 				/* 0 ~ 9 */
			25 25 25 26 26 26 27 27 28 28				/* 10 ~ 19 */
			28 29 29 30 31 32 33 35 36 37				/* 20 ~ 29 */
			38 40 41 42 43 45 47 50 52 55				/* 30 ~ 39 */
			57 60 62 65 67 70 72 75 77 80				/* 40 ~ 49 */
			85 90 95 100 105 110 115 120 125 130			/* 50 ~ 59 */
			134 139 143 148 153 157 162 167 171 176			/* 60 ~ 69 */
			181 185 190 195 202 210 217 225 232 240			/* 70 ~ 79 */
			247 255 262 270 277 285 293 302 311 319			/* 80 ~ 89 */
			328 337 345 354 363 371 380 389 398 408			/* 90 ~ 99 */
			418 429 439 450 460 471 481 492 502 513			/* 100 ~ 109 */
			523 534 545 556 567 578 589 600 611 622			/* 110 ~ 119 */
			633 644 655 665 676 687 698 709 720 731			/* 120 ~ 129 */
			742 753 764 775 817 833 850 866 883 900			/* 130 ~ 139 */
			916 933 950 966 983 1000 1015 1030 1046 1061		/* 140 ~ 149 */
			1076 1092 1107 1123 1138 1153 1169 1184 1200 1219	/* 150 ~ 159 */
			1239 1258 1278 1297 1317 1337 1356 1376 1395 1415	/* 160 ~ 169 */
			1435 1454 1474 1493 1513 1533 1552 1572 1591 1611	/* 170 ~ 179 */
			1631 1650 1670 1690 1713 1737 1761 1785 1808 1832	/* 180 ~ 189 */
			1856 1880 1903 1927 1951 1975 1999 2023 2047 2071	/* 190 ~ 199 */
			2096 2120 2144 2168 2193 2217 2241 2265 2290 2320	/* 200 ~ 209 */
			2350 2380 2410 2440 2470 2500 2530 2560 2590 2620	/* 210 ~ 219 */
			2647 2675 2703 2730 2758 2786 2813 2841 2869 2896	/* 220 ~ 229 */
			2924 2952 2980 3012 3045 3077 3110 3142 3175 3207	/* 230 ~ 239 */
			3240 3272 3305 3337 3370 3409 3448 3487 3526 3565	/* 240 ~ 249 */
			3604 3643 3682 3721 3760 3800>;				/* 250 ~ 255 */
	};
};
