/* Copyright (c) 2014, Code Aurora Forum. All rights reserved.
 *
 * This program is free software; you can redistribute it and/or modify
 * it under the terms of the GNU General Public License version 2 and
 * only version 2 as published by the Free Software Foundation.
 *
 * This program is distributed in the hope that it will be useful,
 * but WITHOUT ANY WARRANTY; without even the implied warranty of
 * MERCHANTABILITY or FITNESS FOR A PARTICULAR PURPOSE.  See the
 * GNU General Public License for more details.
 */

&mdss_mdp {
	dsi_lv9_jdi_nt35596_vid: qcom,mdss_dsi_lv9_jdi_nt35596_fhd_video {
		compatible = "qcom,mdss-dsi-panel";
		qcom,mdss-dsi-panel-name = "JDI FHD video mode dsi panel";
		qcom,mdss-dsi-panel-controller = <&mdss_dsi0>;
		qcom,mdss-dsi-panel-type = "dsi_video_mode";
		qcom,mdss-dsi-panel-destination = "display_1";
		qcom,mdss-dsi-panel-framerate = <60>;
		qcom,mdss-dsi-virtual-channel-id = <0>;
		qcom,mdss-dsi-stream = <0>;

		qcom,mdss-dsi-panel-width = <1080>;
		qcom,mdss-dsi-panel-height = <1920>;
		qcom,mdss-dsi-h-front-porch = <24>;
		qcom,mdss-dsi-h-back-porch = <96>;
		qcom,mdss-dsi-h-pulse-width = <4>;
		qcom,mdss-dsi-h-sync-skew = <0>;
		qcom,mdss-dsi-v-back-porch = <3>;
		qcom,mdss-dsi-v-front-porch = <4>;
		qcom,mdss-dsi-v-pulse-width = <1>;


		qcom,mdss-pan-physical-width-dimension = <65>;
		qcom,mdss-pan-physical-height-dimension = <115>;

		qcom,mdss-dsi-h-left-border = <0>;
		qcom,mdss-dsi-h-right-border = <0>;
		qcom,mdss-dsi-v-top-border = <0>;
		qcom,mdss-dsi-v-bottom-border = <0>;
		qcom,mdss-dsi-bpp = <24>;
		qcom,mdss-dsi-color-order = "rgb_swap_rgb";
		qcom,mdss-dsi-underflow-color = <0xff>;
		qcom,mdss-dsi-border-color = <0xff>;

		qcom,mdss-dsi-on-command = [
			/* Preset Monochrome mode */
			15 01 00 00 00 00 02 FF 22
			15 01 00 00 00 00 02 00 AA
			15 01 00 00 00 00 02 01 AA
			15 01 00 00 00 00 02 02 AA
			15 01 00 00 00 00 02 03 AA
			15 01 00 00 00 00 02 04 AA
			15 01 00 00 00 00 02 05 AA
			15 01 00 00 00 00 02 06 AA
			15 01 00 00 00 00 02 07 AA
			15 01 00 00 00 00 02 08 AA
			15 01 00 00 00 00 02 09 AA
			15 01 00 00 00 00 02 0A AA
			15 01 00 00 00 00 02 0B AA
			15 01 00 00 00 00 02 0C AA
			15 01 00 00 00 00 02 0D AA
			15 01 00 00 00 00 02 0E AA
			15 01 00 00 00 00 02 0F AA
			15 01 00 00 00 00 02 10 AA
			15 01 00 00 00 00 02 11 AA
			15 01 00 00 00 00 02 12 AA
			15 01 00 00 00 00 02 13 AA
			15 01 00 00 00 00 02 14 20
			15 01 00 00 00 00 02 1A 01
			15 01 00 00 00 00 02 55 00
			15 01 00 00 00 00 02 56 00
			15 01 00 00 00 00 02 58 00
			15 01 00 00 00 00 02 68 00
			15 01 00 00 00 00 02 84 FF
			15 01 00 00 00 00 02 85 FF
			15 01 00 00 00 00 02 86 0F
			15 01 00 00 00 00 02 FB 01

			15 01 00 00 00 00 02 FF 10
			15 01 00 00 00 00 02 35 01
			15 01 00 00 00 00 02 51 FF
			15 01 00 00 00 00 02 53 24
			15 01 00 00 00 00 02 55 00
			15 01 00 00 00 00 02 B0 00

			15 01 00 00 00 00 02 FF 26
			15 01 00 00 00 00 02 1D 9B
			15 01 00 00 00 00 02 50 12
			15 01 00 00 00 00 02 FB 01
			15 01 00 00 28 00 02 FF 10 /* wait time 40ms befor sleep out */

			/* Sleep out */
			05 01 00 00 78 00 01 11
			/* Display On */
			05 01 00 00 00 00 01 29
		];

		qcom,mdss-dsi-off-command = [
			/* Display off */
			05 01 00 00 28 00 01 28
			/* Sleep in */
			05 01 00 00 78 00 01 10
		];

		qcom,panel-normal-mode-initial-gamma-command = [
			//page selection cmd start
			15 01 00 00 00 00 02 FF 20
			//R(+) MCR cmd
			15 01 00 00 00 00 02 75 00
			15 01 00 00 00 00 02 76 00
			15 01 00 00 00 00 02 77 00
			15 01 00 00 00 00 02 78 1F
			15 01 00 00 00 00 02 79 00
			15 01 00 00 00 00 02 7A 56
			15 01 00 00 00 00 02 7B 00
			15 01 00 00 00 00 02 7C 7F
			15 01 00 00 00 00 02 7D 00
			15 01 00 00 00 00 02 7E 9E
			15 01 00 00 00 00 02 7F 00
			15 01 00 00 00 00 02 80 B8
			15 01 00 00 00 00 02 81 00
			15 01 00 00 00 00 02 82 CE
			15 01 00 00 00 00 02 83 00
			15 01 00 00 00 00 02 84 E2
			15 01 00 00 00 00 02 85 00
			15 01 00 00 00 00 02 86 F4
			15 01 00 00 00 00 02 87 01
			15 01 00 00 00 00 02 88 2D
			15 01 00 00 00 00 02 89 01
			15 01 00 00 00 00 02 8A 58
			15 01 00 00 00 00 02 8B 01
			15 01 00 00 00 00 02 8C 97
			15 01 00 00 00 00 02 8D 01
			15 01 00 00 00 00 02 8E C7
			15 01 00 00 00 00 02 8F 02
			15 01 00 00 00 00 02 90 0D
			15 01 00 00 00 00 02 91 02
			15 01 00 00 00 00 02 92 42
			15 01 00 00 00 00 02 93 02
			15 01 00 00 00 00 02 94 44
			15 01 00 00 00 00 02 95 02
			15 01 00 00 00 00 02 96 79
			15 01 00 00 00 00 02 97 02
			15 01 00 00 00 00 02 98 B4
			15 01 00 00 00 00 02 99 02
			15 01 00 00 00 00 02 9A DA
			15 01 00 00 00 00 02 9B 03
			15 01 00 00 00 00 02 9C 0B
			15 01 00 00 00 00 02 9D 03
			15 01 00 00 00 00 02 9E 2F
			15 01 00 00 00 00 02 9F 03
			15 01 00 00 00 00 02 A0 60
			15 01 00 00 00 00 02 A2 03
			15 01 00 00 00 00 02 A3 70
			15 01 00 00 00 00 02 A4 03
			15 01 00 00 00 00 02 A5 81
			15 01 00 00 00 00 02 A6 03
			15 01 00 00 00 00 02 A7 93
			15 01 00 00 00 00 02 A9 03
			15 01 00 00 00 00 02 AA A7
			15 01 00 00 00 00 02 AB 03
			15 01 00 00 00 00 02 AC BE
			15 01 00 00 00 00 02 AD 03
			15 01 00 00 00 00 02 AE D6
			15 01 00 00 00 00 02 AF 03
			15 01 00 00 00 00 02 B0 F1
			15 01 00 00 00 00 02 B1 03
			15 01 00 00 00 00 02 B2 FF
			//R(-) MCR cmd
			15 01 00 00 00 00 02 B3 00
			15 01 00 00 00 00 02 B4 00
			15 01 00 00 00 00 02 B5 00
			15 01 00 00 00 00 02 B6 1F
			15 01 00 00 00 00 02 B7 00
			15 01 00 00 00 00 02 B8 56
			15 01 00 00 00 00 02 B9 00
			15 01 00 00 00 00 02 BA 7F
			15 01 00 00 00 00 02 BB 00
			15 01 00 00 00 00 02 BC 9E
			15 01 00 00 00 00 02 BD 00
			15 01 00 00 00 00 02 BE B8
			15 01 00 00 00 00 02 BF 00
			15 01 00 00 00 00 02 C0 CE
			15 01 00 00 00 00 02 C1 00
			15 01 00 00 00 00 02 C2 E2
			15 01 00 00 00 00 02 C3 00
			15 01 00 00 00 00 02 C4 F4
			15 01 00 00 00 00 02 C5 01
			15 01 00 00 00 00 02 C6 2D
			15 01 00 00 00 00 02 C7 01
			15 01 00 00 00 00 02 C8 58
			15 01 00 00 00 00 02 C9 01
			15 01 00 00 00 00 02 CA 97
			15 01 00 00 00 00 02 CB 01
			15 01 00 00 00 00 02 CC C7
			15 01 00 00 00 00 02 CD 02
			15 01 00 00 00 00 02 CE 0D
			15 01 00 00 00 00 02 CF 02
			15 01 00 00 00 00 02 D0 42
			15 01 00 00 00 00 02 D1 02
			15 01 00 00 00 00 02 D2 44
			15 01 00 00 00 00 02 D3 02
			15 01 00 00 00 00 02 D4 79
			15 01 00 00 00 00 02 D5 02
			15 01 00 00 00 00 02 D6 B4
			15 01 00 00 00 00 02 D7 02
			15 01 00 00 00 00 02 D8 DA
			15 01 00 00 00 00 02 D9 03
			15 01 00 00 00 00 02 DA 0B
			15 01 00 00 00 00 02 DB 03
			15 01 00 00 00 00 02 DC 2F
			15 01 00 00 00 00 02 DD 03
			15 01 00 00 00 00 02 DE 60
			15 01 00 00 00 00 02 DF 03
			15 01 00 00 00 00 02 E0 70
			15 01 00 00 00 00 02 E1 03
			15 01 00 00 00 00 02 E2 81
			15 01 00 00 00 00 02 E3 03
			15 01 00 00 00 00 02 E4 93
			15 01 00 00 00 00 02 E5 03
			15 01 00 00 00 00 02 E6 A7
			15 01 00 00 00 00 02 E7 03
			15 01 00 00 00 00 02 E8 BE
			15 01 00 00 00 00 02 E9 03
			15 01 00 00 00 00 02 EA D6
			15 01 00 00 00 00 02 EB 03
			15 01 00 00 00 00 02 EC F1
			15 01 00 00 00 00 02 ED 03
			15 01 00 00 00 00 02 EE FF
			//G(+) MCR cmd
			15 01 00 00 00 00 02 EF 00
			15 01 00 00 00 00 02 F0 00
			15 01 00 00 00 00 02 F1 00
			15 01 00 00 00 00 02 F2 20
			15 01 00 00 00 00 02 F3 00
			15 01 00 00 00 00 02 F4 59
			15 01 00 00 00 00 02 F5 00
			15 01 00 00 00 00 02 F6 82
			15 01 00 00 00 00 02 F7 00
			15 01 00 00 00 00 02 F8 A0
			15 01 00 00 00 00 02 F9 00
			15 01 00 00 00 00 02 FA BA
			//page selection cmd start
			15 01 00 00 00 00 02 FB 01
			15 01 00 00 00 00 02 FF 21
			//page selection cmd end
			15 01 00 00 00 00 02 00 00
			15 01 00 00 00 00 02 01 D0
			15 01 00 00 00 00 02 02 00
			15 01 00 00 00 00 02 03 E4
			15 01 00 00 00 00 02 04 00
			15 01 00 00 00 00 02 05 F5
			15 01 00 00 00 00 02 06 01
			15 01 00 00 00 00 02 07 2F
			15 01 00 00 00 00 02 08 01
			15 01 00 00 00 00 02 09 59
			15 01 00 00 00 00 02 0A 01
			15 01 00 00 00 00 02 0B 98
			15 01 00 00 00 00 02 0C 01
			15 01 00 00 00 00 02 0D C6
			15 01 00 00 00 00 02 0E 02
			15 01 00 00 00 00 02 0F 0D
			15 01 00 00 00 00 02 10 02
			15 01 00 00 00 00 02 11 43
			15 01 00 00 00 00 02 12 02
			15 01 00 00 00 00 02 13 44
			15 01 00 00 00 00 02 14 02
			15 01 00 00 00 00 02 15 79
			15 01 00 00 00 00 02 16 02
			15 01 00 00 00 00 02 17 B4
			15 01 00 00 00 00 02 18 02
			15 01 00 00 00 00 02 19 DA
			15 01 00 00 00 00 02 1A 03
			15 01 00 00 00 00 02 1B 0C
			15 01 00 00 00 00 02 1C 03
			15 01 00 00 00 00 02 1D 30
			15 01 00 00 00 00 02 1E 03
			15 01 00 00 00 00 02 1F 61
			15 01 00 00 00 00 02 20 03
			15 01 00 00 00 00 02 21 71
			15 01 00 00 00 00 02 22 03
			15 01 00 00 00 00 02 23 82
			15 01 00 00 00 00 02 24 03
			15 01 00 00 00 00 02 25 94
			15 01 00 00 00 00 02 26 03
			15 01 00 00 00 00 02 27 A8
			15 01 00 00 00 00 02 28 03
			15 01 00 00 00 00 02 29 BE
			15 01 00 00 00 00 02 2A 03
			15 01 00 00 00 00 02 2B D7
			15 01 00 00 00 00 02 2D 03
			15 01 00 00 00 00 02 2F F1
			15 01 00 00 00 00 02 30 03
			15 01 00 00 00 00 02 31 FF
			//G(-) MCR cmd
			15 01 00 00 00 00 02 32 00
			15 01 00 00 00 00 02 33 00
			15 01 00 00 00 00 02 34 00
			15 01 00 00 00 00 02 35 20
			15 01 00 00 00 00 02 36 00
			15 01 00 00 00 00 02 37 59
			15 01 00 00 00 00 02 38 00
			15 01 00 00 00 00 02 39 82
			15 01 00 00 00 00 02 3A 00
			15 01 00 00 00 00 02 3B A0
			15 01 00 00 00 00 02 3D 00
			15 01 00 00 00 00 02 3F BA
			15 01 00 00 00 00 02 40 00
			15 01 00 00 00 00 02 41 D0
			15 01 00 00 00 00 02 42 00
			15 01 00 00 00 00 02 43 E4
			15 01 00 00 00 00 02 44 00
			15 01 00 00 00 00 02 45 F5
			15 01 00 00 00 00 02 46 01
			15 01 00 00 00 00 02 47 2F
			15 01 00 00 00 00 02 48 01
			15 01 00 00 00 00 02 49 59
			15 01 00 00 00 00 02 4A 01
			15 01 00 00 00 00 02 4B 98
			15 01 00 00 00 00 02 4C 01
			15 01 00 00 00 00 02 4D C6
			15 01 00 00 00 00 02 4E 02
			15 01 00 00 00 00 02 4F 0D
			15 01 00 00 00 00 02 50 02
			15 01 00 00 00 00 02 51 43
			15 01 00 00 00 00 02 52 02
			15 01 00 00 00 00 02 53 44
			15 01 00 00 00 00 02 54 02
			15 01 00 00 00 00 02 55 79
			15 01 00 00 00 00 02 56 02
			15 01 00 00 00 00 02 58 B4
			15 01 00 00 00 00 02 59 02
			15 01 00 00 00 00 02 5A DA
			15 01 00 00 00 00 02 5B 03
			15 01 00 00 00 00 02 5C 0C
			15 01 00 00 00 00 02 5D 03
			15 01 00 00 00 00 02 5E 30
			15 01 00 00 00 00 02 5F 03
			15 01 00 00 00 00 02 60 61
			15 01 00 00 00 00 02 61 03
			15 01 00 00 00 00 02 62 71
			15 01 00 00 00 00 02 63 03
			15 01 00 00 00 00 02 64 82
			15 01 00 00 00 00 02 65 03
			15 01 00 00 00 00 02 66 94
			15 01 00 00 00 00 02 67 03
			15 01 00 00 00 00 02 68 A8
			15 01 00 00 00 00 02 69 03
			15 01 00 00 00 00 02 6A BE
			15 01 00 00 00 00 02 6B 03
			15 01 00 00 00 00 02 6C D7
			15 01 00 00 00 00 02 6D 03
			15 01 00 00 00 00 02 6E F1
			15 01 00 00 00 00 02 6F 03
			15 01 00 00 00 00 02 70 FF
			//B(+) MCR cmd
			15 01 00 00 00 00 02 71 00
			15 01 00 00 00 00 02 72 00
			15 01 00 00 00 00 02 73 00
			15 01 00 00 00 00 02 74 23
			15 01 00 00 00 00 02 75 00
			15 01 00 00 00 00 02 76 61
			15 01 00 00 00 00 02 77 00
			15 01 00 00 00 00 02 78 8C
			15 01 00 00 00 00 02 79 00
			15 01 00 00 00 00 02 7A AA
			15 01 00 00 00 00 02 7B 00
			15 01 00 00 00 00 02 7C C3
			15 01 00 00 00 00 02 7D 00
			15 01 00 00 00 00 02 7E DA
			15 01 00 00 00 00 02 7F 00
			15 01 00 00 00 00 02 80 EE
			15 01 00 00 00 00 02 81 00
			15 01 00 00 00 00 02 82 FF
			15 01 00 00 00 00 02 83 01
			15 01 00 00 00 00 02 84 37
			15 01 00 00 00 00 02 85 01
			15 01 00 00 00 00 02 86 61
			15 01 00 00 00 00 02 87 01
			15 01 00 00 00 00 02 88 A0
			15 01 00 00 00 00 02 89 01
			15 01 00 00 00 00 02 8A CE
			15 01 00 00 00 00 02 8B 02
			15 01 00 00 00 00 02 8C 12
			15 01 00 00 00 00 02 8D 02
			15 01 00 00 00 00 02 8E 49
			15 01 00 00 00 00 02 8F 02
			15 01 00 00 00 00 02 90 4A
			15 01 00 00 00 00 02 91 02
			15 01 00 00 00 00 02 92 7C
			15 01 00 00 00 00 02 93 02
			15 01 00 00 00 00 02 94 B7
			15 01 00 00 00 00 02 95 02
			15 01 00 00 00 00 02 96 DC
			15 01 00 00 00 00 02 97 03
			15 01 00 00 00 00 02 98 0E
			15 01 00 00 00 00 02 99 03
			15 01 00 00 00 00 02 9A 31
			15 01 00 00 00 00 02 9B 03
			15 01 00 00 00 00 02 9C 63
			15 01 00 00 00 00 02 9D 03
			15 01 00 00 00 00 02 9E 72
			15 01 00 00 00 00 02 9F 03
			15 01 00 00 00 00 02 A0 83
			15 01 00 00 00 00 02 A2 03
			15 01 00 00 00 00 02 A3 95
			15 01 00 00 00 00 02 A4 03
			15 01 00 00 00 00 02 A5 A9
			15 01 00 00 00 00 02 A6 03
			15 01 00 00 00 00 02 A7 BF
			15 01 00 00 00 00 02 A9 03
			15 01 00 00 00 00 02 AA D7
			15 01 00 00 00 00 02 AB 03
			15 01 00 00 00 00 02 AC F2
			15 01 00 00 00 00 02 AD 03
			15 01 00 00 00 00 02 AE FF
			//B(-) MCR cmd
			15 01 00 00 00 00 02 AF 00
			15 01 00 00 00 00 02 B0 00
			15 01 00 00 00 00 02 B1 00
			15 01 00 00 00 00 02 B2 23
			15 01 00 00 00 00 02 B3 00
			15 01 00 00 00 00 02 B4 61
			15 01 00 00 00 00 02 B5 00
			15 01 00 00 00 00 02 B6 8C
			15 01 00 00 00 00 02 B7 00
			15 01 00 00 00 00 02 B8 AA
			15 01 00 00 00 00 02 B9 00
			15 01 00 00 00 00 02 BA C3
			15 01 00 00 00 00 02 BB 00
			15 01 00 00 00 00 02 BC DA
			15 01 00 00 00 00 02 BD 00
			15 01 00 00 00 00 02 BE EE
			15 01 00 00 00 00 02 BF 00
			15 01 00 00 00 00 02 C0 FF
			15 01 00 00 00 00 02 C1 01
			15 01 00 00 00 00 02 C2 37
			15 01 00 00 00 00 02 C3 01
			15 01 00 00 00 00 02 C4 61
			15 01 00 00 00 00 02 C5 01
			15 01 00 00 00 00 02 C6 A0
			15 01 00 00 00 00 02 C7 01
			15 01 00 00 00 00 02 C8 CE
			15 01 00 00 00 00 02 C9 02
			15 01 00 00 00 00 02 CA 12
			15 01 00 00 00 00 02 CB 02
			15 01 00 00 00 00 02 CC 49
			15 01 00 00 00 00 02 CD 02
			15 01 00 00 00 00 02 CE 4A
			15 01 00 00 00 00 02 CF 02
			15 01 00 00 00 00 02 D0 7C
			15 01 00 00 00 00 02 D1 02
			15 01 00 00 00 00 02 D2 B7
			15 01 00 00 00 00 02 D3 02
			15 01 00 00 00 00 02 D4 DC
			15 01 00 00 00 00 02 D5 03
			15 01 00 00 00 00 02 D6 0E
			15 01 00 00 00 00 02 D7 03
			15 01 00 00 00 00 02 D8 31
			15 01 00 00 00 00 02 D9 03
			15 01 00 00 00 00 02 DA 63
			15 01 00 00 00 00 02 DB 03
			15 01 00 00 00 00 02 DC 72
			15 01 00 00 00 00 02 DD 03
			15 01 00 00 00 00 02 DE 83
			15 01 00 00 00 00 02 DF 03
			15 01 00 00 00 00 02 E0 95
			15 01 00 00 00 00 02 E1 03
			15 01 00 00 00 00 02 E2 A9
			15 01 00 00 00 00 02 E3 03
			15 01 00 00 00 00 02 E4 BF
			15 01 00 00 00 00 02 E5 03
			15 01 00 00 00 00 02 E6 D7
			15 01 00 00 00 00 02 E7 03
			15 01 00 00 00 00 02 E8 F2
			15 01 00 00 00 00 02 E9 03
			15 01 00 00 00 00 02 EA FF
			15 01 00 00 00 00 02 FB 01
		];

		qcom,panel-reader-mode-initial-step1-command = [
			//page selection cmd start
			15 01 00 00 00 00 02 FF 20
			//R(+) MCR cmd
			15 01 00 00 00 00 02 75 00
			15 01 00 00 00 00 02 76 00
			15 01 00 00 00 00 02 77 00
			15 01 00 00 00 00 02 78 1F
			15 01 00 00 00 00 02 79 00
			15 01 00 00 00 00 02 7A 56
			15 01 00 00 00 00 02 7B 00
			15 01 00 00 00 00 02 7C 7F
			15 01 00 00 00 00 02 7D 00
			15 01 00 00 00 00 02 7E 9E
			15 01 00 00 00 00 02 7F 00
			15 01 00 00 00 00 02 80 B8
			15 01 00 00 00 00 02 81 00
			15 01 00 00 00 00 02 82 CE
			15 01 00 00 00 00 02 83 00
			15 01 00 00 00 00 02 84 E2
			15 01 00 00 00 00 02 85 00
			15 01 00 00 00 00 02 86 F4
			15 01 00 00 00 00 02 87 01
			15 01 00 00 00 00 02 88 2D
			15 01 00 00 00 00 02 89 01
			15 01 00 00 00 00 02 8A 58
			15 01 00 00 00 00 02 8B 01
			15 01 00 00 00 00 02 8C 97
			15 01 00 00 00 00 02 8D 01
			15 01 00 00 00 00 02 8E C7
			15 01 00 00 00 00 02 8F 02
			15 01 00 00 00 00 02 90 0D
			15 01 00 00 00 00 02 91 02
			15 01 00 00 00 00 02 92 42
			15 01 00 00 00 00 02 93 02
			15 01 00 00 00 00 02 94 44
			15 01 00 00 00 00 02 95 02
			15 01 00 00 00 00 02 96 79
			15 01 00 00 00 00 02 97 02
			15 01 00 00 00 00 02 98 B4
			15 01 00 00 00 00 02 99 02
			15 01 00 00 00 00 02 9A DA
			15 01 00 00 00 00 02 9B 03
			15 01 00 00 00 00 02 9C 0B
			15 01 00 00 00 00 02 9D 03
			15 01 00 00 00 00 02 9E 2F
			15 01 00 00 00 00 02 9F 03
			15 01 00 00 00 00 02 A0 60
			15 01 00 00 00 00 02 A2 03
			15 01 00 00 00 00 02 A3 70
			15 01 00 00 00 00 02 A4 03
			15 01 00 00 00 00 02 A5 81
			15 01 00 00 00 00 02 A6 03
			15 01 00 00 00 00 02 A7 93
			15 01 00 00 00 00 02 A9 03
			15 01 00 00 00 00 02 AA A7
			15 01 00 00 00 00 02 AB 03
			15 01 00 00 00 00 02 AC BE
			15 01 00 00 00 00 02 AD 03
			15 01 00 00 00 00 02 AE D6
			15 01 00 00 00 00 02 AF 03
			15 01 00 00 00 00 02 B0 F1
			15 01 00 00 00 00 02 B1 03
			15 01 00 00 00 00 02 B2 FF
			//R(-) MCR cmd
			15 01 00 00 00 00 02 B3 00
			15 01 00 00 00 00 02 B4 00
			15 01 00 00 00 00 02 B5 00
			15 01 00 00 00 00 02 B6 1F
			15 01 00 00 00 00 02 B7 00
			15 01 00 00 00 00 02 B8 56
			15 01 00 00 00 00 02 B9 00
			15 01 00 00 00 00 02 BA 7F
			15 01 00 00 00 00 02 BB 00
			15 01 00 00 00 00 02 BC 9E
			15 01 00 00 00 00 02 BD 00
			15 01 00 00 00 00 02 BE B8
			15 01 00 00 00 00 02 BF 00
			15 01 00 00 00 00 02 C0 CE
			15 01 00 00 00 00 02 C1 00
			15 01 00 00 00 00 02 C2 E2
			15 01 00 00 00 00 02 C3 00
			15 01 00 00 00 00 02 C4 F4
			15 01 00 00 00 00 02 C5 01
			15 01 00 00 00 00 02 C6 2D
			15 01 00 00 00 00 02 C7 01
			15 01 00 00 00 00 02 C8 58
			15 01 00 00 00 00 02 C9 01
			15 01 00 00 00 00 02 CA 97
			15 01 00 00 00 00 02 CB 01
			15 01 00 00 00 00 02 CC C7
			15 01 00 00 00 00 02 CD 02
			15 01 00 00 00 00 02 CE 0D
			15 01 00 00 00 00 02 CF 02
			15 01 00 00 00 00 02 D0 42
			15 01 00 00 00 00 02 D1 02
			15 01 00 00 00 00 02 D2 44
			15 01 00 00 00 00 02 D3 02
			15 01 00 00 00 00 02 D4 79
			15 01 00 00 00 00 02 D5 02
			15 01 00 00 00 00 02 D6 B4
			15 01 00 00 00 00 02 D7 02
			15 01 00 00 00 00 02 D8 DA
			15 01 00 00 00 00 02 D9 03
			15 01 00 00 00 00 02 DA 0B
			15 01 00 00 00 00 02 DB 03
			15 01 00 00 00 00 02 DC 2F
			15 01 00 00 00 00 02 DD 03
			15 01 00 00 00 00 02 DE 60
			15 01 00 00 00 00 02 DF 03
			15 01 00 00 00 00 02 E0 70
			15 01 00 00 00 00 02 E1 03
			15 01 00 00 00 00 02 E2 81
			15 01 00 00 00 00 02 E3 03
			15 01 00 00 00 00 02 E4 93
			15 01 00 00 00 00 02 E5 03
			15 01 00 00 00 00 02 E6 A7
			15 01 00 00 00 00 02 E7 03
			15 01 00 00 00 00 02 E8 BE
			15 01 00 00 00 00 02 E9 03
			15 01 00 00 00 00 02 EA D6
			15 01 00 00 00 00 02 EB 03
			15 01 00 00 00 00 02 EC F1
			15 01 00 00 00 00 02 ED 03
			15 01 00 00 00 00 02 EE FF
			//G(+) MCR cmd
			15 01 00 00 00 00 02 EF 00
			15 01 00 00 00 00 02 F0 CD
			15 01 00 00 00 00 02 F1 00
			15 01 00 00 00 00 02 F2 D7
			15 01 00 00 00 00 02 F3 00
			15 01 00 00 00 00 02 F4 E9
			15 01 00 00 00 00 02 F5 00
			15 01 00 00 00 00 02 F6 F8
			15 01 00 00 00 00 02 F7 01
			15 01 00 00 00 00 02 F8 07
			15 01 00 00 00 00 02 F9 01
			15 01 00 00 00 00 02 FA 15
			//page selection cmd start
			15 01 00 00 00 00 02 FB 01
			15 01 00 00 00 00 02 FF 21
			//page selection cmd end
			15 01 00 00 00 00 02 00 01
			15 01 00 00 00 00 02 01 23
			15 01 00 00 00 00 02 02 01
			15 01 00 00 00 00 02 03 2F
			15 01 00 00 00 00 02 04 01
			15 01 00 00 00 00 02 05 3A
			15 01 00 00 00 00 02 06 01
			15 01 00 00 00 00 02 07 60
			15 01 00 00 00 00 02 08 01
			15 01 00 00 00 00 02 09 7F
			15 01 00 00 00 00 02 0A 01
			15 01 00 00 00 00 02 0B B1
			15 01 00 00 00 00 02 0C 01
			15 01 00 00 00 00 02 0D D8
			15 01 00 00 00 00 02 0E 02
			15 01 00 00 00 00 02 0F 19
			15 01 00 00 00 00 02 10 02
			15 01 00 00 00 00 02 11 4C
			15 01 00 00 00 00 02 12 02
			15 01 00 00 00 00 02 13 4D
			15 01 00 00 00 00 02 14 02
			15 01 00 00 00 00 02 15 81
			15 01 00 00 00 00 02 16 02
			15 01 00 00 00 00 02 17 BA
			15 01 00 00 00 00 02 18 02
			15 01 00 00 00 00 02 19 E0
			15 01 00 00 00 00 02 1A 03
			15 01 00 00 00 00 02 1B 13
			15 01 00 00 00 00 02 1C 03
			15 01 00 00 00 00 02 1D 36
			15 01 00 00 00 00 02 1E 03
			15 01 00 00 00 00 02 1F 67
			15 01 00 00 00 00 02 20 03
			15 01 00 00 00 00 02 21 76
			15 01 00 00 00 00 02 22 03
			15 01 00 00 00 00 02 23 86
			15 01 00 00 00 00 02 24 03
			15 01 00 00 00 00 02 25 98
			15 01 00 00 00 00 02 26 03
			15 01 00 00 00 00 02 27 AC
			15 01 00 00 00 00 02 28 03
			15 01 00 00 00 00 02 29 C1
			15 01 00 00 00 00 02 2A 03
			15 01 00 00 00 00 02 2B D8
			15 01 00 00 00 00 02 2D 03
			15 01 00 00 00 00 02 2F F2
			15 01 00 00 00 00 02 30 03
			15 01 00 00 00 00 02 31 FF
			//G(-) MCR cmd
			15 01 00 00 00 00 02 32 00
			15 01 00 00 00 00 02 33 CD
			15 01 00 00 00 00 02 34 00
			15 01 00 00 00 00 02 35 D7
			15 01 00 00 00 00 02 36 00
			15 01 00 00 00 00 02 37 E9
			15 01 00 00 00 00 02 38 00
			15 01 00 00 00 00 02 39 F8
			15 01 00 00 00 00 02 3A 01
			15 01 00 00 00 00 02 3B 07
			15 01 00 00 00 00 02 3D 01
			15 01 00 00 00 00 02 3F 15
			15 01 00 00 00 00 02 40 01
			15 01 00 00 00 00 02 41 23
			15 01 00 00 00 00 02 42 01
			15 01 00 00 00 00 02 43 2F
			15 01 00 00 00 00 02 44 01
			15 01 00 00 00 00 02 45 3A
			15 01 00 00 00 00 02 46 01
			15 01 00 00 00 00 02 47 60
			15 01 00 00 00 00 02 48 01
			15 01 00 00 00 00 02 49 7F
			15 01 00 00 00 00 02 4A 01
			15 01 00 00 00 00 02 4B B1
			15 01 00 00 00 00 02 4C 01
			15 01 00 00 00 00 02 4D D8
			15 01 00 00 00 00 02 4E 02
			15 01 00 00 00 00 02 4F 19
			15 01 00 00 00 00 02 50 02
			15 01 00 00 00 00 02 51 4C
			15 01 00 00 00 00 02 52 02
			15 01 00 00 00 00 02 53 4D
			15 01 00 00 00 00 02 54 02
			15 01 00 00 00 00 02 55 81
			15 01 00 00 00 00 02 56 02
			15 01 00 00 00 00 02 58 BA
			15 01 00 00 00 00 02 59 02
			15 01 00 00 00 00 02 5A E0
			15 01 00 00 00 00 02 5B 03
			15 01 00 00 00 00 02 5C 13
			15 01 00 00 00 00 02 5D 03
			15 01 00 00 00 00 02 5E 36
			15 01 00 00 00 00 02 5F 03
			15 01 00 00 00 00 02 60 67
			15 01 00 00 00 00 02 61 03
			15 01 00 00 00 00 02 62 76
			15 01 00 00 00 00 02 63 03
			15 01 00 00 00 00 02 64 86
			15 01 00 00 00 00 02 65 03
			15 01 00 00 00 00 02 66 98
			15 01 00 00 00 00 02 67 03
			15 01 00 00 00 00 02 68 AC
			15 01 00 00 00 00 02 69 03
			15 01 00 00 00 00 02 6A C1
			15 01 00 00 00 00 02 6B 03
			15 01 00 00 00 00 02 6C D8
			15 01 00 00 00 00 02 6D 03
			15 01 00 00 00 00 02 6E F2
			15 01 00 00 00 00 02 6F 03
			15 01 00 00 00 00 02 70 FF
			//B(+) MCR cmd
			15 01 00 00 00 00 02 71 01
			15 01 00 00 00 00 02 72 54
			15 01 00 00 00 00 02 73 01
			15 01 00 00 00 00 02 74 59
			15 01 00 00 00 00 02 75 01
			15 01 00 00 00 00 02 76 62
			15 01 00 00 00 00 02 77 01
			15 01 00 00 00 00 02 78 69
			15 01 00 00 00 00 02 79 01
			15 01 00 00 00 00 02 7A 70
			15 01 00 00 00 00 02 7B 01
			15 01 00 00 00 00 02 7C 77
			15 01 00 00 00 00 02 7D 01
			15 01 00 00 00 00 02 7E 7E
			15 01 00 00 00 00 02 7F 01
			15 01 00 00 00 00 02 80 85
			15 01 00 00 00 00 02 81 01
			15 01 00 00 00 00 02 82 8C
			15 01 00 00 00 00 02 83 01
			15 01 00 00 00 00 02 84 A6
			15 01 00 00 00 00 02 85 01
			15 01 00 00 00 00 02 86 BA
			15 01 00 00 00 00 02 87 01
			15 01 00 00 00 00 02 88 DE
			15 01 00 00 00 00 02 89 01
			15 01 00 00 00 00 02 8A FC
			15 01 00 00 00 00 02 8B 02
			15 01 00 00 00 00 02 8C 31
			15 01 00 00 00 00 02 8D 02
			15 01 00 00 00 00 02 8E 5F
			15 01 00 00 00 00 02 8F 02
			15 01 00 00 00 00 02 90 60
			15 01 00 00 00 00 02 91 02
			15 01 00 00 00 00 02 92 8F
			15 01 00 00 00 00 02 93 02
			15 01 00 00 00 00 02 94 C7
			15 01 00 00 00 00 02 95 02
			15 01 00 00 00 00 02 96 EC
			15 01 00 00 00 00 02 97 03
			15 01 00 00 00 00 02 98 1B
			15 01 00 00 00 00 02 99 03
			15 01 00 00 00 00 02 9A 3A
			15 01 00 00 00 00 02 9B 03
			15 01 00 00 00 00 02 9C 67
			15 01 00 00 00 00 02 9D 03
			15 01 00 00 00 00 02 9E 75
			15 01 00 00 00 00 02 9F 03
			15 01 00 00 00 00 02 A0 84
			15 01 00 00 00 00 02 A2 03
			15 01 00 00 00 00 02 A3 96
			15 01 00 00 00 00 02 A4 03
			15 01 00 00 00 00 02 A5 A9
			15 01 00 00 00 00 02 A6 03
			15 01 00 00 00 00 02 A7 BF
			15 01 00 00 00 00 02 A9 03
			15 01 00 00 00 00 02 AA D7
			15 01 00 00 00 00 02 AB 03
			15 01 00 00 00 00 02 AC F1
			15 01 00 00 00 00 02 AD 03
			15 01 00 00 00 00 02 AE FF
			//B(-) MCR cmd
			15 01 00 00 00 00 02 AF 01
			15 01 00 00 00 00 02 B0 54
			15 01 00 00 00 00 02 B1 01
			15 01 00 00 00 00 02 B2 59
			15 01 00 00 00 00 02 B3 01
			15 01 00 00 00 00 02 B4 62
			15 01 00 00 00 00 02 B5 01
			15 01 00 00 00 00 02 B6 69
			15 01 00 00 00 00 02 B7 01
			15 01 00 00 00 00 02 B8 70
			15 01 00 00 00 00 02 B9 01
			15 01 00 00 00 00 02 BA 77
			15 01 00 00 00 00 02 BB 01
			15 01 00 00 00 00 02 BC 7E
			15 01 00 00 00 00 02 BD 01
			15 01 00 00 00 00 02 BE 85
			15 01 00 00 00 00 02 BF 01
			15 01 00 00 00 00 02 C0 8C
			15 01 00 00 00 00 02 C1 01
			15 01 00 00 00 00 02 C2 A6
			15 01 00 00 00 00 02 C3 01
			15 01 00 00 00 00 02 C4 BA
			15 01 00 00 00 00 02 C5 01
			15 01 00 00 00 00 02 C6 DE
			15 01 00 00 00 00 02 C7 01
			15 01 00 00 00 00 02 C8 FC
			15 01 00 00 00 00 02 C9 02
			15 01 00 00 00 00 02 CA 31
			15 01 00 00 00 00 02 CB 02
			15 01 00 00 00 00 02 CC 5F
			15 01 00 00 00 00 02 CD 02
			15 01 00 00 00 00 02 CE 60
			15 01 00 00 00 00 02 CF 02
			15 01 00 00 00 00 02 D0 8F
			15 01 00 00 00 00 02 D1 02
			15 01 00 00 00 00 02 D2 C7
			15 01 00 00 00 00 02 D3 02
			15 01 00 00 00 00 02 D4 EC
			15 01 00 00 00 00 02 D5 03
			15 01 00 00 00 00 02 D6 1B
			15 01 00 00 00 00 02 D7 03
			15 01 00 00 00 00 02 D8 3A
			15 01 00 00 00 00 02 D9 03
			15 01 00 00 00 00 02 DA 67
			15 01 00 00 00 00 02 DB 03
			15 01 00 00 00 00 02 DC 75
			15 01 00 00 00 00 02 DD 03
			15 01 00 00 00 00 02 DE 84
			15 01 00 00 00 00 02 DF 03
			15 01 00 00 00 00 02 E0 96
			15 01 00 00 00 00 02 E1 03
			15 01 00 00 00 00 02 E2 A9
			15 01 00 00 00 00 02 E3 03
			15 01 00 00 00 00 02 E4 BF
			15 01 00 00 00 00 02 E5 03
			15 01 00 00 00 00 02 E6 D7
			15 01 00 00 00 00 02 E7 03
			15 01 00 00 00 00 02 E8 F1
			15 01 00 00 00 00 02 E9 03
			15 01 00 00 00 00 02 EA FF
			//page selection cmd start
			15 01 00 00 00 00 02 FB 01
			15 01 00 00 00 00 02 FF 10
			//page selection cmd end
		];

		qcom,panel-reader-mode-step1-command = [
			//page selection cmd start
			15 01 00 00 00 00 02 FF 20
			//R(+) MCR cmd
			15 00 00 00 00 00 02 75 00
			15 00 00 00 00 00 02 76 00
			15 00 00 00 00 00 02 77 00
			15 00 00 00 00 00 02 78 1F
			15 00 00 00 00 00 02 79 00
			15 00 00 00 00 00 02 7A 56
			15 00 00 00 00 00 02 7B 00
			15 00 00 00 00 00 02 7C 7F
			15 00 00 00 00 00 02 7D 00
			15 00 00 00 00 00 02 7E 9E
			15 00 00 00 00 00 02 7F 00
			15 00 00 00 00 00 02 80 B8
			15 00 00 00 00 00 02 81 00
			15 00 00 00 00 00 02 82 CE
			15 00 00 00 00 00 02 83 00
			15 00 00 00 00 00 02 84 E2
			15 00 00 00 00 00 02 85 00
			15 00 00 00 00 00 02 86 F4
			15 00 00 00 00 00 02 87 01
			15 00 00 00 00 00 02 88 2D
			15 00 00 00 00 00 02 89 01
			15 00 00 00 00 00 02 8A 58
			15 00 00 00 00 00 02 8B 01
			15 00 00 00 00 00 02 8C 97
			15 00 00 00 00 00 02 8D 01
			15 00 00 00 00 00 02 8E C7
			15 00 00 00 00 00 02 8F 02
			15 00 00 00 00 00 02 90 0D
			15 00 00 00 00 00 02 91 02
			15 00 00 00 00 00 02 92 42
			15 00 00 00 00 00 02 93 02
			15 00 00 00 00 00 02 94 44
			15 00 00 00 00 00 02 95 02
			15 00 00 00 00 00 02 96 79
			15 00 00 00 00 00 02 97 02
			15 00 00 00 00 00 02 98 B4
			15 00 00 00 00 00 02 99 02
			15 00 00 00 00 00 02 9A DA
			15 00 00 00 00 00 02 9B 03
			15 00 00 00 00 00 02 9C 0B
			15 00 00 00 00 00 02 9D 03
			15 00 00 00 00 00 02 9E 2F
			15 00 00 00 00 00 02 9F 03
			15 00 00 00 00 00 02 A0 60
			15 00 00 00 00 00 02 A2 03
			15 00 00 00 00 00 02 A3 70
			15 00 00 00 00 00 02 A4 03
			15 00 00 00 00 00 02 A5 81
			15 00 00 00 00 00 02 A6 03
			15 00 00 00 00 00 02 A7 93
			15 00 00 00 00 00 02 A9 03
			15 00 00 00 00 00 02 AA A7
			15 00 00 00 00 00 02 AB 03
			15 00 00 00 00 00 02 AC BE
			15 00 00 00 00 00 02 AD 03
			15 00 00 00 00 00 02 AE D6
			15 00 00 00 00 00 02 AF 03
			15 00 00 00 00 00 02 B0 F1
			15 00 00 00 00 00 02 B1 03
			15 01 00 00 00 00 02 B2 FF
			//R(-) MCR cmd
			15 00 00 00 00 00 02 B3 00
			15 00 00 00 00 00 02 B4 00
			15 00 00 00 00 00 02 B5 00
			15 00 00 00 00 00 02 B6 1F
			15 00 00 00 00 00 02 B7 00
			15 00 00 00 00 00 02 B8 56
			15 00 00 00 00 00 02 B9 00
			15 00 00 00 00 00 02 BA 7F
			15 00 00 00 00 00 02 BB 00
			15 00 00 00 00 00 02 BC 9E
			15 00 00 00 00 00 02 BD 00
			15 00 00 00 00 00 02 BE B8
			15 00 00 00 00 00 02 BF 00
			15 00 00 00 00 00 02 C0 CE
			15 00 00 00 00 00 02 C1 00
			15 00 00 00 00 00 02 C2 E2
			15 00 00 00 00 00 02 C3 00
			15 00 00 00 00 00 02 C4 F4
			15 00 00 00 00 00 02 C5 01
			15 00 00 00 00 00 02 C6 2D
			15 00 00 00 00 00 02 C7 01
			15 00 00 00 00 00 02 C8 58
			15 00 00 00 00 00 02 C9 01
			15 00 00 00 00 00 02 CA 97
			15 00 00 00 00 00 02 CB 01
			15 00 00 00 00 00 02 CC C7
			15 00 00 00 00 00 02 CD 02
			15 00 00 00 00 00 02 CE 0D
			15 00 00 00 00 00 02 CF 02
			15 00 00 00 00 00 02 D0 42
			15 00 00 00 00 00 02 D1 02
			15 00 00 00 00 00 02 D2 44
			15 00 00 00 00 00 02 D3 02
			15 00 00 00 00 00 02 D4 79
			15 00 00 00 00 00 02 D5 02
			15 00 00 00 00 00 02 D6 B4
			15 00 00 00 00 00 02 D7 02
			15 00 00 00 00 00 02 D8 DA
			15 00 00 00 00 00 02 D9 03
			15 00 00 00 00 00 02 DA 0B
			15 00 00 00 00 00 02 DB 03
			15 00 00 00 00 00 02 DC 2F
			15 00 00 00 00 00 02 DD 03
			15 00 00 00 00 00 02 DE 60
			15 00 00 00 00 00 02 DF 03
			15 00 00 00 00 00 02 E0 70
			15 00 00 00 00 00 02 E1 03
			15 00 00 00 00 00 02 E2 81
			15 00 00 00 00 00 02 E3 03
			15 00 00 00 00 00 02 E4 93
			15 00 00 00 00 00 02 E5 03
			15 00 00 00 00 00 02 E6 A7
			15 00 00 00 00 00 02 E7 03
			15 00 00 00 00 00 02 E8 BE
			15 00 00 00 00 00 02 E9 03
			15 00 00 00 00 00 02 EA D6
			15 00 00 00 00 00 02 EB 03
			15 00 00 00 00 00 02 EC F1
			15 00 00 00 00 00 02 ED 03
			15 01 00 00 00 00 02 EE FF
			//G(+) MCR cmd
			15 00 00 00 00 00 02 EF 00
			15 00 00 00 00 00 02 F0 CD
			15 00 00 00 00 00 02 F1 00
			15 00 00 00 00 00 02 F2 D7
			15 00 00 00 00 00 02 F3 00
			15 00 00 00 00 00 02 F4 E9
			15 00 00 00 00 00 02 F5 00
			15 00 00 00 00 00 02 F6 F8
			15 00 00 00 00 00 02 F7 01
			15 00 00 00 00 00 02 F8 07
			15 00 00 00 00 00 02 F9 01
			15 00 00 00 00 00 02 FA 15
			//page selection cmd start
			15 00 00 00 00 00 02 FB 01
			15 01 00 00 00 00 02 FF 21
			//page selection cmd end
			15 00 00 00 00 00 02 00 01
			15 00 00 00 00 00 02 01 23
			15 00 00 00 00 00 02 02 01
			15 00 00 00 00 00 02 03 2F
			15 00 00 00 00 00 02 04 01
			15 00 00 00 00 00 02 05 3A
			15 00 00 00 00 00 02 06 01
			15 00 00 00 00 00 02 07 60
			15 00 00 00 00 00 02 08 01
			15 00 00 00 00 00 02 09 7F
			15 00 00 00 00 00 02 0A 01
			15 00 00 00 00 00 02 0B B1
			15 00 00 00 00 00 02 0C 01
			15 00 00 00 00 00 02 0D D8
			15 00 00 00 00 00 02 0E 02
			15 00 00 00 00 00 02 0F 19
			15 00 00 00 00 00 02 10 02
			15 00 00 00 00 00 02 11 4C
			15 00 00 00 00 00 02 12 02
			15 00 00 00 00 00 02 13 4D
			15 00 00 00 00 00 02 14 02
			15 00 00 00 00 00 02 15 81
			15 00 00 00 00 00 02 16 02
			15 00 00 00 00 00 02 17 BA
			15 00 00 00 00 00 02 18 02
			15 00 00 00 00 00 02 19 E0
			15 00 00 00 00 00 02 1A 03
			15 00 00 00 00 00 02 1B 13
			15 00 00 00 00 00 02 1C 03
			15 00 00 00 00 00 02 1D 36
			15 00 00 00 00 00 02 1E 03
			15 00 00 00 00 00 02 1F 67
			15 00 00 00 00 00 02 20 03
			15 00 00 00 00 00 02 21 76
			15 00 00 00 00 00 02 22 03
			15 00 00 00 00 00 02 23 86
			15 00 00 00 00 00 02 24 03
			15 00 00 00 00 00 02 25 98
			15 00 00 00 00 00 02 26 03
			15 00 00 00 00 00 02 27 AC
			15 00 00 00 00 00 02 28 03
			15 00 00 00 00 00 02 29 C1
			15 00 00 00 00 00 02 2A 03
			15 00 00 00 00 00 02 2B D8
			15 00 00 00 00 00 02 2D 03
			15 00 00 00 00 00 02 2F F2
			15 00 00 00 00 00 02 30 03
			15 01 00 00 00 00 02 31 FF
			//G(-) MCR cmd
			15 00 00 00 00 00 02 32 00
			15 00 00 00 00 00 02 33 CD
			15 00 00 00 00 00 02 34 00
			15 00 00 00 00 00 02 35 D7
			15 00 00 00 00 00 02 36 00
			15 00 00 00 00 00 02 37 E9
			15 00 00 00 00 00 02 38 00
			15 00 00 00 00 00 02 39 F8
			15 00 00 00 00 00 02 3A 01
			15 00 00 00 00 00 02 3B 07
			15 00 00 00 00 00 02 3D 01
			15 00 00 00 00 00 02 3F 15
			15 00 00 00 00 00 02 40 01
			15 00 00 00 00 00 02 41 23
			15 00 00 00 00 00 02 42 01
			15 00 00 00 00 00 02 43 2F
			15 00 00 00 00 00 02 44 01
			15 00 00 00 00 00 02 45 3A
			15 00 00 00 00 00 02 46 01
			15 00 00 00 00 00 02 47 60
			15 00 00 00 00 00 02 48 01
			15 00 00 00 00 00 02 49 7F
			15 00 00 00 00 00 02 4A 01
			15 00 00 00 00 00 02 4B B1
			15 00 00 00 00 00 02 4C 01
			15 00 00 00 00 00 02 4D D8
			15 00 00 00 00 00 02 4E 02
			15 00 00 00 00 00 02 4F 19
			15 00 00 00 00 00 02 50 02
			15 00 00 00 00 00 02 51 4C
			15 00 00 00 00 00 02 52 02
			15 00 00 00 00 00 02 53 4D
			15 00 00 00 00 00 02 54 02
			15 00 00 00 00 00 02 55 81
			15 00 00 00 00 00 02 56 02
			15 00 00 00 00 00 02 58 BA
			15 00 00 00 00 00 02 59 02
			15 00 00 00 00 00 02 5A E0
			15 00 00 00 00 00 02 5B 03
			15 00 00 00 00 00 02 5C 13
			15 00 00 00 00 00 02 5D 03
			15 00 00 00 00 00 02 5E 36
			15 00 00 00 00 00 02 5F 03
			15 00 00 00 00 00 02 60 67
			15 00 00 00 00 00 02 61 03
			15 00 00 00 00 00 02 62 76
			15 00 00 00 00 00 02 63 03
			15 00 00 00 00 00 02 64 86
			15 00 00 00 00 00 02 65 03
			15 00 00 00 00 00 02 66 98
			15 00 00 00 00 00 02 67 03
			15 00 00 00 00 00 02 68 AC
			15 00 00 00 00 00 02 69 03
			15 00 00 00 00 00 02 6A C1
			15 00 00 00 00 00 02 6B 03
			15 00 00 00 00 00 02 6C D8
			15 00 00 00 00 00 02 6D 03
			15 00 00 00 00 00 02 6E F2
			15 00 00 00 00 00 02 6F 03
			15 01 00 00 00 00 02 70 FF
			//B(+) MCR cmd
			15 00 00 00 00 00 02 71 01
			15 00 00 00 00 00 02 72 54
			15 00 00 00 00 00 02 73 01
			15 00 00 00 00 00 02 74 59
			15 00 00 00 00 00 02 75 01
			15 00 00 00 00 00 02 76 62
			15 00 00 00 00 00 02 77 01
			15 00 00 00 00 00 02 78 69
			15 00 00 00 00 00 02 79 01
			15 00 00 00 00 00 02 7A 70
			15 00 00 00 00 00 02 7B 01
			15 00 00 00 00 00 02 7C 77
			15 00 00 00 00 00 02 7D 01
			15 00 00 00 00 00 02 7E 7E
			15 00 00 00 00 00 02 7F 01
			15 00 00 00 00 00 02 80 85
			15 00 00 00 00 00 02 81 01
			15 00 00 00 00 00 02 82 8C
			15 00 00 00 00 00 02 83 01
			15 00 00 00 00 00 02 84 A6
			15 00 00 00 00 00 02 85 01
			15 00 00 00 00 00 02 86 BA
			15 00 00 00 00 00 02 87 01
			15 00 00 00 00 00 02 88 DE
			15 00 00 00 00 00 02 89 01
			15 00 00 00 00 00 02 8A FC
			15 00 00 00 00 00 02 8B 02
			15 00 00 00 00 00 02 8C 31
			15 00 00 00 00 00 02 8D 02
			15 00 00 00 00 00 02 8E 5F
			15 00 00 00 00 00 02 8F 02
			15 00 00 00 00 00 02 90 60
			15 00 00 00 00 00 02 91 02
			15 00 00 00 00 00 02 92 8F
			15 00 00 00 00 00 02 93 02
			15 00 00 00 00 00 02 94 C7
			15 00 00 00 00 00 02 95 02
			15 00 00 00 00 00 02 96 EC
			15 00 00 00 00 00 02 97 03
			15 00 00 00 00 00 02 98 1B
			15 00 00 00 00 00 02 99 03
			15 00 00 00 00 00 02 9A 3A
			15 00 00 00 00 00 02 9B 03
			15 00 00 00 00 00 02 9C 67
			15 00 00 00 00 00 02 9D 03
			15 00 00 00 00 00 02 9E 75
			15 00 00 00 00 00 02 9F 03
			15 00 00 00 00 00 02 A0 84
			15 00 00 00 00 00 02 A2 03
			15 00 00 00 00 00 02 A3 96
			15 00 00 00 00 00 02 A4 03
			15 00 00 00 00 00 02 A5 A9
			15 00 00 00 00 00 02 A6 03
			15 00 00 00 00 00 02 A7 BF
			15 00 00 00 00 00 02 A9 03
			15 00 00 00 00 00 02 AA D7
			15 00 00 00 00 00 02 AB 03
			15 00 00 00 00 00 02 AC F1
			15 00 00 00 00 00 02 AD 03
			15 01 00 00 00 00 02 AE FF
			//B(-) MCR cmd
			15 00 00 00 00 00 02 AF 01
			15 00 00 00 00 00 02 B0 54
			15 00 00 00 00 00 02 B1 01
			15 00 00 00 00 00 02 B2 59
			15 00 00 00 00 00 02 B3 01
			15 00 00 00 00 00 02 B4 62
			15 00 00 00 00 00 02 B5 01
			15 00 00 00 00 00 02 B6 69
			15 00 00 00 00 00 02 B7 01
			15 00 00 00 00 00 02 B8 70
			15 00 00 00 00 00 02 B9 01
			15 00 00 00 00 00 02 BA 77
			15 00 00 00 00 00 02 BB 01
			15 00 00 00 00 00 02 BC 7E
			15 00 00 00 00 00 02 BD 01
			15 00 00 00 00 00 02 BE 85
			15 00 00 00 00 00 02 BF 01
			15 00 00 00 00 00 02 C0 8C
			15 00 00 00 00 00 02 C1 01
			15 00 00 00 00 00 02 C2 A6
			15 00 00 00 00 00 02 C3 01
			15 00 00 00 00 00 02 C4 BA
			15 00 00 00 00 00 02 C5 01
			15 00 00 00 00 00 02 C6 DE
			15 00 00 00 00 00 02 C7 01
			15 00 00 00 00 00 02 C8 FC
			15 00 00 00 00 00 02 C9 02
			15 00 00 00 00 00 02 CA 31
			15 00 00 00 00 00 02 CB 02
			15 00 00 00 00 00 02 CC 5F
			15 00 00 00 00 00 02 CD 02
			15 00 00 00 00 00 02 CE 60
			15 00 00 00 00 00 02 CF 02
			15 00 00 00 00 00 02 D0 8F
			15 00 00 00 00 00 02 D1 02
			15 00 00 00 00 00 02 D2 C7
			15 00 00 00 00 00 02 D3 02
			15 00 00 00 00 00 02 D4 EC
			15 00 00 00 00 00 02 D5 03
			15 00 00 00 00 00 02 D6 1B
			15 00 00 00 00 00 02 D7 03
			15 00 00 00 00 00 02 D8 3A
			15 00 00 00 00 00 02 D9 03
			15 00 00 00 00 00 02 DA 67
			15 00 00 00 00 00 02 DB 03
			15 00 00 00 00 00 02 DC 75
			15 00 00 00 00 00 02 DD 03
			15 00 00 00 00 00 02 DE 84
			15 00 00 00 00 00 02 DF 03
			15 00 00 00 00 00 02 E0 96
			15 00 00 00 00 00 02 E1 03
			15 00 00 00 00 00 02 E2 A9
			15 00 00 00 00 00 02 E3 03
			15 00 00 00 00 00 02 E4 BF
			15 00 00 00 00 00 02 E5 03
			15 00 00 00 00 00 02 E6 D7
			15 00 00 00 00 00 02 E7 03
			15 00 00 00 00 00 02 E8 F1
			15 00 00 00 00 00 02 E9 03
			15 00 00 00 00 00 02 EA FF
			//page selection cmd start
			15 00 00 00 00 00 02 FB 01
			15 01 00 00 00 00 02 FF 10
			//page selection cmd end
		];

		qcom,panel-reader-mode-initial-step2-command = [
			//page selection cmd start
			15 01 00 00 00 00 02 FF 20
			//R(+) MCR cmd
			15 01 00 00 00 00 02 75 00
			15 01 00 00 00 00 02 76 00
			15 01 00 00 00 00 02 77 00
			15 01 00 00 00 00 02 78 1F
			15 01 00 00 00 00 02 79 00
			15 01 00 00 00 00 02 7A 56
			15 01 00 00 00 00 02 7B 00
			15 01 00 00 00 00 02 7C 7F
			15 01 00 00 00 00 02 7D 00
			15 01 00 00 00 00 02 7E 9E
			15 01 00 00 00 00 02 7F 00
			15 01 00 00 00 00 02 80 B8
			15 01 00 00 00 00 02 81 00
			15 01 00 00 00 00 02 82 CE
			15 01 00 00 00 00 02 83 00
			15 01 00 00 00 00 02 84 E2
			15 01 00 00 00 00 02 85 00
			15 01 00 00 00 00 02 86 F4
			15 01 00 00 00 00 02 87 01
			15 01 00 00 00 00 02 88 2D
			15 01 00 00 00 00 02 89 01
			15 01 00 00 00 00 02 8A 58
			15 01 00 00 00 00 02 8B 01
			15 01 00 00 00 00 02 8C 97
			15 01 00 00 00 00 02 8D 01
			15 01 00 00 00 00 02 8E C7
			15 01 00 00 00 00 02 8F 02
			15 01 00 00 00 00 02 90 0D
			15 01 00 00 00 00 02 91 02
			15 01 00 00 00 00 02 92 42
			15 01 00 00 00 00 02 93 02
			15 01 00 00 00 00 02 94 44
			15 01 00 00 00 00 02 95 02
			15 01 00 00 00 00 02 96 79
			15 01 00 00 00 00 02 97 02
			15 01 00 00 00 00 02 98 B4
			15 01 00 00 00 00 02 99 02
			15 01 00 00 00 00 02 9A DA
			15 01 00 00 00 00 02 9B 03
			15 01 00 00 00 00 02 9C 0B
			15 01 00 00 00 00 02 9D 03
			15 01 00 00 00 00 02 9E 2F
			15 01 00 00 00 00 02 9F 03
			15 01 00 00 00 00 02 A0 60
			15 01 00 00 00 00 02 A2 03
			15 01 00 00 00 00 02 A3 70
			15 01 00 00 00 00 02 A4 03
			15 01 00 00 00 00 02 A5 81
			15 01 00 00 00 00 02 A6 03
			15 01 00 00 00 00 02 A7 93
			15 01 00 00 00 00 02 A9 03
			15 01 00 00 00 00 02 AA A7
			15 01 00 00 00 00 02 AB 03
			15 01 00 00 00 00 02 AC BE
			15 01 00 00 00 00 02 AD 03
			15 01 00 00 00 00 02 AE D6
			15 01 00 00 00 00 02 AF 03
			15 01 00 00 00 00 02 B0 F1
			15 01 00 00 00 00 02 B1 03
			15 01 00 00 00 00 02 B2 FF
			//R(-) MCR cmd
			15 01 00 00 00 00 02 B3 00
			15 01 00 00 00 00 02 B4 00
			15 01 00 00 00 00 02 B5 00
			15 01 00 00 00 00 02 B6 1F
			15 01 00 00 00 00 02 B7 00
			15 01 00 00 00 00 02 B8 56
			15 01 00 00 00 00 02 B9 00
			15 01 00 00 00 00 02 BA 7F
			15 01 00 00 00 00 02 BB 00
			15 01 00 00 00 00 02 BC 9E
			15 01 00 00 00 00 02 BD 00
			15 01 00 00 00 00 02 BE B8
			15 01 00 00 00 00 02 BF 00
			15 01 00 00 00 00 02 C0 CE
			15 01 00 00 00 00 02 C1 00
			15 01 00 00 00 00 02 C2 E2
			15 01 00 00 00 00 02 C3 00
			15 01 00 00 00 00 02 C4 F4
			15 01 00 00 00 00 02 C5 01
			15 01 00 00 00 00 02 C6 2D
			15 01 00 00 00 00 02 C7 01
			15 01 00 00 00 00 02 C8 58
			15 01 00 00 00 00 02 C9 01
			15 01 00 00 00 00 02 CA 97
			15 01 00 00 00 00 02 CB 01
			15 01 00 00 00 00 02 CC C7
			15 01 00 00 00 00 02 CD 02
			15 01 00 00 00 00 02 CE 0D
			15 01 00 00 00 00 02 CF 02
			15 01 00 00 00 00 02 D0 42
			15 01 00 00 00 00 02 D1 02
			15 01 00 00 00 00 02 D2 44
			15 01 00 00 00 00 02 D3 02
			15 01 00 00 00 00 02 D4 79
			15 01 00 00 00 00 02 D5 02
			15 01 00 00 00 00 02 D6 B4
			15 01 00 00 00 00 02 D7 02
			15 01 00 00 00 00 02 D8 DA
			15 01 00 00 00 00 02 D9 03
			15 01 00 00 00 00 02 DA 0B
			15 01 00 00 00 00 02 DB 03
			15 01 00 00 00 00 02 DC 2F
			15 01 00 00 00 00 02 DD 03
			15 01 00 00 00 00 02 DE 60
			15 01 00 00 00 00 02 DF 03
			15 01 00 00 00 00 02 E0 70
			15 01 00 00 00 00 02 E1 03
			15 01 00 00 00 00 02 E2 81
			15 01 00 00 00 00 02 E3 03
			15 01 00 00 00 00 02 E4 93
			15 01 00 00 00 00 02 E5 03
			15 01 00 00 00 00 02 E6 A7
			15 01 00 00 00 00 02 E7 03
			15 01 00 00 00 00 02 E8 BE
			15 01 00 00 00 00 02 E9 03
			15 01 00 00 00 00 02 EA D6
			15 01 00 00 00 00 02 EB 03
			15 01 00 00 00 00 02 EC F1
			15 01 00 00 00 00 02 ED 03
			15 01 00 00 00 00 02 EE FF
			//G(+) MCR cmd
			15 01 00 00 00 00 02 EF 01
			15 01 00 00 00 00 02 F0 15
			15 01 00 00 00 00 02 F1 01
			15 01 00 00 00 00 02 F2 1C
			15 01 00 00 00 00 02 F3 01
			15 01 00 00 00 00 02 F4 2A
			15 01 00 00 00 00 02 F5 01
			15 01 00 00 00 00 02 F6 35
			15 01 00 00 00 00 02 F7 01
			15 01 00 00 00 00 02 F8 3E
			15 01 00 00 00 00 02 F9 01
			15 01 00 00 00 00 02 FA 48
			//page selection cmd start
			15 01 00 00 00 00 02 FB 01
			15 01 00 00 00 00 02 FF 21
			//page selection cmd end
			15 01 00 00 00 00 02 00 01
			15 01 00 00 00 00 02 01 52
			15 01 00 00 00 00 02 02 01
			15 01 00 00 00 00 02 03 5A
			15 01 00 00 00 00 02 04 01
			15 01 00 00 00 00 02 05 62
			15 01 00 00 00 00 02 06 01
			15 01 00 00 00 00 02 07 7F
			15 01 00 00 00 00 02 08 01
			15 01 00 00 00 00 02 09 9B
			15 01 00 00 00 00 02 0A 01
			15 01 00 00 00 00 02 0B C6
			15 01 00 00 00 00 02 0C 01
			15 01 00 00 00 00 02 0D E7
			15 01 00 00 00 00 02 0E 02
			15 01 00 00 00 00 02 0F 21
			15 01 00 00 00 00 02 10 02
			15 01 00 00 00 00 02 11 53
			15 01 00 00 00 00 02 12 02
			15 01 00 00 00 00 02 13 54
			15 01 00 00 00 00 02 14 02
			15 01 00 00 00 00 02 15 86
			15 01 00 00 00 00 02 16 02
			15 01 00 00 00 00 02 17 C0
			15 01 00 00 00 00 02 18 02
			15 01 00 00 00 00 02 19 E5
			15 01 00 00 00 00 02 1A 03
			15 01 00 00 00 00 02 1B 18
			15 01 00 00 00 00 02 1C 03
			15 01 00 00 00 00 02 1D 3B
			15 01 00 00 00 00 02 1E 03
			15 01 00 00 00 00 02 1F 6B
			15 01 00 00 00 00 02 20 03
			15 01 00 00 00 00 02 21 79
			15 01 00 00 00 00 02 22 03
			15 01 00 00 00 00 02 23 89
			15 01 00 00 00 00 02 24 03
			15 01 00 00 00 00 02 25 9B
			15 01 00 00 00 00 02 26 03
			15 01 00 00 00 00 02 27 AE
			15 01 00 00 00 00 02 28 03
			15 01 00 00 00 00 02 29 C3
			15 01 00 00 00 00 02 2A 03
			15 01 00 00 00 00 02 2B DA
			15 01 00 00 00 00 02 2D 03
			15 01 00 00 00 00 02 2F F2
			15 01 00 00 00 00 02 30 03
			15 01 00 00 00 00 02 31 FF
			//G(-) MCR cmd
			15 01 00 00 00 00 02 32 01
			15 01 00 00 00 00 02 33 15
			15 01 00 00 00 00 02 34 01
			15 01 00 00 00 00 02 35 1C
			15 01 00 00 00 00 02 36 01
			15 01 00 00 00 00 02 37 2A
			15 01 00 00 00 00 02 38 01
			15 01 00 00 00 00 02 39 35
			15 01 00 00 00 00 02 3A 01
			15 01 00 00 00 00 02 3B 3E
			15 01 00 00 00 00 02 3D 01
			15 01 00 00 00 00 02 3F 48
			15 01 00 00 00 00 02 40 01
			15 01 00 00 00 00 02 41 52
			15 01 00 00 00 00 02 42 01
			15 01 00 00 00 00 02 43 5A
			15 01 00 00 00 00 02 44 01
			15 01 00 00 00 00 02 45 62
			15 01 00 00 00 00 02 46 01
			15 01 00 00 00 00 02 47 7F
			15 01 00 00 00 00 02 48 01
			15 01 00 00 00 00 02 49 9B
			15 01 00 00 00 00 02 4A 01
			15 01 00 00 00 00 02 4B C6
			15 01 00 00 00 00 02 4C 01
			15 01 00 00 00 00 02 4D E7
			15 01 00 00 00 00 02 4E 02
			15 01 00 00 00 00 02 4F 21
			15 01 00 00 00 00 02 50 02
			15 01 00 00 00 00 02 51 53
			15 01 00 00 00 00 02 52 02
			15 01 00 00 00 00 02 53 54
			15 01 00 00 00 00 02 54 02
			15 01 00 00 00 00 02 55 86
			15 01 00 00 00 00 02 56 02
			15 01 00 00 00 00 02 58 C0
			15 01 00 00 00 00 02 59 02
			15 01 00 00 00 00 02 5A E5
			15 01 00 00 00 00 02 5B 03
			15 01 00 00 00 00 02 5C 18
			15 01 00 00 00 00 02 5D 03
			15 01 00 00 00 00 02 5E 3B
			15 01 00 00 00 00 02 5F 03
			15 01 00 00 00 00 02 60 6B
			15 01 00 00 00 00 02 61 03
			15 01 00 00 00 00 02 62 79
			15 01 00 00 00 00 02 63 03
			15 01 00 00 00 00 02 64 89
			15 01 00 00 00 00 02 65 03
			15 01 00 00 00 00 02 66 9B
			15 01 00 00 00 00 02 67 03
			15 01 00 00 00 00 02 68 AE
			15 01 00 00 00 00 02 69 03
			15 01 00 00 00 00 02 6A C3
			15 01 00 00 00 00 02 6B 03
			15 01 00 00 00 00 02 6C DA
			15 01 00 00 00 00 02 6D 03
			15 01 00 00 00 00 02 6E F2
			15 01 00 00 00 00 02 6F 03
			15 01 00 00 00 00 02 70 FF
			//B(+) MCR cmd
			15 01 00 00 00 00 02 71 01
			15 01 00 00 00 00 02 72 A3
			15 01 00 00 00 00 02 73 01
			15 01 00 00 00 00 02 74 A6
			15 01 00 00 00 00 02 75 01
			15 01 00 00 00 00 02 76 AA
			15 01 00 00 00 00 02 77 01
			15 01 00 00 00 00 02 78 AF
			15 01 00 00 00 00 02 79 01
			15 01 00 00 00 00 02 7A B4
			15 01 00 00 00 00 02 7B 01
			15 01 00 00 00 00 02 7C B8
			15 01 00 00 00 00 02 7D 01
			15 01 00 00 00 00 02 7E BD
			15 01 00 00 00 00 02 7F 01
			15 01 00 00 00 00 02 80 C2
			15 01 00 00 00 00 02 81 01
			15 01 00 00 00 00 02 82 C6
			15 01 00 00 00 00 02 83 01
			15 01 00 00 00 00 02 84 D6
			15 01 00 00 00 00 02 85 01
			15 01 00 00 00 00 02 86 E4
			15 01 00 00 00 00 02 87 01
			15 01 00 00 00 00 02 88 FF
			15 01 00 00 00 00 02 89 02
			15 01 00 00 00 00 02 8A 19
			15 01 00 00 00 00 02 8B 02
			15 01 00 00 00 00 02 8C 46
			15 01 00 00 00 00 02 8D 02
			15 01 00 00 00 00 02 8E 6E
			15 01 00 00 00 00 02 8F 02
			15 01 00 00 00 00 02 90 6F
			15 01 00 00 00 00 02 91 02
			15 01 00 00 00 00 02 92 9D
			15 01 00 00 00 00 02 93 02
			15 01 00 00 00 00 02 94 D2
			15 01 00 00 00 00 02 95 02
			15 01 00 00 00 00 02 96 F8
			15 01 00 00 00 00 02 97 03
			15 01 00 00 00 00 02 98 27
			15 01 00 00 00 00 02 99 03
			15 01 00 00 00 00 02 9A 48
			15 01 00 00 00 00 02 9B 03
			15 01 00 00 00 00 02 9C 74
			15 01 00 00 00 00 02 9D 03
			15 01 00 00 00 00 02 9E 82
			15 01 00 00 00 00 02 9F 03
			15 01 00 00 00 00 02 A0 91
			15 01 00 00 00 00 02 A2 03
			15 01 00 00 00 00 02 A3 A1
			15 01 00 00 00 00 02 A4 03
			15 01 00 00 00 00 02 A5 B3
			15 01 00 00 00 00 02 A6 03
			15 01 00 00 00 00 02 A7 C7
			15 01 00 00 00 00 02 A9 03
			15 01 00 00 00 00 02 AA DC
			15 01 00 00 00 00 02 AB 03
			15 01 00 00 00 00 02 AC F3
			15 01 00 00 00 00 02 AD 03
			15 01 00 00 00 00 02 AE FF
			//B(-) MCR cmd
			15 01 00 00 00 00 02 AF 01
			15 01 00 00 00 00 02 B0 A3
			15 01 00 00 00 00 02 B1 01
			15 01 00 00 00 00 02 B2 A6
			15 01 00 00 00 00 02 B3 01
			15 01 00 00 00 00 02 B4 AA
			15 01 00 00 00 00 02 B5 01
			15 01 00 00 00 00 02 B6 AF
			15 01 00 00 00 00 02 B7 01
			15 01 00 00 00 00 02 B8 B4
			15 01 00 00 00 00 02 B9 01
			15 01 00 00 00 00 02 BA B8
			15 01 00 00 00 00 02 BB 01
			15 01 00 00 00 00 02 BC BD
			15 01 00 00 00 00 02 BD 01
			15 01 00 00 00 00 02 BE C2
			15 01 00 00 00 00 02 BF 01
			15 01 00 00 00 00 02 C0 C6
			15 01 00 00 00 00 02 C1 01
			15 01 00 00 00 00 02 C2 D6
			15 01 00 00 00 00 02 C3 01
			15 01 00 00 00 00 02 C4 E4
			15 01 00 00 00 00 02 C5 01
			15 01 00 00 00 00 02 C6 FF
			15 01 00 00 00 00 02 C7 02
			15 01 00 00 00 00 02 C8 19
			15 01 00 00 00 00 02 C9 02
			15 01 00 00 00 00 02 CA 46
			15 01 00 00 00 00 02 CB 02
			15 01 00 00 00 00 02 CC 6E
			15 01 00 00 00 00 02 CD 02
			15 01 00 00 00 00 02 CE 6F
			15 01 00 00 00 00 02 CF 02
			15 01 00 00 00 00 02 D0 9D
			15 01 00 00 00 00 02 D1 02
			15 01 00 00 00 00 02 D2 D2
			15 01 00 00 00 00 02 D3 02
			15 01 00 00 00 00 02 D4 F8
			15 01 00 00 00 00 02 D5 03
			15 01 00 00 00 00 02 D6 27
			15 01 00 00 00 00 02 D7 03
			15 01 00 00 00 00 02 D8 48
			15 01 00 00 00 00 02 D9 03
			15 01 00 00 00 00 02 DA 74
			15 01 00 00 00 00 02 DB 03
			15 01 00 00 00 00 02 DC 82
			15 01 00 00 00 00 02 DD 03
			15 01 00 00 00 00 02 DE 91
			15 01 00 00 00 00 02 DF 03
			15 01 00 00 00 00 02 E0 A1
			15 01 00 00 00 00 02 E1 03
			15 01 00 00 00 00 02 E2 B3
			15 01 00 00 00 00 02 E3 03
			15 01 00 00 00 00 02 E4 C7
			15 01 00 00 00 00 02 E5 03
			15 01 00 00 00 00 02 E6 DC
			15 01 00 00 00 00 02 E7 03
			15 01 00 00 00 00 02 E8 F3
			15 01 00 00 00 00 02 E9 03
			15 01 00 00 00 00 02 EA FF
			//page selection cmd start
			15 01 00 00 00 00 02 FB 01
			15 01 00 00 00 00 02 FF 10
			//page selection cmd end
		];

		qcom,panel-reader-mode-step2-command = [
			//page selection cmd start
			15 01 00 00 00 00 02 FF 20
			//R(+) MCR cmd
			15 00 00 00 00 00 02 75 00
			15 00 00 00 00 00 02 76 00
			15 00 00 00 00 00 02 77 00
			15 00 00 00 00 00 02 78 1F
			15 00 00 00 00 00 02 79 00
			15 00 00 00 00 00 02 7A 56
			15 00 00 00 00 00 02 7B 00
			15 00 00 00 00 00 02 7C 7F
			15 00 00 00 00 00 02 7D 00
			15 00 00 00 00 00 02 7E 9E
			15 00 00 00 00 00 02 7F 00
			15 00 00 00 00 00 02 80 B8
			15 00 00 00 00 00 02 81 00
			15 00 00 00 00 00 02 82 CE
			15 00 00 00 00 00 02 83 00
			15 00 00 00 00 00 02 84 E2
			15 00 00 00 00 00 02 85 00
			15 00 00 00 00 00 02 86 F4
			15 00 00 00 00 00 02 87 01
			15 00 00 00 00 00 02 88 2D
			15 00 00 00 00 00 02 89 01
			15 00 00 00 00 00 02 8A 58
			15 00 00 00 00 00 02 8B 01
			15 00 00 00 00 00 02 8C 97
			15 00 00 00 00 00 02 8D 01
			15 00 00 00 00 00 02 8E C7
			15 00 00 00 00 00 02 8F 02
			15 00 00 00 00 00 02 90 0D
			15 00 00 00 00 00 02 91 02
			15 00 00 00 00 00 02 92 42
			15 00 00 00 00 00 02 93 02
			15 00 00 00 00 00 02 94 44
			15 00 00 00 00 00 02 95 02
			15 00 00 00 00 00 02 96 79
			15 00 00 00 00 00 02 97 02
			15 00 00 00 00 00 02 98 B4
			15 00 00 00 00 00 02 99 02
			15 00 00 00 00 00 02 9A DA
			15 00 00 00 00 00 02 9B 03
			15 00 00 00 00 00 02 9C 0B
			15 00 00 00 00 00 02 9D 03
			15 00 00 00 00 00 02 9E 2F
			15 00 00 00 00 00 02 9F 03
			15 00 00 00 00 00 02 A0 60
			15 00 00 00 00 00 02 A2 03
			15 00 00 00 00 00 02 A3 70
			15 00 00 00 00 00 02 A4 03
			15 00 00 00 00 00 02 A5 81
			15 00 00 00 00 00 02 A6 03
			15 00 00 00 00 00 02 A7 93
			15 00 00 00 00 00 02 A9 03
			15 00 00 00 00 00 02 AA A7
			15 00 00 00 00 00 02 AB 03
			15 00 00 00 00 00 02 AC BE
			15 00 00 00 00 00 02 AD 03
			15 00 00 00 00 00 02 AE D6
			15 00 00 00 00 00 02 AF 03
			15 00 00 00 00 00 02 B0 F1
			15 00 00 00 00 00 02 B1 03
			15 01 00 00 00 00 02 B2 FF
			//R(-) MCR cmd
			15 00 00 00 00 00 02 B3 00
			15 00 00 00 00 00 02 B4 00
			15 00 00 00 00 00 02 B5 00
			15 00 00 00 00 00 02 B6 1F
			15 00 00 00 00 00 02 B7 00
			15 00 00 00 00 00 02 B8 56
			15 00 00 00 00 00 02 B9 00
			15 00 00 00 00 00 02 BA 7F
			15 00 00 00 00 00 02 BB 00
			15 00 00 00 00 00 02 BC 9E
			15 00 00 00 00 00 02 BD 00
			15 00 00 00 00 00 02 BE B8
			15 00 00 00 00 00 02 BF 00
			15 00 00 00 00 00 02 C0 CE
			15 00 00 00 00 00 02 C1 00
			15 00 00 00 00 00 02 C2 E2
			15 00 00 00 00 00 02 C3 00
			15 00 00 00 00 00 02 C4 F4
			15 00 00 00 00 00 02 C5 01
			15 00 00 00 00 00 02 C6 2D
			15 00 00 00 00 00 02 C7 01
			15 00 00 00 00 00 02 C8 58
			15 00 00 00 00 00 02 C9 01
			15 00 00 00 00 00 02 CA 97
			15 00 00 00 00 00 02 CB 01
			15 00 00 00 00 00 02 CC C7
			15 00 00 00 00 00 02 CD 02
			15 00 00 00 00 00 02 CE 0D
			15 00 00 00 00 00 02 CF 02
			15 00 00 00 00 00 02 D0 42
			15 00 00 00 00 00 02 D1 02
			15 00 00 00 00 00 02 D2 44
			15 00 00 00 00 00 02 D3 02
			15 00 00 00 00 00 02 D4 79
			15 00 00 00 00 00 02 D5 02
			15 00 00 00 00 00 02 D6 B4
			15 00 00 00 00 00 02 D7 02
			15 00 00 00 00 00 02 D8 DA
			15 00 00 00 00 00 02 D9 03
			15 00 00 00 00 00 02 DA 0B
			15 00 00 00 00 00 02 DB 03
			15 00 00 00 00 00 02 DC 2F
			15 00 00 00 00 00 02 DD 03
			15 00 00 00 00 00 02 DE 60
			15 00 00 00 00 00 02 DF 03
			15 00 00 00 00 00 02 E0 70
			15 00 00 00 00 00 02 E1 03
			15 00 00 00 00 00 02 E2 81
			15 00 00 00 00 00 02 E3 03
			15 00 00 00 00 00 02 E4 93
			15 00 00 00 00 00 02 E5 03
			15 00 00 00 00 00 02 E6 A7
			15 00 00 00 00 00 02 E7 03
			15 00 00 00 00 00 02 E8 BE
			15 00 00 00 00 00 02 E9 03
			15 00 00 00 00 00 02 EA D6
			15 00 00 00 00 00 02 EB 03
			15 00 00 00 00 00 02 EC F1
			15 00 00 00 00 00 02 ED 03
			15 01 00 00 00 00 02 EE FF
			//G(+) MCR cmd
			15 00 00 00 00 00 02 EF 01
			15 00 00 00 00 00 02 F0 15
			15 00 00 00 00 00 02 F1 01
			15 00 00 00 00 00 02 F2 1C
			15 00 00 00 00 00 02 F3 01
			15 00 00 00 00 00 02 F4 2A
			15 00 00 00 00 00 02 F5 01
			15 00 00 00 00 00 02 F6 35
			15 00 00 00 00 00 02 F7 01
			15 00 00 00 00 00 02 F8 3E
			15 00 00 00 00 00 02 F9 01
			15 00 00 00 00 00 02 FA 48
			//page selection cmd start
			15 00 00 00 00 00 02 FB 01
			15 01 00 00 00 00 02 FF 21
			//page selection cmd end
			15 00 00 00 00 00 02 00 01
			15 00 00 00 00 00 02 01 52
			15 00 00 00 00 00 02 02 01
			15 00 00 00 00 00 02 03 5A
			15 00 00 00 00 00 02 04 01
			15 00 00 00 00 00 02 05 62
			15 00 00 00 00 00 02 06 01
			15 00 00 00 00 00 02 07 7F
			15 00 00 00 00 00 02 08 01
			15 00 00 00 00 00 02 09 9B
			15 00 00 00 00 00 02 0A 01
			15 00 00 00 00 00 02 0B C6
			15 00 00 00 00 00 02 0C 01
			15 00 00 00 00 00 02 0D E7
			15 00 00 00 00 00 02 0E 02
			15 00 00 00 00 00 02 0F 21
			15 00 00 00 00 00 02 10 02
			15 00 00 00 00 00 02 11 53
			15 00 00 00 00 00 02 12 02
			15 00 00 00 00 00 02 13 54
			15 00 00 00 00 00 02 14 02
			15 00 00 00 00 00 02 15 86
			15 00 00 00 00 00 02 16 02
			15 00 00 00 00 00 02 17 C0
			15 00 00 00 00 00 02 18 02
			15 00 00 00 00 00 02 19 E5
			15 00 00 00 00 00 02 1A 03
			15 00 00 00 00 00 02 1B 18
			15 00 00 00 00 00 02 1C 03
			15 00 00 00 00 00 02 1D 3B
			15 00 00 00 00 00 02 1E 03
			15 00 00 00 00 00 02 1F 6B
			15 00 00 00 00 00 02 20 03
			15 00 00 00 00 00 02 21 79
			15 00 00 00 00 00 02 22 03
			15 00 00 00 00 00 02 23 89
			15 00 00 00 00 00 02 24 03
			15 00 00 00 00 00 02 25 9B
			15 00 00 00 00 00 02 26 03
			15 00 00 00 00 00 02 27 AE
			15 00 00 00 00 00 02 28 03
			15 00 00 00 00 00 02 29 C3
			15 00 00 00 00 00 02 2A 03
			15 00 00 00 00 00 02 2B DA
			15 00 00 00 00 00 02 2D 03
			15 00 00 00 00 00 02 2F F2
			15 00 00 00 00 00 02 30 03
			15 01 00 00 00 00 02 31 FF
			//G(-) MCR cmd
			15 00 00 00 00 00 02 32 01
			15 00 00 00 00 00 02 33 15
			15 00 00 00 00 00 02 34 01
			15 00 00 00 00 00 02 35 1C
			15 00 00 00 00 00 02 36 01
			15 00 00 00 00 00 02 37 2A
			15 00 00 00 00 00 02 38 01
			15 00 00 00 00 00 02 39 35
			15 00 00 00 00 00 02 3A 01
			15 00 00 00 00 00 02 3B 3E
			15 00 00 00 00 00 02 3D 01
			15 00 00 00 00 00 02 3F 48
			15 00 00 00 00 00 02 40 01
			15 00 00 00 00 00 02 41 52
			15 00 00 00 00 00 02 42 01
			15 00 00 00 00 00 02 43 5A
			15 00 00 00 00 00 02 44 01
			15 00 00 00 00 00 02 45 62
			15 00 00 00 00 00 02 46 01
			15 00 00 00 00 00 02 47 7F
			15 00 00 00 00 00 02 48 01
			15 00 00 00 00 00 02 49 9B
			15 00 00 00 00 00 02 4A 01
			15 00 00 00 00 00 02 4B C6
			15 00 00 00 00 00 02 4C 01
			15 00 00 00 00 00 02 4D E7
			15 00 00 00 00 00 02 4E 02
			15 00 00 00 00 00 02 4F 21
			15 00 00 00 00 00 02 50 02
			15 00 00 00 00 00 02 51 53
			15 00 00 00 00 00 02 52 02
			15 00 00 00 00 00 02 53 54
			15 00 00 00 00 00 02 54 02
			15 00 00 00 00 00 02 55 86
			15 00 00 00 00 00 02 56 02
			15 00 00 00 00 00 02 58 C0
			15 00 00 00 00 00 02 59 02
			15 00 00 00 00 00 02 5A E5
			15 00 00 00 00 00 02 5B 03
			15 00 00 00 00 00 02 5C 18
			15 00 00 00 00 00 02 5D 03
			15 00 00 00 00 00 02 5E 3B
			15 00 00 00 00 00 02 5F 03
			15 00 00 00 00 00 02 60 6B
			15 00 00 00 00 00 02 61 03
			15 00 00 00 00 00 02 62 79
			15 00 00 00 00 00 02 63 03
			15 00 00 00 00 00 02 64 89
			15 00 00 00 00 00 02 65 03
			15 00 00 00 00 00 02 66 9B
			15 00 00 00 00 00 02 67 03
			15 00 00 00 00 00 02 68 AE
			15 00 00 00 00 00 02 69 03
			15 00 00 00 00 00 02 6A C3
			15 00 00 00 00 00 02 6B 03
			15 00 00 00 00 00 02 6C DA
			15 00 00 00 00 00 02 6D 03
			15 00 00 00 00 00 02 6E F2
			15 00 00 00 00 00 02 6F 03
			15 01 00 00 00 00 02 70 FF
			//B(+) MCR cmd
			15 00 00 00 00 00 02 71 01
			15 00 00 00 00 00 02 72 A3
			15 00 00 00 00 00 02 73 01
			15 00 00 00 00 00 02 74 A6
			15 00 00 00 00 00 02 75 01
			15 00 00 00 00 00 02 76 AA
			15 00 00 00 00 00 02 77 01
			15 00 00 00 00 00 02 78 AF
			15 00 00 00 00 00 02 79 01
			15 00 00 00 00 00 02 7A B4
			15 00 00 00 00 00 02 7B 01
			15 00 00 00 00 00 02 7C B8
			15 00 00 00 00 00 02 7D 01
			15 00 00 00 00 00 02 7E BD
			15 00 00 00 00 00 02 7F 01
			15 00 00 00 00 00 02 80 C2
			15 00 00 00 00 00 02 81 01
			15 00 00 00 00 00 02 82 C6
			15 00 00 00 00 00 02 83 01
			15 00 00 00 00 00 02 84 D6
			15 00 00 00 00 00 02 85 01
			15 00 00 00 00 00 02 86 E4
			15 00 00 00 00 00 02 87 01
			15 00 00 00 00 00 02 88 FF
			15 00 00 00 00 00 02 89 02
			15 00 00 00 00 00 02 8A 19
			15 00 00 00 00 00 02 8B 02
			15 00 00 00 00 00 02 8C 46
			15 00 00 00 00 00 02 8D 02
			15 00 00 00 00 00 02 8E 6E
			15 00 00 00 00 00 02 8F 02
			15 00 00 00 00 00 02 90 6F
			15 00 00 00 00 00 02 91 02
			15 00 00 00 00 00 02 92 9D
			15 00 00 00 00 00 02 93 02
			15 00 00 00 00 00 02 94 D2
			15 00 00 00 00 00 02 95 02
			15 00 00 00 00 00 02 96 F8
			15 00 00 00 00 00 02 97 03
			15 00 00 00 00 00 02 98 27
			15 00 00 00 00 00 02 99 03
			15 00 00 00 00 00 02 9A 48
			15 00 00 00 00 00 02 9B 03
			15 00 00 00 00 00 02 9C 74
			15 00 00 00 00 00 02 9D 03
			15 00 00 00 00 00 02 9E 82
			15 00 00 00 00 00 02 9F 03
			15 00 00 00 00 00 02 A0 91
			15 00 00 00 00 00 02 A2 03
			15 00 00 00 00 00 02 A3 A1
			15 00 00 00 00 00 02 A4 03
			15 00 00 00 00 00 02 A5 B3
			15 00 00 00 00 00 02 A6 03
			15 00 00 00 00 00 02 A7 C7
			15 00 00 00 00 00 02 A9 03
			15 00 00 00 00 00 02 AA DC
			15 00 00 00 00 00 02 AB 03
			15 00 00 00 00 00 02 AC F3
			15 00 00 00 00 00 02 AD 03
			15 01 00 00 00 00 02 AE FF
			//B(-) MCR cmd
			15 00 00 00 00 00 02 AF 01
			15 00 00 00 00 00 02 B0 A3
			15 00 00 00 00 00 02 B1 01
			15 00 00 00 00 00 02 B2 A6
			15 00 00 00 00 00 02 B3 01
			15 00 00 00 00 00 02 B4 AA
			15 00 00 00 00 00 02 B5 01
			15 00 00 00 00 00 02 B6 AF
			15 00 00 00 00 00 02 B7 01
			15 00 00 00 00 00 02 B8 B4
			15 00 00 00 00 00 02 B9 01
			15 00 00 00 00 00 02 BA B8
			15 00 00 00 00 00 02 BB 01
			15 00 00 00 00 00 02 BC BD
			15 00 00 00 00 00 02 BD 01
			15 00 00 00 00 00 02 BE C2
			15 00 00 00 00 00 02 BF 01
			15 00 00 00 00 00 02 C0 C6
			15 00 00 00 00 00 02 C1 01
			15 00 00 00 00 00 02 C2 D6
			15 00 00 00 00 00 02 C3 01
			15 00 00 00 00 00 02 C4 E4
			15 00 00 00 00 00 02 C5 01
			15 00 00 00 00 00 02 C6 FF
			15 00 00 00 00 00 02 C7 02
			15 00 00 00 00 00 02 C8 19
			15 00 00 00 00 00 02 C9 02
			15 00 00 00 00 00 02 CA 46
			15 00 00 00 00 00 02 CB 02
			15 00 00 00 00 00 02 CC 6E
			15 00 00 00 00 00 02 CD 02
			15 00 00 00 00 00 02 CE 6F
			15 00 00 00 00 00 02 CF 02
			15 00 00 00 00 00 02 D0 9D
			15 00 00 00 00 00 02 D1 02
			15 00 00 00 00 00 02 D2 D2
			15 00 00 00 00 00 02 D3 02
			15 00 00 00 00 00 02 D4 F8
			15 00 00 00 00 00 02 D5 03
			15 00 00 00 00 00 02 D6 27
			15 00 00 00 00 00 02 D7 03
			15 00 00 00 00 00 02 D8 48
			15 00 00 00 00 00 02 D9 03
			15 00 00 00 00 00 02 DA 74
			15 00 00 00 00 00 02 DB 03
			15 00 00 00 00 00 02 DC 82
			15 00 00 00 00 00 02 DD 03
			15 00 00 00 00 00 02 DE 91
			15 00 00 00 00 00 02 DF 03
			15 00 00 00 00 00 02 E0 A1
			15 00 00 00 00 00 02 E1 03
			15 00 00 00 00 00 02 E2 B3
			15 00 00 00 00 00 02 E3 03
			15 00 00 00 00 00 02 E4 C7
			15 00 00 00 00 00 02 E5 03
			15 00 00 00 00 00 02 E6 DC
			15 00 00 00 00 00 02 E7 03
			15 00 00 00 00 00 02 E8 F3
			15 00 00 00 00 00 02 E9 03
			15 00 00 00 00 00 02 EA FF
			//page selection cmd start
			15 00 00 00 00 00 02 FB 01
			15 01 00 00 00 00 02 FF 10
			//page selection cmd end
		];

		qcom,panel-reader-mode-initial-step3-command = [
			//page selection cmd start
			15 01 00 00 00 00 02 FF 20
			//R(+) MCR cmd
			15 01 00 00 00 00 02 75 00
			15 01 00 00 00 00 02 76 00
			15 01 00 00 00 00 02 77 00
			15 01 00 00 00 00 02 78 1F
			15 01 00 00 00 00 02 79 00
			15 01 00 00 00 00 02 7A 56
			15 01 00 00 00 00 02 7B 00
			15 01 00 00 00 00 02 7C 7F
			15 01 00 00 00 00 02 7D 00
			15 01 00 00 00 00 02 7E 9E
			15 01 00 00 00 00 02 7F 00
			15 01 00 00 00 00 02 80 B8
			15 01 00 00 00 00 02 81 00
			15 01 00 00 00 00 02 82 CE
			15 01 00 00 00 00 02 83 00
			15 01 00 00 00 00 02 84 E2
			15 01 00 00 00 00 02 85 00
			15 01 00 00 00 00 02 86 F4
			15 01 00 00 00 00 02 87 01
			15 01 00 00 00 00 02 88 2D
			15 01 00 00 00 00 02 89 01
			15 01 00 00 00 00 02 8A 58
			15 01 00 00 00 00 02 8B 01
			15 01 00 00 00 00 02 8C 97
			15 01 00 00 00 00 02 8D 01
			15 01 00 00 00 00 02 8E C7
			15 01 00 00 00 00 02 8F 02
			15 01 00 00 00 00 02 90 0D
			15 01 00 00 00 00 02 91 02
			15 01 00 00 00 00 02 92 42
			15 01 00 00 00 00 02 93 02
			15 01 00 00 00 00 02 94 44
			15 01 00 00 00 00 02 95 02
			15 01 00 00 00 00 02 96 79
			15 01 00 00 00 00 02 97 02
			15 01 00 00 00 00 02 98 B4
			15 01 00 00 00 00 02 99 02
			15 01 00 00 00 00 02 9A DA
			15 01 00 00 00 00 02 9B 03
			15 01 00 00 00 00 02 9C 0B
			15 01 00 00 00 00 02 9D 03
			15 01 00 00 00 00 02 9E 2F
			15 01 00 00 00 00 02 9F 03
			15 01 00 00 00 00 02 A0 60
			15 01 00 00 00 00 02 A2 03
			15 01 00 00 00 00 02 A3 70
			15 01 00 00 00 00 02 A4 03
			15 01 00 00 00 00 02 A5 81
			15 01 00 00 00 00 02 A6 03
			15 01 00 00 00 00 02 A7 93
			15 01 00 00 00 00 02 A9 03
			15 01 00 00 00 00 02 AA A7
			15 01 00 00 00 00 02 AB 03
			15 01 00 00 00 00 02 AC BE
			15 01 00 00 00 00 02 AD 03
			15 01 00 00 00 00 02 AE D6
			15 01 00 00 00 00 02 AF 03
			15 01 00 00 00 00 02 B0 F1
			15 01 00 00 00 00 02 B1 03
			15 01 00 00 00 00 02 B2 FF
			//R(-) MCR cmd
			15 01 00 00 00 00 02 B3 00
			15 01 00 00 00 00 02 B4 00
			15 01 00 00 00 00 02 B5 00
			15 01 00 00 00 00 02 B6 1F
			15 01 00 00 00 00 02 B7 00
			15 01 00 00 00 00 02 B8 56
			15 01 00 00 00 00 02 B9 00
			15 01 00 00 00 00 02 BA 7F
			15 01 00 00 00 00 02 BB 00
			15 01 00 00 00 00 02 BC 9E
			15 01 00 00 00 00 02 BD 00
			15 01 00 00 00 00 02 BE B8
			15 01 00 00 00 00 02 BF 00
			15 01 00 00 00 00 02 C0 CE
			15 01 00 00 00 00 02 C1 00
			15 01 00 00 00 00 02 C2 E2
			15 01 00 00 00 00 02 C3 00
			15 01 00 00 00 00 02 C4 F4
			15 01 00 00 00 00 02 C5 01
			15 01 00 00 00 00 02 C6 2D
			15 01 00 00 00 00 02 C7 01
			15 01 00 00 00 00 02 C8 58
			15 01 00 00 00 00 02 C9 01
			15 01 00 00 00 00 02 CA 97
			15 01 00 00 00 00 02 CB 01
			15 01 00 00 00 00 02 CC C7
			15 01 00 00 00 00 02 CD 02
			15 01 00 00 00 00 02 CE 0D
			15 01 00 00 00 00 02 CF 02
			15 01 00 00 00 00 02 D0 42
			15 01 00 00 00 00 02 D1 02
			15 01 00 00 00 00 02 D2 44
			15 01 00 00 00 00 02 D3 02
			15 01 00 00 00 00 02 D4 79
			15 01 00 00 00 00 02 D5 02
			15 01 00 00 00 00 02 D6 B4
			15 01 00 00 00 00 02 D7 02
			15 01 00 00 00 00 02 D8 DA
			15 01 00 00 00 00 02 D9 03
			15 01 00 00 00 00 02 DA 0B
			15 01 00 00 00 00 02 DB 03
			15 01 00 00 00 00 02 DC 2F
			15 01 00 00 00 00 02 DD 03
			15 01 00 00 00 00 02 DE 60
			15 01 00 00 00 00 02 DF 03
			15 01 00 00 00 00 02 E0 70
			15 01 00 00 00 00 02 E1 03
			15 01 00 00 00 00 02 E2 81
			15 01 00 00 00 00 02 E3 03
			15 01 00 00 00 00 02 E4 93
			15 01 00 00 00 00 02 E5 03
			15 01 00 00 00 00 02 E6 A7
			15 01 00 00 00 00 02 E7 03
			15 01 00 00 00 00 02 E8 BE
			15 01 00 00 00 00 02 E9 03
			15 01 00 00 00 00 02 EA D6
			15 01 00 00 00 00 02 EB 03
			15 01 00 00 00 00 02 EC F1
			15 01 00 00 00 00 02 ED 03
			15 01 00 00 00 00 02 EE FF
			//G(+) MCR cmd
			15 01 00 00 00 00 02 EF 01
			15 01 00 00 00 00 02 F0 46
			15 01 00 00 00 00 02 F1 01
			15 01 00 00 00 00 02 F2 4B
			15 01 00 00 00 00 02 F3 01
			15 01 00 00 00 00 02 F4 54
			15 01 00 00 00 00 02 F5 01
			15 01 00 00 00 00 02 F6 5C
			15 01 00 00 00 00 02 F7 01
			15 01 00 00 00 00 02 F8 64
			15 01 00 00 00 00 02 F9 01
			15 01 00 00 00 00 02 FA 6B
			//page selection cmd start
			15 01 00 00 00 00 02 FB 01
			15 01 00 00 00 00 02 FF 21
			//page selection cmd end
			15 01 00 00 00 00 02 00 01
			15 01 00 00 00 00 02 01 72
			15 01 00 00 00 00 02 02 01
			15 01 00 00 00 00 02 03 79
			15 01 00 00 00 00 02 04 01
			15 01 00 00 00 00 02 05 80
			15 01 00 00 00 00 02 06 01
			15 01 00 00 00 00 02 07 9B
			15 01 00 00 00 00 02 08 01
			15 01 00 00 00 00 02 09 AF
			15 01 00 00 00 00 02 0A 01
			15 01 00 00 00 00 02 0B D4
			15 01 00 00 00 00 02 0C 01
			15 01 00 00 00 00 02 0D F3
			15 01 00 00 00 00 02 0E 02
			15 01 00 00 00 00 02 0F 2A
			15 01 00 00 00 00 02 10 02
			15 01 00 00 00 00 02 11 59
			15 01 00 00 00 00 02 12 02
			15 01 00 00 00 00 02 13 5B
			15 01 00 00 00 00 02 14 02
			15 01 00 00 00 00 02 15 8C
			15 01 00 00 00 00 02 16 02
			15 01 00 00 00 00 02 17 C4
			15 01 00 00 00 00 02 18 02
			15 01 00 00 00 00 02 19 EA
			15 01 00 00 00 00 02 1A 03
			15 01 00 00 00 00 02 1B 1C
			15 01 00 00 00 00 02 1C 03
			15 01 00 00 00 00 02 1D 3E
			15 01 00 00 00 00 02 1E 03
			15 01 00 00 00 00 02 1F 6D
			15 01 00 00 00 00 02 20 03
			15 01 00 00 00 00 02 21 7B
			15 01 00 00 00 00 02 22 03
			15 01 00 00 00 00 02 23 8B
			15 01 00 00 00 00 02 24 03
			15 01 00 00 00 00 02 25 9D
			15 01 00 00 00 00 02 26 03
			15 01 00 00 00 00 02 27 AF
			15 01 00 00 00 00 02 28 03
			15 01 00 00 00 00 02 29 C4
			15 01 00 00 00 00 02 2A 03
			15 01 00 00 00 00 02 2B DA
			15 01 00 00 00 00 02 2D 03
			15 01 00 00 00 00 02 2F F3
			15 01 00 00 00 00 02 30 03
			15 01 00 00 00 00 02 31 FF
			//G(-) MCR cmd
			15 01 00 00 00 00 02 32 01
			15 01 00 00 00 00 02 33 46
			15 01 00 00 00 00 02 34 01
			15 01 00 00 00 00 02 35 4B
			15 01 00 00 00 00 02 36 01
			15 01 00 00 00 00 02 37 54
			15 01 00 00 00 00 02 38 01
			15 01 00 00 00 00 02 39 5C
			15 01 00 00 00 00 02 3A 01
			15 01 00 00 00 00 02 3B 64
			15 01 00 00 00 00 02 3D 01
			15 01 00 00 00 00 02 3F 6B
			15 01 00 00 00 00 02 40 01
			15 01 00 00 00 00 02 41 72
			15 01 00 00 00 00 02 42 01
			15 01 00 00 00 00 02 43 79
			15 01 00 00 00 00 02 44 01
			15 01 00 00 00 00 02 45 80
			15 01 00 00 00 00 02 46 01
			15 01 00 00 00 00 02 47 9B
			15 01 00 00 00 00 02 48 01
			15 01 00 00 00 00 02 49 AF
			15 01 00 00 00 00 02 4A 01
			15 01 00 00 00 00 02 4B D4
			15 01 00 00 00 00 02 4C 01
			15 01 00 00 00 00 02 4D F3
			15 01 00 00 00 00 02 4E 02
			15 01 00 00 00 00 02 4F 2A
			15 01 00 00 00 00 02 50 02
			15 01 00 00 00 00 02 51 59
			15 01 00 00 00 00 02 52 02
			15 01 00 00 00 00 02 53 5B
			15 01 00 00 00 00 02 54 02
			15 01 00 00 00 00 02 55 8C
			15 01 00 00 00 00 02 56 02
			15 01 00 00 00 00 02 58 C4
			15 01 00 00 00 00 02 59 02
			15 01 00 00 00 00 02 5A EA
			15 01 00 00 00 00 02 5B 03
			15 01 00 00 00 00 02 5C 1C
			15 01 00 00 00 00 02 5D 03
			15 01 00 00 00 00 02 5E 3E
			15 01 00 00 00 00 02 5F 03
			15 01 00 00 00 00 02 60 6D
			15 01 00 00 00 00 02 61 03
			15 01 00 00 00 00 02 62 7B
			15 01 00 00 00 00 02 63 03
			15 01 00 00 00 00 02 64 8B
			15 01 00 00 00 00 02 65 03
			15 01 00 00 00 00 02 66 9D
			15 01 00 00 00 00 02 67 03
			15 01 00 00 00 00 02 68 AF
			15 01 00 00 00 00 02 69 03
			15 01 00 00 00 00 02 6A C4
			15 01 00 00 00 00 02 6B 03
			15 01 00 00 00 00 02 6C DA
			15 01 00 00 00 00 02 6D 03
			15 01 00 00 00 00 02 6E F3
			15 01 00 00 00 00 02 6F 03
			15 01 00 00 00 00 02 70 FF
			//B(+) MCR cmd
			15 01 00 00 00 00 02 71 01
			15 01 00 00 00 00 02 72 CD
			15 01 00 00 00 00 02 73 01
			15 01 00 00 00 00 02 74 CF
			15 01 00 00 00 00 02 75 01
			15 01 00 00 00 00 02 76 D2
			15 01 00 00 00 00 02 77 01
			15 01 00 00 00 00 02 78 D6
			15 01 00 00 00 00 02 79 01
			15 01 00 00 00 00 02 7A D9
			15 01 00 00 00 00 02 7B 01
			15 01 00 00 00 00 02 7C DC
			15 01 00 00 00 00 02 7D 01
			15 01 00 00 00 00 02 7E DF
			15 01 00 00 00 00 02 7F 01
			15 01 00 00 00 00 02 80 E2
			15 01 00 00 00 00 02 81 01
			15 01 00 00 00 00 02 82 E6
			15 01 00 00 00 00 02 83 01
			15 01 00 00 00 00 02 84 F2
			15 01 00 00 00 00 02 85 01
			15 01 00 00 00 00 02 86 FF
			15 01 00 00 00 00 02 87 02
			15 01 00 00 00 00 02 88 17
			15 01 00 00 00 00 02 89 02
			15 01 00 00 00 00 02 8A 2C
			15 01 00 00 00 00 02 8B 02
			15 01 00 00 00 00 02 8C 54
			15 01 00 00 00 00 02 8D 02
			15 01 00 00 00 00 02 8E 79
			15 01 00 00 00 00 02 8F 02
			15 01 00 00 00 00 02 90 7A
			15 01 00 00 00 00 02 91 02
			15 01 00 00 00 00 02 92 A7
			15 01 00 00 00 00 02 93 02
			15 01 00 00 00 00 02 94 DB
			15 01 00 00 00 00 02 95 03
			15 01 00 00 00 00 02 96 00
			15 01 00 00 00 00 02 97 03
			15 01 00 00 00 00 02 98 30
			15 01 00 00 00 00 02 99 03
			15 01 00 00 00 00 02 9A 53
			15 01 00 00 00 00 02 9B 03
			15 01 00 00 00 00 02 9C 81
			15 01 00 00 00 00 02 9D 03
			15 01 00 00 00 00 02 9E 8E
			15 01 00 00 00 00 02 9F 03
			15 01 00 00 00 00 02 A0 9D
			15 01 00 00 00 00 02 A2 03
			15 01 00 00 00 00 02 A3 AC
			15 01 00 00 00 00 02 A4 03
			15 01 00 00 00 00 02 A5 BC
			15 01 00 00 00 00 02 A6 03
			15 01 00 00 00 00 02 A7 CE
			15 01 00 00 00 00 02 A9 03
			15 01 00 00 00 00 02 AA E1
			15 01 00 00 00 00 02 AB 03
			15 01 00 00 00 00 02 AC F5
			15 01 00 00 00 00 02 AD 03
			15 01 00 00 00 00 02 AE FF
			//B(-) MCR cmd
			15 01 00 00 00 00 02 AF 01
			15 01 00 00 00 00 02 B0 CD
			15 01 00 00 00 00 02 B1 01
			15 01 00 00 00 00 02 B2 CF
			15 01 00 00 00 00 02 B3 01
			15 01 00 00 00 00 02 B4 D2
			15 01 00 00 00 00 02 B5 01
			15 01 00 00 00 00 02 B6 D6
			15 01 00 00 00 00 02 B7 01
			15 01 00 00 00 00 02 B8 D9
			15 01 00 00 00 00 02 B9 01
			15 01 00 00 00 00 02 BA DC
			15 01 00 00 00 00 02 BB 01
			15 01 00 00 00 00 02 BC DF
			15 01 00 00 00 00 02 BD 01
			15 01 00 00 00 00 02 BE E2
			15 01 00 00 00 00 02 BF 01
			15 01 00 00 00 00 02 C0 E6
			15 01 00 00 00 00 02 C1 01
			15 01 00 00 00 00 02 C2 F2
			15 01 00 00 00 00 02 C3 01
			15 01 00 00 00 00 02 C4 FF
			15 01 00 00 00 00 02 C5 02
			15 01 00 00 00 00 02 C6 17
			15 01 00 00 00 00 02 C7 02
			15 01 00 00 00 00 02 C8 2C
			15 01 00 00 00 00 02 C9 02
			15 01 00 00 00 00 02 CA 54
			15 01 00 00 00 00 02 CB 02
			15 01 00 00 00 00 02 CC 79
			15 01 00 00 00 00 02 CD 02
			15 01 00 00 00 00 02 CE 7A
			15 01 00 00 00 00 02 CF 02
			15 01 00 00 00 00 02 D0 A7
			15 01 00 00 00 00 02 D1 02
			15 01 00 00 00 00 02 D2 DB
			15 01 00 00 00 00 02 D3 03
			15 01 00 00 00 00 02 D4 00
			15 01 00 00 00 00 02 D5 03
			15 01 00 00 00 00 02 D6 30
			15 01 00 00 00 00 02 D7 03
			15 01 00 00 00 00 02 D8 53
			15 01 00 00 00 00 02 D9 03
			15 01 00 00 00 00 02 DA 81
			15 01 00 00 00 00 02 DB 03
			15 01 00 00 00 00 02 DC 8E
			15 01 00 00 00 00 02 DD 03
			15 01 00 00 00 00 02 DE 9D
			15 01 00 00 00 00 02 DF 03
			15 01 00 00 00 00 02 E0 AC
			15 01 00 00 00 00 02 E1 03
			15 01 00 00 00 00 02 E2 BC
			15 01 00 00 00 00 02 E3 03
			15 01 00 00 00 00 02 E4 CE
			15 01 00 00 00 00 02 E5 03
			15 01 00 00 00 00 02 E6 E1
			15 01 00 00 00 00 02 E7 03
			15 01 00 00 00 00 02 E8 F5
			15 01 00 00 00 00 02 E9 03
			15 01 00 00 00 00 02 EA FF
			//page selection cmd start
			15 01 00 00 00 00 02 FB 01
			15 01 00 00 00 00 02 FF 10
			//page selection cmd end
		];
		qcom,panel-reader-mode-step3-command = [
			//page selection cmd start
			15 01 00 00 00 00 02 FF 20
			//R(+) MCR cmd
			15 00 00 00 00 00 02 75 00
			15 00 00 00 00 00 02 76 00
			15 00 00 00 00 00 02 77 00
			15 00 00 00 00 00 02 78 1F
			15 00 00 00 00 00 02 79 00
			15 00 00 00 00 00 02 7A 56
			15 00 00 00 00 00 02 7B 00
			15 00 00 00 00 00 02 7C 7F
			15 00 00 00 00 00 02 7D 00
			15 00 00 00 00 00 02 7E 9E
			15 00 00 00 00 00 02 7F 00
			15 00 00 00 00 00 02 80 B8
			15 00 00 00 00 00 02 81 00
			15 00 00 00 00 00 02 82 CE
			15 00 00 00 00 00 02 83 00
			15 00 00 00 00 00 02 84 E2
			15 00 00 00 00 00 02 85 00
			15 00 00 00 00 00 02 86 F4
			15 00 00 00 00 00 02 87 01
			15 00 00 00 00 00 02 88 2D
			15 00 00 00 00 00 02 89 01
			15 00 00 00 00 00 02 8A 58
			15 00 00 00 00 00 02 8B 01
			15 00 00 00 00 00 02 8C 97
			15 00 00 00 00 00 02 8D 01
			15 00 00 00 00 00 02 8E C7
			15 00 00 00 00 00 02 8F 02
			15 00 00 00 00 00 02 90 0D
			15 00 00 00 00 00 02 91 02
			15 00 00 00 00 00 02 92 42
			15 00 00 00 00 00 02 93 02
			15 00 00 00 00 00 02 94 44
			15 00 00 00 00 00 02 95 02
			15 00 00 00 00 00 02 96 79
			15 00 00 00 00 00 02 97 02
			15 00 00 00 00 00 02 98 B4
			15 00 00 00 00 00 02 99 02
			15 00 00 00 00 00 02 9A DA
			15 00 00 00 00 00 02 9B 03
			15 00 00 00 00 00 02 9C 0B
			15 00 00 00 00 00 02 9D 03
			15 00 00 00 00 00 02 9E 2F
			15 00 00 00 00 00 02 9F 03
			15 00 00 00 00 00 02 A0 60
			15 00 00 00 00 00 02 A2 03
			15 00 00 00 00 00 02 A3 70
			15 00 00 00 00 00 02 A4 03
			15 00 00 00 00 00 02 A5 81
			15 00 00 00 00 00 02 A6 03
			15 00 00 00 00 00 02 A7 93
			15 00 00 00 00 00 02 A9 03
			15 00 00 00 00 00 02 AA A7
			15 00 00 00 00 00 02 AB 03
			15 00 00 00 00 00 02 AC BE
			15 00 00 00 00 00 02 AD 03
			15 00 00 00 00 00 02 AE D6
			15 00 00 00 00 00 02 AF 03
			15 00 00 00 00 00 02 B0 F1
			15 00 00 00 00 00 02 B1 03
			15 01 00 00 00 00 02 B2 FF
			//R(-) MCR cmd
			15 00 00 00 00 00 02 B3 00
			15 00 00 00 00 00 02 B4 00
			15 00 00 00 00 00 02 B5 00
			15 00 00 00 00 00 02 B6 1F
			15 00 00 00 00 00 02 B7 00
			15 00 00 00 00 00 02 B8 56
			15 00 00 00 00 00 02 B9 00
			15 00 00 00 00 00 02 BA 7F
			15 00 00 00 00 00 02 BB 00
			15 00 00 00 00 00 02 BC 9E
			15 00 00 00 00 00 02 BD 00
			15 00 00 00 00 00 02 BE B8
			15 00 00 00 00 00 02 BF 00
			15 00 00 00 00 00 02 C0 CE
			15 00 00 00 00 00 02 C1 00
			15 00 00 00 00 00 02 C2 E2
			15 00 00 00 00 00 02 C3 00
			15 00 00 00 00 00 02 C4 F4
			15 00 00 00 00 00 02 C5 01
			15 00 00 00 00 00 02 C6 2D
			15 00 00 00 00 00 02 C7 01
			15 00 00 00 00 00 02 C8 58
			15 00 00 00 00 00 02 C9 01
			15 00 00 00 00 00 02 CA 97
			15 00 00 00 00 00 02 CB 01
			15 00 00 00 00 00 02 CC C7
			15 00 00 00 00 00 02 CD 02
			15 00 00 00 00 00 02 CE 0D
			15 00 00 00 00 00 02 CF 02
			15 00 00 00 00 00 02 D0 42
			15 00 00 00 00 00 02 D1 02
			15 00 00 00 00 00 02 D2 44
			15 00 00 00 00 00 02 D3 02
			15 00 00 00 00 00 02 D4 79
			15 00 00 00 00 00 02 D5 02
			15 00 00 00 00 00 02 D6 B4
			15 00 00 00 00 00 02 D7 02
			15 00 00 00 00 00 02 D8 DA
			15 00 00 00 00 00 02 D9 03
			15 00 00 00 00 00 02 DA 0B
			15 00 00 00 00 00 02 DB 03
			15 00 00 00 00 00 02 DC 2F
			15 00 00 00 00 00 02 DD 03
			15 00 00 00 00 00 02 DE 60
			15 00 00 00 00 00 02 DF 03
			15 00 00 00 00 00 02 E0 70
			15 00 00 00 00 00 02 E1 03
			15 00 00 00 00 00 02 E2 81
			15 00 00 00 00 00 02 E3 03
			15 00 00 00 00 00 02 E4 93
			15 00 00 00 00 00 02 E5 03
			15 00 00 00 00 00 02 E6 A7
			15 00 00 00 00 00 02 E7 03
			15 00 00 00 00 00 02 E8 BE
			15 00 00 00 00 00 02 E9 03
			15 00 00 00 00 00 02 EA D6
			15 00 00 00 00 00 02 EB 03
			15 00 00 00 00 00 02 EC F1
			15 00 00 00 00 00 02 ED 03
			15 01 00 00 00 00 02 EE FF
			//G(+) MCR cmd
			15 00 00 00 00 00 02 EF 01
			15 00 00 00 00 00 02 F0 46
			15 00 00 00 00 00 02 F1 01
			15 00 00 00 00 00 02 F2 4B
			15 00 00 00 00 00 02 F3 01
			15 00 00 00 00 00 02 F4 54
			15 00 00 00 00 00 02 F5 01
			15 00 00 00 00 00 02 F6 5C
			15 00 00 00 00 00 02 F7 01
			15 00 00 00 00 00 02 F8 64
			15 00 00 00 00 00 02 F9 01
			15 00 00 00 00 00 02 FA 6B
			//page selection cmd start
			15 00 00 00 00 00 02 FB 01
			15 01 00 00 00 00 02 FF 21
			//page selection cmd end
			15 00 00 00 00 00 02 00 01
			15 00 00 00 00 00 02 01 72
			15 00 00 00 00 00 02 02 01
			15 00 00 00 00 00 02 03 79
			15 00 00 00 00 00 02 04 01
			15 00 00 00 00 00 02 05 80
			15 00 00 00 00 00 02 06 01
			15 00 00 00 00 00 02 07 9B
			15 00 00 00 00 00 02 08 01
			15 00 00 00 00 00 02 09 AF
			15 00 00 00 00 00 02 0A 01
			15 00 00 00 00 00 02 0B D4
			15 00 00 00 00 00 02 0C 01
			15 00 00 00 00 00 02 0D F3
			15 00 00 00 00 00 02 0E 02
			15 00 00 00 00 00 02 0F 2A
			15 00 00 00 00 00 02 10 02
			15 00 00 00 00 00 02 11 59
			15 00 00 00 00 00 02 12 02
			15 00 00 00 00 00 02 13 5B
			15 00 00 00 00 00 02 14 02
			15 00 00 00 00 00 02 15 8C
			15 00 00 00 00 00 02 16 02
			15 00 00 00 00 00 02 17 C4
			15 00 00 00 00 00 02 18 02
			15 00 00 00 00 00 02 19 EA
			15 00 00 00 00 00 02 1A 03
			15 00 00 00 00 00 02 1B 1C
			15 00 00 00 00 00 02 1C 03
			15 00 00 00 00 00 02 1D 3E
			15 00 00 00 00 00 02 1E 03
			15 00 00 00 00 00 02 1F 6D
			15 00 00 00 00 00 02 20 03
			15 00 00 00 00 00 02 21 7B
			15 00 00 00 00 00 02 22 03
			15 00 00 00 00 00 02 23 8B
			15 00 00 00 00 00 02 24 03
			15 00 00 00 00 00 02 25 9D
			15 00 00 00 00 00 02 26 03
			15 00 00 00 00 00 02 27 AF
			15 00 00 00 00 00 02 28 03
			15 00 00 00 00 00 02 29 C4
			15 00 00 00 00 00 02 2A 03
			15 00 00 00 00 00 02 2B DA
			15 00 00 00 00 00 02 2D 03
			15 00 00 00 00 00 02 2F F3
			15 00 00 00 00 00 02 30 03
			15 01 00 00 00 00 02 31 FF
			//G(-) MCR cmd
			15 00 00 00 00 00 02 32 01
			15 00 00 00 00 00 02 33 46
			15 00 00 00 00 00 02 34 01
			15 00 00 00 00 00 02 35 4B
			15 00 00 00 00 00 02 36 01
			15 00 00 00 00 00 02 37 54
			15 00 00 00 00 00 02 38 01
			15 00 00 00 00 00 02 39 5C
			15 00 00 00 00 00 02 3A 01
			15 00 00 00 00 00 02 3B 64
			15 00 00 00 00 00 02 3D 01
			15 00 00 00 00 00 02 3F 6B
			15 00 00 00 00 00 02 40 01
			15 00 00 00 00 00 02 41 72
			15 00 00 00 00 00 02 42 01
			15 00 00 00 00 00 02 43 79
			15 00 00 00 00 00 02 44 01
			15 00 00 00 00 00 02 45 80
			15 00 00 00 00 00 02 46 01
			15 00 00 00 00 00 02 47 9B
			15 00 00 00 00 00 02 48 01
			15 00 00 00 00 00 02 49 AF
			15 00 00 00 00 00 02 4A 01
			15 00 00 00 00 00 02 4B D4
			15 00 00 00 00 00 02 4C 01
			15 00 00 00 00 00 02 4D F3
			15 00 00 00 00 00 02 4E 02
			15 00 00 00 00 00 02 4F 2A
			15 00 00 00 00 00 02 50 02
			15 00 00 00 00 00 02 51 59
			15 00 00 00 00 00 02 52 02
			15 00 00 00 00 00 02 53 5B
			15 00 00 00 00 00 02 54 02
			15 00 00 00 00 00 02 55 8C
			15 00 00 00 00 00 02 56 02
			15 00 00 00 00 00 02 58 C4
			15 00 00 00 00 00 02 59 02
			15 00 00 00 00 00 02 5A EA
			15 00 00 00 00 00 02 5B 03
			15 00 00 00 00 00 02 5C 1C
			15 00 00 00 00 00 02 5D 03
			15 00 00 00 00 00 02 5E 3E
			15 00 00 00 00 00 02 5F 03
			15 00 00 00 00 00 02 60 6D
			15 00 00 00 00 00 02 61 03
			15 00 00 00 00 00 02 62 7B
			15 00 00 00 00 00 02 63 03
			15 00 00 00 00 00 02 64 8B
			15 00 00 00 00 00 02 65 03
			15 00 00 00 00 00 02 66 9D
			15 00 00 00 00 00 02 67 03
			15 00 00 00 00 00 02 68 AF
			15 00 00 00 00 00 02 69 03
			15 00 00 00 00 00 02 6A C4
			15 00 00 00 00 00 02 6B 03
			15 00 00 00 00 00 02 6C DA
			15 00 00 00 00 00 02 6D 03
			15 00 00 00 00 00 02 6E F3
			15 00 00 00 00 00 02 6F 03
			15 01 00 00 00 00 02 70 FF
			//B(+) MCR cmd
			15 00 00 00 00 00 02 71 01
			15 00 00 00 00 00 02 72 CD
			15 00 00 00 00 00 02 73 01
			15 00 00 00 00 00 02 74 CF
			15 00 00 00 00 00 02 75 01
			15 00 00 00 00 00 02 76 D2
			15 00 00 00 00 00 02 77 01
			15 00 00 00 00 00 02 78 D6
			15 00 00 00 00 00 02 79 01
			15 00 00 00 00 00 02 7A D9
			15 00 00 00 00 00 02 7B 01
			15 00 00 00 00 00 02 7C DC
			15 00 00 00 00 00 02 7D 01
			15 00 00 00 00 00 02 7E DF
			15 00 00 00 00 00 02 7F 01
			15 00 00 00 00 00 02 80 E2
			15 00 00 00 00 00 02 81 01
			15 00 00 00 00 00 02 82 E6
			15 00 00 00 00 00 02 83 01
			15 00 00 00 00 00 02 84 F2
			15 00 00 00 00 00 02 85 01
			15 00 00 00 00 00 02 86 FF
			15 00 00 00 00 00 02 87 02
			15 00 00 00 00 00 02 88 17
			15 00 00 00 00 00 02 89 02
			15 00 00 00 00 00 02 8A 2C
			15 00 00 00 00 00 02 8B 02
			15 00 00 00 00 00 02 8C 54
			15 00 00 00 00 00 02 8D 02
			15 00 00 00 00 00 02 8E 79
			15 00 00 00 00 00 02 8F 02
			15 00 00 00 00 00 02 90 7A
			15 00 00 00 00 00 02 91 02
			15 00 00 00 00 00 02 92 A7
			15 00 00 00 00 00 02 93 02
			15 00 00 00 00 00 02 94 DB
			15 00 00 00 00 00 02 95 03
			15 00 00 00 00 00 02 96 00
			15 00 00 00 00 00 02 97 03
			15 00 00 00 00 00 02 98 30
			15 00 00 00 00 00 02 99 03
			15 00 00 00 00 00 02 9A 53
			15 00 00 00 00 00 02 9B 03
			15 00 00 00 00 00 02 9C 81
			15 00 00 00 00 00 02 9D 03
			15 00 00 00 00 00 02 9E 8E
			15 00 00 00 00 00 02 9F 03
			15 00 00 00 00 00 02 A0 9D
			15 00 00 00 00 00 02 A2 03
			15 00 00 00 00 00 02 A3 AC
			15 00 00 00 00 00 02 A4 03
			15 00 00 00 00 00 02 A5 BC
			15 00 00 00 00 00 02 A6 03
			15 00 00 00 00 00 02 A7 CE
			15 00 00 00 00 00 02 A9 03
			15 00 00 00 00 00 02 AA E1
			15 00 00 00 00 00 02 AB 03
			15 00 00 00 00 00 02 AC F5
			15 00 00 00 00 00 02 AD 03
			15 01 00 00 00 00 02 AE FF
			//B(-) MCR cmd
			15 00 00 00 00 00 02 AF 01
			15 00 00 00 00 00 02 B0 CD
			15 00 00 00 00 00 02 B1 01
			15 00 00 00 00 00 02 B2 CF
			15 00 00 00 00 00 02 B3 01
			15 00 00 00 00 00 02 B4 D2
			15 00 00 00 00 00 02 B5 01
			15 00 00 00 00 00 02 B6 D6
			15 00 00 00 00 00 02 B7 01
			15 00 00 00 00 00 02 B8 D9
			15 00 00 00 00 00 02 B9 01
			15 00 00 00 00 00 02 BA DC
			15 00 00 00 00 00 02 BB 01
			15 00 00 00 00 00 02 BC DF
			15 00 00 00 00 00 02 BD 01
			15 00 00 00 00 00 02 BE E2
			15 00 00 00 00 00 02 BF 01
			15 00 00 00 00 00 02 C0 E6
			15 00 00 00 00 00 02 C1 01
			15 00 00 00 00 00 02 C2 F2
			15 00 00 00 00 00 02 C3 01
			15 00 00 00 00 00 02 C4 FF
			15 00 00 00 00 00 02 C5 02
			15 00 00 00 00 00 02 C6 17
			15 00 00 00 00 00 02 C7 02
			15 00 00 00 00 00 02 C8 2C
			15 00 00 00 00 00 02 C9 02
			15 00 00 00 00 00 02 CA 54
			15 00 00 00 00 00 02 CB 02
			15 00 00 00 00 00 02 CC 79
			15 00 00 00 00 00 02 CD 02
			15 00 00 00 00 00 02 CE 7A
			15 00 00 00 00 00 02 CF 02
			15 00 00 00 00 00 02 D0 A7
			15 00 00 00 00 00 02 D1 02
			15 00 00 00 00 00 02 D2 DB
			15 00 00 00 00 00 02 D3 03
			15 00 00 00 00 00 02 D4 00
			15 00 00 00 00 00 02 D5 03
			15 00 00 00 00 00 02 D6 30
			15 00 00 00 00 00 02 D7 03
			15 00 00 00 00 00 02 D8 53
			15 00 00 00 00 00 02 D9 03
			15 00 00 00 00 00 02 DA 81
			15 00 00 00 00 00 02 DB 03
			15 00 00 00 00 00 02 DC 8E
			15 00 00 00 00 00 02 DD 03
			15 00 00 00 00 00 02 DE 9D
			15 00 00 00 00 00 02 DF 03
			15 00 00 00 00 00 02 E0 AC
			15 00 00 00 00 00 02 E1 03
			15 00 00 00 00 00 02 E2 BC
			15 00 00 00 00 00 02 E3 03
			15 00 00 00 00 00 02 E4 CE
			15 00 00 00 00 00 02 E5 03
			15 00 00 00 00 00 02 E6 E1
			15 00 00 00 00 00 02 E7 03
			15 00 00 00 00 00 02 E8 F5
			15 00 00 00 00 00 02 E9 03
			15 00 00 00 00 00 02 EA FF
			//page selection cmd start
			15 00 00 00 00 00 02 FB 01
			15 01 00 00 00 00 02 FF 10
			//page selection cmd end
		];

		qcom,panel-reader-mode-off-command  = [
			//page selection cmd start
			15 01 00 00 00 00 02 FF 20
			//R(+) MCR cmd
			15 00 00 00 00 00 02 75 00
			15 00 00 00 00 00 02 76 00
			15 00 00 00 00 00 02 77 00
			15 00 00 00 00 00 02 78 1F
			15 00 00 00 00 00 02 79 00
			15 00 00 00 00 00 02 7A 56
			15 00 00 00 00 00 02 7B 00
			15 00 00 00 00 00 02 7C 7F
			15 00 00 00 00 00 02 7D 00
			15 00 00 00 00 00 02 7E 9E
			15 00 00 00 00 00 02 7F 00
			15 00 00 00 00 00 02 80 B8
			15 00 00 00 00 00 02 81 00
			15 00 00 00 00 00 02 82 CE
			15 00 00 00 00 00 02 83 00
			15 00 00 00 00 00 02 84 E2
			15 00 00 00 00 00 02 85 00
			15 00 00 00 00 00 02 86 F4
			15 00 00 00 00 00 02 87 01
			15 00 00 00 00 00 02 88 2D
			15 00 00 00 00 00 02 89 01
			15 00 00 00 00 00 02 8A 58
			15 00 00 00 00 00 02 8B 01
			15 00 00 00 00 00 02 8C 97
			15 00 00 00 00 00 02 8D 01
			15 00 00 00 00 00 02 8E C7
			15 00 00 00 00 00 02 8F 02
			15 00 00 00 00 00 02 90 0D
			15 00 00 00 00 00 02 91 02
			15 00 00 00 00 00 02 92 42
			15 00 00 00 00 00 02 93 02
			15 00 00 00 00 00 02 94 44
			15 00 00 00 00 00 02 95 02
			15 00 00 00 00 00 02 96 79
			15 00 00 00 00 00 02 97 02
			15 00 00 00 00 00 02 98 B4
			15 00 00 00 00 00 02 99 02
			15 00 00 00 00 00 02 9A DA
			15 00 00 00 00 00 02 9B 03
			15 00 00 00 00 00 02 9C 0B
			15 00 00 00 00 00 02 9D 03
			15 00 00 00 00 00 02 9E 2F
			15 00 00 00 00 00 02 9F 03
			15 00 00 00 00 00 02 A0 60
			15 00 00 00 00 00 02 A2 03
			15 00 00 00 00 00 02 A3 70
			15 00 00 00 00 00 02 A4 03
			15 00 00 00 00 00 02 A5 81
			15 00 00 00 00 00 02 A6 03
			15 00 00 00 00 00 02 A7 93
			15 00 00 00 00 00 02 A9 03
			15 00 00 00 00 00 02 AA A7
			15 00 00 00 00 00 02 AB 03
			15 00 00 00 00 00 02 AC BE
			15 00 00 00 00 00 02 AD 03
			15 00 00 00 00 00 02 AE D6
			15 00 00 00 00 00 02 AF 03
			15 00 00 00 00 00 02 B0 F1
			15 00 00 00 00 00 02 B1 03
			15 01 00 00 00 00 02 B2 FF
			//R(-) MCR cmd
			15 00 00 00 00 00 02 B3 00
			15 00 00 00 00 00 02 B4 00
			15 00 00 00 00 00 02 B5 00
			15 00 00 00 00 00 02 B6 1F
			15 00 00 00 00 00 02 B7 00
			15 00 00 00 00 00 02 B8 56
			15 00 00 00 00 00 02 B9 00
			15 00 00 00 00 00 02 BA 7F
			15 00 00 00 00 00 02 BB 00
			15 00 00 00 00 00 02 BC 9E
			15 00 00 00 00 00 02 BD 00
			15 00 00 00 00 00 02 BE B8
			15 00 00 00 00 00 02 BF 00
			15 00 00 00 00 00 02 C0 CE
			15 00 00 00 00 00 02 C1 00
			15 00 00 00 00 00 02 C2 E2
			15 00 00 00 00 00 02 C3 00
			15 00 00 00 00 00 02 C4 F4
			15 00 00 00 00 00 02 C5 01
			15 00 00 00 00 00 02 C6 2D
			15 00 00 00 00 00 02 C7 01
			15 00 00 00 00 00 02 C8 58
			15 00 00 00 00 00 02 C9 01
			15 00 00 00 00 00 02 CA 97
			15 00 00 00 00 00 02 CB 01
			15 00 00 00 00 00 02 CC C7
			15 00 00 00 00 00 02 CD 02
			15 00 00 00 00 00 02 CE 0D
			15 00 00 00 00 00 02 CF 02
			15 00 00 00 00 00 02 D0 42
			15 00 00 00 00 00 02 D1 02
			15 00 00 00 00 00 02 D2 44
			15 00 00 00 00 00 02 D3 02
			15 00 00 00 00 00 02 D4 79
			15 00 00 00 00 00 02 D5 02
			15 00 00 00 00 00 02 D6 B4
			15 00 00 00 00 00 02 D7 02
			15 00 00 00 00 00 02 D8 DA
			15 00 00 00 00 00 02 D9 03
			15 00 00 00 00 00 02 DA 0B
			15 00 00 00 00 00 02 DB 03
			15 00 00 00 00 00 02 DC 2F
			15 00 00 00 00 00 02 DD 03
			15 00 00 00 00 00 02 DE 60
			15 00 00 00 00 00 02 DF 03
			15 00 00 00 00 00 02 E0 70
			15 00 00 00 00 00 02 E1 03
			15 00 00 00 00 00 02 E2 81
			15 00 00 00 00 00 02 E3 03
			15 00 00 00 00 00 02 E4 93
			15 00 00 00 00 00 02 E5 03
			15 00 00 00 00 00 02 E6 A7
			15 00 00 00 00 00 02 E7 03
			15 00 00 00 00 00 02 E8 BE
			15 00 00 00 00 00 02 E9 03
			15 00 00 00 00 00 02 EA D6
			15 00 00 00 00 00 02 EB 03
			15 00 00 00 00 00 02 EC F1
			15 00 00 00 00 00 02 ED 03
			15 01 00 00 00 00 02 EE FF
			//G(+) MCR cmd
			15 00 00 00 00 00 02 EF 00
			15 00 00 00 00 00 02 F0 00
			15 00 00 00 00 00 02 F1 00
			15 00 00 00 00 00 02 F2 20
			15 00 00 00 00 00 02 F3 00
			15 00 00 00 00 00 02 F4 59
			15 00 00 00 00 00 02 F5 00
			15 00 00 00 00 00 02 F6 82
			15 00 00 00 00 00 02 F7 00
			15 00 00 00 00 00 02 F8 A0
			15 00 00 00 00 00 02 F9 00
			15 00 00 00 00 00 02 FA BA
			//page selection cmd start
			15 00 00 00 00 00 02 FB 01
			15 01 00 00 00 00 02 FF 21
			//page selection cmd end
			15 00 00 00 00 00 02 00 00
			15 00 00 00 00 00 02 01 D0
			15 00 00 00 00 00 02 02 00
			15 00 00 00 00 00 02 03 E4
			15 00 00 00 00 00 02 04 00
			15 00 00 00 00 00 02 05 F5
			15 00 00 00 00 00 02 06 01
			15 00 00 00 00 00 02 07 2F
			15 00 00 00 00 00 02 08 01
			15 00 00 00 00 00 02 09 59
			15 00 00 00 00 00 02 0A 01
			15 00 00 00 00 00 02 0B 98
			15 00 00 00 00 00 02 0C 01
			15 00 00 00 00 00 02 0D C6
			15 00 00 00 00 00 02 0E 02
			15 00 00 00 00 00 02 0F 0D
			15 00 00 00 00 00 02 10 02
			15 00 00 00 00 00 02 11 43
			15 00 00 00 00 00 02 12 02
			15 00 00 00 00 00 02 13 44
			15 00 00 00 00 00 02 14 02
			15 00 00 00 00 00 02 15 79
			15 00 00 00 00 00 02 16 02
			15 00 00 00 00 00 02 17 B4
			15 00 00 00 00 00 02 18 02
			15 00 00 00 00 00 02 19 DA
			15 00 00 00 00 00 02 1A 03
			15 00 00 00 00 00 02 1B 0C
			15 00 00 00 00 00 02 1C 03
			15 00 00 00 00 00 02 1D 30
			15 00 00 00 00 00 02 1E 03
			15 00 00 00 00 00 02 1F 61
			15 00 00 00 00 00 02 20 03
			15 00 00 00 00 00 02 21 71
			15 00 00 00 00 00 02 22 03
			15 00 00 00 00 00 02 23 82
			15 00 00 00 00 00 02 24 03
			15 00 00 00 00 00 02 25 94
			15 00 00 00 00 00 02 26 03
			15 00 00 00 00 00 02 27 A8
			15 00 00 00 00 00 02 28 03
			15 00 00 00 00 00 02 29 BE
			15 00 00 00 00 00 02 2A 03
			15 00 00 00 00 00 02 2B D7
			15 00 00 00 00 00 02 2D 03
			15 00 00 00 00 00 02 2F F1
			15 00 00 00 00 00 02 30 03
			15 01 00 00 00 00 02 31 FF
			//G(-) MCR cmd
			15 00 00 00 00 00 02 32 00
			15 00 00 00 00 00 02 33 00
			15 00 00 00 00 00 02 34 00
			15 00 00 00 00 00 02 35 20
			15 00 00 00 00 00 02 36 00
			15 00 00 00 00 00 02 37 59
			15 00 00 00 00 00 02 38 00
			15 00 00 00 00 00 02 39 82
			15 00 00 00 00 00 02 3A 00
			15 00 00 00 00 00 02 3B A0
			15 00 00 00 00 00 02 3D 00
			15 00 00 00 00 00 02 3F BA
			15 00 00 00 00 00 02 40 00
			15 00 00 00 00 00 02 41 D0
			15 00 00 00 00 00 02 42 00
			15 00 00 00 00 00 02 43 E4
			15 00 00 00 00 00 02 44 00
			15 00 00 00 00 00 02 45 F5
			15 00 00 00 00 00 02 46 01
			15 00 00 00 00 00 02 47 2F
			15 00 00 00 00 00 02 48 01
			15 00 00 00 00 00 02 49 59
			15 00 00 00 00 00 02 4A 01
			15 00 00 00 00 00 02 4B 98
			15 00 00 00 00 00 02 4C 01
			15 00 00 00 00 00 02 4D C6
			15 00 00 00 00 00 02 4E 02
			15 00 00 00 00 00 02 4F 0D
			15 00 00 00 00 00 02 50 02
			15 00 00 00 00 00 02 51 43
			15 00 00 00 00 00 02 52 02
			15 00 00 00 00 00 02 53 44
			15 00 00 00 00 00 02 54 02
			15 00 00 00 00 00 02 55 79
			15 00 00 00 00 00 02 56 02
			15 00 00 00 00 00 02 58 B4
			15 00 00 00 00 00 02 59 02
			15 00 00 00 00 00 02 5A DA
			15 00 00 00 00 00 02 5B 03
			15 00 00 00 00 00 02 5C 0C
			15 00 00 00 00 00 02 5D 03
			15 00 00 00 00 00 02 5E 30
			15 00 00 00 00 00 02 5F 03
			15 00 00 00 00 00 02 60 61
			15 00 00 00 00 00 02 61 03
			15 00 00 00 00 00 02 62 71
			15 00 00 00 00 00 02 63 03
			15 00 00 00 00 00 02 64 82
			15 00 00 00 00 00 02 65 03
			15 00 00 00 00 00 02 66 94
			15 00 00 00 00 00 02 67 03
			15 00 00 00 00 00 02 68 A8
			15 00 00 00 00 00 02 69 03
			15 00 00 00 00 00 02 6A BE
			15 00 00 00 00 00 02 6B 03
			15 00 00 00 00 00 02 6C D7
			15 00 00 00 00 00 02 6D 03
			15 00 00 00 00 00 02 6E F1
			15 00 00 00 00 00 02 6F 03
			15 01 00 00 00 00 02 70 FF
			//B(+) MCR cmd
			15 00 00 00 00 00 02 71 00
			15 00 00 00 00 00 02 72 00
			15 00 00 00 00 00 02 73 00
			15 00 00 00 00 00 02 74 23
			15 00 00 00 00 00 02 75 00
			15 00 00 00 00 00 02 76 61
			15 00 00 00 00 00 02 77 00
			15 00 00 00 00 00 02 78 8C
			15 00 00 00 00 00 02 79 00
			15 00 00 00 00 00 02 7A AA
			15 00 00 00 00 00 02 7B 00
			15 00 00 00 00 00 02 7C C3
			15 00 00 00 00 00 02 7D 00
			15 00 00 00 00 00 02 7E DA
			15 00 00 00 00 00 02 7F 00
			15 00 00 00 00 00 02 80 EE
			15 00 00 00 00 00 02 81 00
			15 00 00 00 00 00 02 82 FF
			15 00 00 00 00 00 02 83 01
			15 00 00 00 00 00 02 84 37
			15 00 00 00 00 00 02 85 01
			15 00 00 00 00 00 02 86 61
			15 00 00 00 00 00 02 87 01
			15 00 00 00 00 00 02 88 A0
			15 00 00 00 00 00 02 89 01
			15 00 00 00 00 00 02 8A CE
			15 00 00 00 00 00 02 8B 02
			15 00 00 00 00 00 02 8C 12
			15 00 00 00 00 00 02 8D 02
			15 00 00 00 00 00 02 8E 49
			15 00 00 00 00 00 02 8F 02
			15 00 00 00 00 00 02 90 4A
			15 00 00 00 00 00 02 91 02
			15 00 00 00 00 00 02 92 7C
			15 00 00 00 00 00 02 93 02
			15 00 00 00 00 00 02 94 B7
			15 00 00 00 00 00 02 95 02
			15 00 00 00 00 00 02 96 DC
			15 00 00 00 00 00 02 97 03
			15 00 00 00 00 00 02 98 0E
			15 00 00 00 00 00 02 99 03
			15 00 00 00 00 00 02 9A 31
			15 00 00 00 00 00 02 9B 03
			15 00 00 00 00 00 02 9C 63
			15 00 00 00 00 00 02 9D 03
			15 00 00 00 00 00 02 9E 72
			15 00 00 00 00 00 02 9F 03
			15 00 00 00 00 00 02 A0 83
			15 00 00 00 00 00 02 A2 03
			15 00 00 00 00 00 02 A3 95
			15 00 00 00 00 00 02 A4 03
			15 00 00 00 00 00 02 A5 A9
			15 00 00 00 00 00 02 A6 03
			15 00 00 00 00 00 02 A7 BF
			15 00 00 00 00 00 02 A9 03
			15 00 00 00 00 00 02 AA D7
			15 00 00 00 00 00 02 AB 03
			15 00 00 00 00 00 02 AC F2
			15 00 00 00 00 00 02 AD 03
			15 00 00 00 00 00 02 AE FF
			//B(-) MCR cmd
			15 00 00 00 00 00 02 AF 00
			15 00 00 00 00 00 02 B0 00
			15 00 00 00 00 00 02 B1 00
			15 00 00 00 00 00 02 B2 23
			15 00 00 00 00 00 02 B3 00
			15 00 00 00 00 00 02 B4 61
			15 00 00 00 00 00 02 B5 00
			15 00 00 00 00 00 02 B6 8C
			15 00 00 00 00 00 02 B7 00
			15 00 00 00 00 00 02 B8 AA
			15 00 00 00 00 00 02 B9 00
			15 00 00 00 00 00 02 BA C3
			15 00 00 00 00 00 02 BB 00
			15 00 00 00 00 00 02 BC DA
			15 00 00 00 00 00 02 BD 00
			15 00 00 00 00 00 02 BE EE
			15 00 00 00 00 00 02 BF 00
			15 00 00 00 00 00 02 C0 FF
			15 00 00 00 00 00 02 C1 01
			15 00 00 00 00 00 02 C2 37
			15 00 00 00 00 00 02 C3 01
			15 00 00 00 00 00 02 C4 61
			15 00 00 00 00 00 02 C5 01
			15 00 00 00 00 00 02 C6 A0
			15 00 00 00 00 00 02 C7 01
			15 00 00 00 00 00 02 C8 CE
			15 00 00 00 00 00 02 C9 02
			15 00 00 00 00 00 02 CA 12
			15 00 00 00 00 00 02 CB 02
			15 00 00 00 00 00 02 CC 49
			15 00 00 00 00 00 02 CD 02
			15 00 00 00 00 00 02 CE 4A
			15 00 00 00 00 00 02 CF 02
			15 00 00 00 00 00 02 D0 7C
			15 00 00 00 00 00 02 D1 02
			15 00 00 00 00 00 02 D2 B7
			15 00 00 00 00 00 02 D3 02
			15 00 00 00 00 00 02 D4 DC
			15 00 00 00 00 00 02 D5 03
			15 00 00 00 00 00 02 D6 0E
			15 00 00 00 00 00 02 D7 03
			15 00 00 00 00 00 02 D8 31
			15 00 00 00 00 00 02 D9 03
			15 00 00 00 00 00 02 DA 63
			15 00 00 00 00 00 02 DB 03
			15 00 00 00 00 00 02 DC 72
			15 00 00 00 00 00 02 DD 03
			15 00 00 00 00 00 02 DE 83
			15 00 00 00 00 00 02 DF 03
			15 00 00 00 00 00 02 E0 95
			15 00 00 00 00 00 02 E1 03
			15 00 00 00 00 00 02 E2 A9
			15 00 00 00 00 00 02 E3 03
			15 00 00 00 00 00 02 E4 BF
			15 00 00 00 00 00 02 E5 03
			15 00 00 00 00 00 02 E6 D7
			15 00 00 00 00 00 02 E7 03
			15 00 00 00 00 00 02 E8 F2
			15 00 00 00 00 00 02 E9 03
			15 00 00 00 00 00 02 EA FF
			//page selection cmd start
			15 00 00 00 00 00 02 FB 01
			15 01 00 00 00 00 02 FF 10
			//page selection cmd end
		];

		qcom,panel-reader-mode-mono-enable-command = [
			15 01 00 00 00 00 02 FF 10
			15 01 00 00 00 00 02 55 80
		];

		qcom,panel-reader-mode-mono-disable-command = [
			15 01 00 00 00 00 02 FF 10
			15 01 00 00 00 00 02 55 00
		];

		qcom,mdss-dsi-on-command-state = "dsi_lp_mode";
		qcom,mdss-dsi-off-command-state = "dsi_hs_mode";
		qcom,esd-check-enabled;
		qcom,mdss-dsi-panel-status-command = [06 01 00 01 05 00 02 0A 08];
		qcom,mdss-dsi-panel-status-command-state = "dsi_hs_mode";
		qcom,mdss-dsi-panel-status-check-mode = "reg_read";
		qcom,mdss-dsi-panel-status-read-length = <1>;
		qcom,mdss-dsi-panel-status-value = <0x9c>;
		qcom,mdss-dsi-reader-mode-command-state = "dsi_hs_mode";
		qcom,mdss-dsi-h-sync-pulse = <0>;
		qcom,mdss-dsi-lane-map = "lane_map_0123";
		qcom,mdss-dsi-bllp-eof-power-mode;
		qcom,mdss-dsi-bllp-power-mode;
		qcom,mdss-dsi-lane-0-state;
		qcom,mdss-dsi-lane-1-state;
		qcom,mdss-dsi-lane-2-state;
		qcom,mdss-dsi-lane-3-state;
		qcom,mdss-dsi-panel-timings = [E4 39 22 00 64 66 28 3D 32 03 04 00]; /* TLPX is 62.5ns */

		qcom,mdss-dsi-reset-sequence = <1 10>, <1 12>, <1 10>; /* reset is always HIGH */
		qcom,mdss-dsi-t-clk-post = <0x3>;
		qcom,mdss-dsi-t-clk-pre = <0x2B>;
		qcom,mdss-dsi-dma-trigger = "trigger_sw";

		/* KYH 20150904 modified from none to trigger_sw */
		qcom,mdss-dsi-mdp-trigger = "trigger_sw";

		qcom,mdss-dsi-pan-enable-dynamic-fps;
		qcom,mdss-dsi-pan-fps-update = "dfps_immediate_porch_mode_vfp";
		qcom,mdss-dsi-min-refresh-rate = <50>;
		qcom,mdss-dsi-max-refresh-rate = <60>;

		qcom,cont-splash-enabled;
		//qcom,mdss-dsi-force-clock-lane-hs;

		qcom,mdss-dsi-traffic-mode = "non_burst_sync_event";

		qcom,mdss-dsi-post-init-delay = <1>;

		lge,blmap-size = <256>;
		lge,blmap = <
			0 25 25 25 25 25 25 25 25 25				/* 0 ~ 9 */
			25 26 28 29 31 32 34 35 37 38				/* 10 ~ 19 */
			40 41 43 44 46 47 49 50 52 53				/* 20 ~ 29 */
			55 56 58 59 61 63 64 66 67 69				/* 30 ~ 39 */
			70 72 73 75 76 78 79 81 82 84				/* 40 ~ 49 */
			85 87 88 90 91 93 94 96 97 99				/* 50 ~ 59 */
			101 106 112 118 124 129 135 141 147 152			/* 60 ~ 69 */
			158 164 170 175 181 187 193 198 204 210			/* 70 ~ 79 */
			216 221 227 233 239 244 250 256 262 267			/* 80 ~ 89 */
			273 279 285 290 296 302 308 313 319 325			/* 90 ~ 99 */
			331 336 342 348 354 359 365 371 377 387			/* 100 ~ 109 */
			397 408 418 428 439 449 459 470 480 491			/* 110 ~ 119 */
			501 511 522 532 542 553 563 573 584 594			/* 120 ~ 129 */
			605 615 625 636 646 656 667 677 688 698			/* 130 ~ 139 */
			708 719 729 739 750 760 770 781 791 802			/* 140 ~ 149 */
			812 822 833 843 853 864 874 885 900 916			/* 150 ~ 159 */
			932 948 964 979 995 1011 1027 1043 1058 1074		/* 160 ~ 169 */
			1090 1106 1122 1138 1153 1169 1185 1201 1217 1232	/* 170 ~ 179 */
			1248 1264 1280 1296 1312 1327 1343 1359 1375 1391	/* 180 ~ 189 */
			1406 1422 1438 1454 1470 1486 1501 1517 1533 1549	/* 190 ~ 199 */
			1565 1580 1596 1612 1628 1644 1660 1683 1706 1729	/* 200 ~ 209 */
			1752 1775 1798 1821 1844 1867 1890 1913 1936 1959	/* 210 ~ 219 */
			1982 2005 2028 2052 2075 2098 2121 2144 2167 2190	/* 220 ~ 229 */
			2213 2236 2259 2282 2305 2328 2351 2374 2397 2421	/* 230 ~ 239 */
			2444 2467 2490 2513 2536 2559 2582 2605 2628 2651	/* 240 ~ 249 */
			2674 2697 2720 2743 2766 2790				/* 250 ~ 255 */
		>;

		lge,blmap-hl = <
			0 2790 2790 2790 2790 2790 2790 2790 2790 2790		/* 0 ~ 9 */
			2790 2793 2797 2801 2805 2809 2812 2816 2820 2824	/* 10 ~ 19 */
			2828 2832 2835 2839 2843 2847 2851 2854 2858 2862	/* 20 ~ 29 */
			2866 2870 2874 2877 2881 2885 2889 2893 2896 2900	/* 30 ~ 39 */
			2904 2908 2912 2916 2919 2923 2927 2931 2935 2938	/* 40 ~ 49 */
			2942 2946 2950 2954 2958 2961 2965 2969 2973 2977	/* 50 ~ 59 */
			2981 2984 2988 2992 2996 3000 3003 3007 3011 3015	/* 60 ~ 69 */
			3019 3023 3026 3030 3034 3038 3042 3045 3049 3053	/* 70 ~ 79 */
			3057 3061 3065 3068 3072 3076 3080 3084 3087 3091	/* 80 ~ 89 */
			3095 3099 3103 3107 3110 3114 3118 3122 3126 3130	/* 90 ~ 99 */
			3133 3137 3141 3145 3149 3152 3156 3160 3164 3168	/* 100 ~ 109 */
			3172 3175 3179 3183 3187 3191 3194 3198 3202 3206	/* 110 ~ 119 */
			3210 3214 3217 3221 3225 3229 3233 3236 3240 3244	/* 120 ~ 129 */
			3248 3252 3256 3259 3263 3267 3271 3275 3279 3282	/* 130 ~ 139 */
			3286 3290 3294 3298 3301 3305 3309 3313 3317 3321	/* 140 ~ 149 */
			3324 3328 3332 3336 3340 3343 3347 3351 3355 3359	/* 150 ~ 159 */
			3363 3366 3370 3374 3378 3382 3385 3389 3393 3397	/* 160 ~ 169 */
			3401 3405 3408 3412 3416 3420 3424 3428 3431 3435	/* 170 ~ 179 */
			3439 3443 3447 3450 3454 3458 3462 3466 3470 3473	/* 180 ~ 189 */
			3477 3481 3485 3489 3492 3496 3500 3504 3508 3512	/* 190 ~ 199 */
			3515 3519 3523 3527 3531 3534 3538 3542 3546 3550	/* 200 ~ 209 */
			3554 3557 3561 3565 3569 3573 3577 3580 3584 3588	/* 210 ~ 219 */
			3592 3596 3599 3603 3607 3611 3615 3619 3622 3626	/* 220 ~ 229 */
			3630 3634 3638 3641 3645 3649 3653 3657 3661 3664	/* 230 ~ 239 */
			3668 3672 3676 3680 3683 3687 3691 3695 3699 3703	/* 240 ~ 249 */
			3706 3710 3714 3718 3722 3726				/* 250 ~ 255 */
		>;
	};
};
