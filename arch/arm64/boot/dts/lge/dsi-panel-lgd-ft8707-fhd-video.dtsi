/* Copyright (c) 2014, Code Aurora Forum. All rights reserved.
 *
 * This program is free software; you can redistribute it and/or modify
 * it under the terms of the GNU General Public License version 2 and
 * only version 2 as published by the Free Software Foundation.
 *
 * This program is distributed in the hope that it will be useful,
 * but WITHOUT ANY WARRANTY; without even the implied warranty of
 * MERCHANTABILITY or FITNESS FOR A PARTICULAR PURPOSE.  See the
 * GNU General Public License for more details.
 */

&mdss_mdp {
	dsi_lgd_ft8707_vid: qcom,mdss_dsi_lgd_ft8707_fhd_video {
		compatible = "qcom,mdss-dsi-panel";
		qcom,mdss-dsi-panel-name = "LGD FHD video mode dsi panel";
		qcom,mdss-dsi-panel-controller = <&mdss_dsi0>;
		qcom,mdss-dsi-panel-type = "dsi_video_mode";
		qcom,mdss-dsi-panel-destination = "display_1";
		qcom,mdss-dsi-panel-framerate = <60>;
		qcom,mdss-dsi-virtual-channel-id = <0>;
		qcom,mdss-dsi-stream = <0>;

		qcom,mdss-dsi-panel-width = <1080>;
		qcom,mdss-dsi-panel-height = <1920>;
		qcom,mdss-dsi-h-front-porch = <32>;
		qcom,mdss-dsi-h-back-porch = <32>;
		qcom,mdss-dsi-h-pulse-width = <4>;
		qcom,mdss-dsi-h-sync-skew = <0>;
		qcom,mdss-dsi-v-back-porch = <12>;
		qcom,mdss-dsi-v-front-porch = <307>;
		qcom,mdss-dsi-v-pulse-width = <4>;


		qcom,mdss-pan-physical-width-dimension = <65>;
		qcom,mdss-pan-physical-height-dimension = <115>;

		qcom,mdss-dsi-h-left-border = <0>;
		qcom,mdss-dsi-h-right-border = <0>;
		qcom,mdss-dsi-v-top-border = <0>;
		qcom,mdss-dsi-v-bottom-border = <0>;
		qcom,mdss-dsi-bpp = <24>;
		qcom,mdss-dsi-color-order = "rgb_swap_rgb";
		qcom,mdss-dsi-underflow-color = <0xff>;
		qcom,mdss-dsi-border-color = <0xff>;

		qcom,mdss-dsi-on-command = [
			15 01 00 00 00 00 02		/* CMD2 Enable */
			00 00
			29 01 00 00 00 00 04
			FF 87 07 01
			15 01 00 00 00 00 02		/* FocalTech CMD Enable */
			00 80
			29 01 00 00 00 00 03
			FF 87 07
			15 01 00 00 00 00 02		/* X / Y mirror */
			00 B4
			29 01 00 00 00 00 02
			C0 50
			15 01 00 00 00 00 02		/* VGH Clamp (Normal Mode) */
			00 96
			29 01 00 00 00 00 02
			C5 5C
			15 01 00 00 00 00 02		/* VGL Clamp (Normal Mode) */
			00 97
			29 01 00 00 00 00 02
			C5 43
			15 01 00 00 00 00 02		/* VGH Clamp (Idle Mode) */
			00 A6
			29 01 00 00 00 00 02
			C5 5C
			15 01 00 00 00 00 02		/* VGL Clamp (Idle Mode) */
			00 A7
			29 01 00 00 00 00 02
			C5 43
			15 01 00 00 00 00 02		/* VCI1/VCL Pump ratio (Normal Mode) */
			00 98
			29 01 00 00 00 00 03
			C5 44 44
			15 01 00 00 00 00 02		/* VCI1/VCL Pump ratio (Idle Mode) */
			00 A8
			29 01 00 00 00 00 03
			C5 44 44
			15 01 00 00 00 00 02		/* VGHO2 (Normal Mode) */
			00 91
			29 01 00 00 00 00 02
			C5 57
			15 01 00 00 00 00 02		/* VGLO2 (Normal Mode) */
			00 92
			29 01 00 00 00 00 02
			C5 3E
			15 01 00 00 00 00 02		/* VGHO2 (Idle Mode) */
			00 A1
			29 01 00 00 00 00 02
			C5 57
			15 01 00 00 00 00 02		/* VGLO2 (Idle Mode) */
			00 A2
			29 01 00 00 00 00 02
			C5 3E
			15 01 00 00 00 00 02		/* GVDD/NGVDD */
			00 00
			29 01 00 00 00 00 03
			D8 8C AA
			15 01 00 00 00 00 02		/* Panel timing 1 */
			00 80
			29 01 00 00 00 00 0D
			C2 87 00 00 03 86 00 00 03 85 00 00 03
			15 01 00 00 00 00 02		/* Panel timing 2 */
			00 90
			29 01 00 00 00 00 0D
			C2 84 00 00 03 83 01 00 03 82 02 00 03
			15 01 00 00 00 00 02		/* Panel timing 3 */
			00 A0
			29 01 00 00 00 00 0D
			C2 81 03 00 03 00 04 00 03 00 00 00 00
			15 01 00 00 00 00 02		/* Panel timing 4 */
			00 B0
			29 01 00 00 00 00 0D
			C2 00 00 00 00 00 00 00 00 00 00 00 00
			15 01 00 00 00 00 02		/* Panel timing 5 */
			00 C0
			29 01 00 00 00 00 0D
			C2 00 00 00 00 00 00 00 00 00 00 00 00
			15 01 00 00 00 00 02		/* Panel timing 6 */
			00 D0
			29 01 00 00 00 00 0C
			C2 00 00 00 00 07 17 97 00 17 97 00
			15 01 00 00 00 00 02		/* Panel timing 7 */
			00 80
			29 01 00 00 00 00 0F
			C3 8B 00 00 8A 00 00 89 00 00 88 00 00 33 33
			15 01 00 00 00 00 02		/* Panel timing 8 */
			00 A0
			29 01 00 00 00 00 10
			C3 00 3F 01 00 3F 01 00 02 0F 0F 02 0F 0F C1 00
			15 01 00 00 00 00 02		/* Panel timing 9 */
			00 B0
			29 01 00 00 00 00 10
			C3 00 00 00 00 00 00 00 00 02 00 00 02 02 01 01
			15 01 00 00 00 00 02		/* Panel timing 10 */
			00 80
			29 01 00 00 00 00 10
			CB 40 40 40 40 40 40 40 40 40 40 40 40 40 40 40
			15 01 00 00 00 00 02		/* Panel timing 11 */
			00 90
			29 01 00 00 00 00 10
			CB 00 00 00 00 00 40 40 40 40 40 40 40 40 40 40
			15 01 00 00 00 00 02		/* Panel timing 12 */
			00 A0
			29 01 00 00 00 00 0B
			CB 40 40 40 40 40 00 00 00 00 00
			15 01 00 00 00 00 02		/* Panel timing 13 */
			00 B0
			29 01 00 00 00 00 10
			CB 01 05 05 01 01 C5 C5 C5 C5 C5 C5 C5 C5 C5 C5
			15 01 00 00 00 00 02		/* Panel timing 14 */
			00 C0
			29 01 00 00 00 00 10
			CB 01 01 01 01 01 01 05 05 01 01 C5 C5 C5 C5 C5
			15 01 00 00 00 00 02		/* Panel timing 15 */
			00 D0
			29 01 00 00 00 00 0B
			CB C5 C5 C5 C5 01 01 01 01 01 00
			15 01 00 00 00 00 02		/* Panel timing 16 */
			00 80
			29 01 00 00 00 00 10
			CC 32 02 01 23 24 09 09 07 07 0D 0D 0B 0B 17 19
			15 01 00 00 00 00 02		/* Panel timing 17 */
			00 90
			29 01 00 00 00 00 10
			CC 01 01 3A 3A 3A 32 02 01 23 24 0A 0A 08 08 0E
			15 01 00 00 00 00 02		/* Panel timing 18 */
			00 A0
			29 01 00 00 00 00 0B
			CC 0E 0C 0C 18 1A 01 01 3A 3A 3A
			15 01 00 00 00 00 02		/* Panel timing 19 */
			00 B0
			29 01 00 00 00 00 10
			CC 32 01 02 23 24 0C 0C 0E 0E 08 08 0A 0A 1A 18
			15 01 00 00 00 00 02		/* Panel timing 20 */
			00 C0
			29 01 00 00 00 00 10
			CC 01 01 3A 3A 3A 32 01 02 23 24 0B 0B 0D 0D 07
			15 01 00 00 00 00 02		/* Panel timing 21 */
			00 D0
			29 01 00 00 00 00 0B
			CC 07 09 09 19 17 01 01 3A 3A 3A
			15 01 00 00 00 00 02		/* Panel timing 22 */
			00 E0
			29 01 00 00 00 00 10
			CC 00 00 00 00 00 00 00 00 00 00 05 05 05 05 05
			15 01 00 00 00 00 02		/* Panel timing 23 */
			00 F0
			29 01 00 00 00 00 09
			CC 00 00 00 00 00 00 00 00
			15 01 00 00 00 00 02		/* Positive Gamma 1 */
			00 00
			29 01 00 00 00 00 10
			E1 00 0A 21 35 40 4B 5C 69 6A 76 76 89 7C 6A 6D
			15 01 00 00 00 00 02		/* Positive Gamma 2 */
			00 10
			29 01 00 00 00 00 0A
			E1 62 5A 4F 3E 35 2A 1D 10 07
			15 01 00 00 00 00 02		/* Negative Gamma 1 */
			00 00
			29 01 00 00 00 00 10
			E2 00 0A 21 35 40 4B 5D 6A 6B 76 77 8A 7C 6A 6D
			15 01 00 00 00 00 02		/* Negative Gamma 2 */
			00 10
			29 01 00 00 00 00 0A
			E2 62 5A 4F 3F 35 2A 1D 10 07
			15 01 00 00 00 00 02		/* RAM Compressing Setting */
			00 00
			29 01 00 00 00 00 02
			1C 03
			15 01 00 00 00 00 02		/* Unknown 1 */
			00 90
			29 01 00 00 00 00 02
			F4 08
			15 01 00 00 00 00 02		/* Unknown 2 */
			00 8D
			29 01 00 00 00 00 03
			A4 01 60
			15 01 00 00 00 00 02		/* Unknown 3 */
			00 90
			29 01 00 00 00 00 05
			F5 4A 00 4A 00
			15 01 00 00 00 00 02		/* Unknown 4 */
			00 91
			29 01 00 00 00 00 04
			F4 03 33 33
			15 01 00 00 00 00 02		/* Unknown 5 */
			00 92
			29 01 00 00 00 00 02
			C4 01
			15 01 00 00 00 00 02		/* Software Panel Setting */
			00 A5
			29 01 00 00 00 00 03
			B3 17 08
			15 01 00 00 00 00 02		/* Unknown 6 */
			00 80
			29 01 00 00 00 00 02
			C4 00
			15 01 00 00 00 00 02		/* Vcom Path */
			00 81
			29 01 00 00 00 00 02
			A5 03
			15 01 00 00 00 00 02		/* Unknown 7 */
			00 A4
			29 01 00 00 00 00 05
			CF 00 07 20 70
			15 01 00 00 00 00 02		/* Vstart */
			00 94
			29 01 00 00 00 00 05
			CF 00 00 80 90
			15 01 00 00 00 00 02		/* Vmid */
			00 98
			29 01 00 00 00 00 05
			CF 03 03 10 20
			15 01 00 00 00 00 02		/* Vend */
			00 A0
			29 01 00 00 00 00 05
			CF 06 06 ED FD
			15 01 00 00 00 00 02		/* VGHO & VGLO Delta Set */
			00 82
			29 01 00 00 00 00 02
			C5 0E
			15 01 00 00 00 00 02		/* Unknown 8 */
			00 D1
			29 01 00 00 00 00 07
			CF 02 04 01 FF 00 AD
			15 01 00 00 00 00 02		/* Unknown 9 */
			00 D7
			29 01 00 00 00 00 07
			CF 02 04 00 0D 00 08
			15 01 00 00 00 00 02		/* Unknown 10 */
			00 B0
			29 01 00 00 00 00 04
			C5 20 20 01
			15 01 00 00 00 00 02		/* TCON VFP HI / LO */
			00 82
			29 01 00 00 00 00 04
			C0 01 33 10
			15 01 00 00 00 00 02		/* Unknown 11 */
			00 A2
			29 01 00 00 00 00 03
			F5 80 C0
			15 01 00 00 00 00 02		/* VGHO1 & VGLO1 Offset */
			00 85
			29 01 00 00 00 00 02
			C5 01
			15 01 00 00 00 00 02		/* Glance Mode VBP/VFP Set */
			00 99
			29 01 00 00 00 00 05
			C0 07 80 07 80
			15 01 00 00 00 00 02		/* Source Tail PTS Setting */
			00 80
			29 01 00 00 00 00 02
			A6 00
			15 01 00 00 00 00 02		/* Display OSC Frequency */
			00 80
			29 01 00 00 00 00 03
			C1 22 22
                        15 01 00 00 00 00 02            /* Touch OSC Frequency - Temporal*/
                        00 C1
                        29 01 00 00 00 00 02
                        F4 3F
			15 01 00 00 00 00 02		/* TP Term 2 */
			00 9B
			29 01 00 00 00 00 03
			CE 01 06
			15 01 00 00 00 00 02		/* VGH / VGL Pump Ratio */
			00 95
			29 01 00 00 00 00 02
			C5 A2
			15 01 00 00 00 00 02		/* En NVDD */
			00 C5
			29 01 00 00 00 00 02
			F5 80

			29 01 00 00 00 00 03		/* Color Enhancement */
			91 80 00
			15 01 00 00 00 00 02		/* Color Noise Improvement */
			00 B0
			29 01 00 00 00 00 0D
			D6 58 58 58 58 58 58 58	58 58 58 58 58
			15 01 00 00 00 00 02		/* Skin Tone Improvement */
			00 C0
			29 01 00 00 00 00 0D
			D6 95 72 AA AA AA AA AA AA AA AA AA AA
			15 01 00 00 00 00 02		/* Yellow Color Adjustment */
			00 D0
			29 01 00 00 00 00 0D
			D6 90 80 56 80 80 80 80 80 80 80 80 80
			29 01 00 00 00 00 03		/* Sharpness Enhancement */
			90 80 11

			05 01 00 00 78 00 01		/* Sleep out */
			11
			05 01 00 00 05 00 01		/* Display On */
			29
			];
		qcom,mdss-dsi-off-command = [
			05 01 00 00 00 00 01		/* Display off */
			28
			05 01 00 00 64 00 01		/* Sleep in */
			10
			];

		qcom,panel-reader-mode-initial-setting-command = [
			15 01 00 00 00 00 02
			00 80

			29 01 00 00 00 00 07
			C8 04 00 03 C1 03 5E

			15 01 00 00 00 00 02
			00 90

			29 01 00 00 00 00 07
			C8 04 00 03 DA 03 97

			15 01 00 00 00 00 02
			00 A0

			29 01 00 00 00 00 07
			C8 04 00 03 23 02 AB

			15 01 00 00 00 00 02
			94 00
			];
		qcom,panel-reader-mode-initial-step1-command  = [ // 6600K
			15 01 00 00 00 00 02
			94 81
			];
		qcom,panel-reader-mode-step1-command  = [ // 6600K
			15 01 00 00 00 00 02
			94 81
			];
		qcom,panel-reader-mode-initial-step2-command  = [ // 5500K
			15 01 00 00 00 00 02
			94 E1
			];
		qcom,panel-reader-mode-step2-command  = [// 5500K
			15 01 00 00 00 00 02
			94 E1
			];
		qcom,panel-reader-mode-initial-step3-command  = [ // 5000K
			15 01 00 00 00 00 02
			94 FA
			];
		qcom,panel-reader-mode-step3-command  = [ // 5000K
			15 01 00 00 00 00 02
			94 FA
			];
		qcom,panel-reader-mode-off-command  = [ // off : 7300K
			15 01 00 00 00 00 02
			94 00
			];
		/*qcom,mdss-dsi-on-command-state = "dsi_lp_mode";*/
		qcom,mdss-dsi-on-command-state = "dsi_lp_mode";
		qcom,mdss-dsi-off-command-state = "dsi_lp_mode";
		qcom,mdss-dsi-reader-mode-command-state = "dsi_lp_mode";
		qcom,mdss-dsi-h-sync-pulse = <0>;
		qcom,mdss-dsi-lane-map = "lane_map_0123";
		qcom,mdss-dsi-bllp-eof-power-mode;
		qcom,mdss-dsi-bllp-power-mode;
		qcom,mdss-dsi-lane-0-state;
		qcom,mdss-dsi-lane-1-state;
		qcom,mdss-dsi-lane-2-state;
		qcom,mdss-dsi-lane-3-state;
		qcom,mdss-dsi-panel-timings = [EA 3A 28 00 6C 6E 2C 3E 2E 03 04 00];

		qcom,mdss-dsi-reset-sequence = <1 10>, <0 10>, <1 15>;
		qcom,mdss-dsi-t-clk-post = <0x02>;
		qcom,mdss-dsi-t-clk-pre = <0x2C>;
		qcom,mdss-dsi-dma-trigger = "trigger_sw";

		/* KYH 20150904 modified from none to trigger_sw */
		qcom,mdss-dsi-mdp-trigger = "trigger_sw";

		//qcom,cont-splash-enabled;
		//qcom,mdss-dsi-force-clock-lane-hs;
		qcom,mdss-dsi-lp11-init;
		qcom,suspend-ulps-enabled;

		/* KYH 20150904 modified from DSI_NON_BURST_SYNCH_PULSE to DSI_NON_BURST_SYNCH_EVENT */
		qcom,mdss-dsi-traffic-mode = "non_burst_sync_event";

		qcom,mdss-dsi-post-init-delay = <1>;

		lge,blmap-size = <256>;
		lge,blmap = <
			0 45 45 45 45 45 45 45 45 45 				/* 0 ~ 9 */
			45 45 45 46 46 46 47 47 47 48				/* 10 ~ 19 */
			48 48 49 49 50 53 55 58 60 62				/* 20 ~ 29 */
			64 66 69 72 75 78 80 82 84 86				/* 30 ~ 39 */
			88 90 92 94 96 98 100 102 103 108				/* 40 ~ 49 */
			112 116 120 125 130 134 138 142 146 150			/* 50 ~ 59 */
			154 159 164 169 175 181 187 193 199 205			/* 60 ~ 69 */
			211 217 223 230 237 244 251 259 267 274			/* 70 ~ 79 */
			281 289 296 303 311 319 327 335 343 351			/* 80 ~ 89 */
			359 367 375 383 390 397 404 411 419 432			/* 90 ~ 99 */
			443 456 469 482 495 508 521 534 548 558			/* 100 ~ 109 */
			568 578 588 599 610 621 632 643 654 665			/* 110 ~ 119 */
			676 687 699 713 727 741 755 769 783 798			/* 120 ~ 129 */
			813 828 843 858 873 891 909 927 945 963			/* 130 ~ 139 */
			981 999 1017 1036 1055 1073 1089 1105 1121 1137		/* 140 ~ 149 */
			1153 1170 1188 1206 1224 1242 1260 1278 1295 1316	/* 150 ~ 159 */
			1337 1359 1381 1402 1423 1444 1465 1486 1507 1528	/* 160 ~ 169 */
			1550 1571 1592 1613 1634 1655 1676 1698 1720 1742	/* 170 ~ 179 */
			1764 1786 1808 1830 1857 1884 1911 1938 1965 1992	/* 180 ~ 189 */
			2019 2047 2075 2103 2130 2154 2178 2202 2226 2250	/* 190 ~ 199 */
			2274 2298 2322 2346 2371 2396 2421 2446 2470 2500	/* 200 ~ 209 */
			2530 2560 2590 2620 2650 2680 2710 2740 2770 2800	/* 210 ~ 219 */
			2830 2865 2900 2935 2970 3006 3042 3078 3114 3150	/* 220 ~ 229 */
			3185 3220 3255 3290 3326 3362 3398 3434 3470 3506	/* 230 ~ 239 */
			3542 3578 3614 3650 3687 3724 3761 3798 3835 3872	/* 240 ~ 249 */
			3909 3946 3983 4020 4057 4095>;				/* 250 ~ 255 */
	};
};
