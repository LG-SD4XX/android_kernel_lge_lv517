/*
 * Copyright (c) 2016, The Linux Foundation. All rights reserved.
 *
 * This program is free software; you can redistribute it and/or modify
 * it under the terms of the GNU General Public License version 2 and
 * only version 2 as published by the Free Software Foundation.
 *
 * This program is distributed in the hope that it will be useful,
 * but WITHOUT ANY WARRANTY; without even the implied warranty of
 * MERCHANTABILITY or FITNESS FOR A PARTICULAR PURPOSE.  See the
 * GNU General Public License for more details.
 */

#include "msm8917-lv7_global_ca-pinctrl.dtsi"
#include "msm8917-lv7_global_ca-camera.dtsi"
#include "msm8917-lv7_global_ca-panel.dtsi"
#include "msm8917-lv7_global_ca-sound.dtsi"
#include "msm8917-lv7_global_ca-misc.dtsi"
#include "msm8917-lv7_global_ca-pm.dtsi"
#include "msm8917-lv7_global_ca-touch.dtsi"
