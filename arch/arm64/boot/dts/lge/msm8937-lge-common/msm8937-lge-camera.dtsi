/*
 * Copyright (c) 2015, The Linux Foundation. All rights reserved.
 *
 * This program is free software; you can redistribute it and/or modify
 * it under the terms of the GNU General Public License version 2 and
 * only version 2 as published by the Free Software Foundation.
 *
 * This program is distributed in the hope that it will be useful,
 * but WITHOUT ANY WARRANTY; without even the implied warranty of
 * MERCHANTABILITY or FITNESS FOR A PARTICULAR PURPOSE.  See the
 * GNU General Public License for more details.
 */

/* LGE_CHANGE_S, disabled vfe_secure for ph2, 2016-02-10, hongs.lee@lge.com */
&soc {
	qcom,cam_smmu {
		msm_cam_smmu_cb2: msm_cam_smmu_cb2 {
			status = "disable";
			compatible = "qcom,qsmmu-cam-cb";
			label = "vfe_secure";
			qcom,secure-context;
		};
	};
};
/* LGE_CHANGE_E, disabled vfe_secure for ph2, 2016-02-10, hongs.lee@lge.com */