/* Copyright (c) 2013, The Linux Foundation. All rights reserved.
 *
 * This program is free software; you can redistribute it and/or modify
 * it under the terms of the GNU General Public License version 2 and
 * only version 2 as published by the Free Software Foundation.
 *
 * This program is distributed in the hope that it will be useful,
 * but WITHOUT ANY WARRANTY; without even the implied warranty of
 * MERCHANTABILITY or FITNESS FOR A PARTICULAR PURPOSE.  See the
 * GNU General Public License for more details.
 */

/*---------------------------------------------------------------------------
 * This file is autogenerated file using gcdb parser. Please do not edit it.
 * Update input XML file to add a new entry or update variable in this file
 * VERSION = "1.0"
 *---------------------------------------------------------------------------*/
&mdss_mdp {
	dsi_tovis_nt35523b_wxga_video: qcom,mdss_dsi_tovis_nt35523b_wxga_video {
		compatible = "qcom,mdss-dsi-panel";
		status = "ok";
		qcom,cont-splash-enabled;
		qcom,mdss-dsi-panel-name = "tovis nt32223b wxga video mode dsi panel";
		qcom,mdss-dsi-panel-controller = <&mdss_dsi0>;
		qcom,mdss-dsi-panel-type = "dsi_video_mode";
		qcom,mdss-dsi-panel-destination = "display_1";
		qcom,mdss-dsi-panel-framerate = <60>;
		qcom,mdss-pan-physical-width-dimension = <94>;
		qcom,mdss-pan-physical-height-dimension = <150>;
		qcom,mdss-dsi-virtual-channel-id = <0>;
		qcom,mdss-dsi-stream = <0>;
		qcom,mdss-dsi-panel-width = <800>;
		qcom,mdss-dsi-panel-height = <1280>;
		qcom,mdss-dsi-h-front-porch = <16>;
		qcom,mdss-dsi-h-back-porch = <48>;
		qcom,mdss-dsi-h-pulse-width = <16>;
		qcom,mdss-dsi-h-sync-skew = <0>;
		qcom,mdss-dsi-v-front-porch = <8>;
		qcom,mdss-dsi-v-back-porch = <4>;
		qcom,mdss-dsi-v-pulse-width = <4>;
		qcom,mdss-dsi-h-left-border = <0>;
		qcom,mdss-dsi-h-right-border = <0>;
		qcom,mdss-dsi-v-top-border = <0>;
		qcom,mdss-dsi-v-bottom-border = <0>;
		qcom,mdss-dsi-bpp = <24>;
		qcom,mdss-dsi-color-order = "rgb_swap_rgb";
		qcom,mdss-dsi-underflow-color = <0xff>;
		qcom,mdss-dsi-border-color = <0>;

		qcom,mdss-dsi-on-command = [
/*			39 01 00 00 00 00 06 F0 55 AA 52 08 00
			39 01 00 00 00 00 05 B8 02 06 21 00
			39 01 00 00 00 00 03 BA 22 26
			39 01 00 00 00 00 05 E6 FF FF FB DA
			39 01 00 00 00 00 07 CC 11 11 11 00 00 00
			39 01 00 00 00 00 0D CE 10 10 10 10 10 10 10 10 10 10 10 10
			39 01 00 00 00 00 0D D7 09 09 09 00 01 00 00 00 01 00 00 00
			39 01 00 00 00 00 0D D8 00 00 00 09 09 09 00 00 00 00 09 09
			39 01 00 00 00 00 06 F0 55 AA 52 08 01
			15 01 00 00 00 00 02 B2 01
			15 01 00 00 00 00 02 CA 00
			15 01 00 00 00 00 02 CE 04
			39 01 00 00 00 00 03 BC 78 00
			39 01 00 00 00 00 03 BD 78 00
			39 01 00 00 00 00 06 F0 55 AA 52 08 02
			15 01 00 00 00 00 02 B0 C1
			39 01 00 00 00 00 11 D1 00 A9 00 BA 00 C1 00 CF 00 DC 00 F2 01 06 01 29
			39 01 00 00 00 00 11 D2 01 46 01 76 01 9E 01 DE 02 13 02 14 02 46 02 7D
			39 01 00 00 00 00 11 D3 02 A4 02 D9 03 01 03 2A 03 49 03 68 03 7C 03 99
			39 01 00 00 00 00 05 D4 03 B3 03 CC
			39 01 00 00 00 00 11 D5 00 B0 00 C0 00 C8 00 D6 00 E3 00 F9 01 0D 01 30
			39 01 00 00 00 00 11 D6 01 4D 01 7D 01 A5 01 E5 02 1A 02 1B 02 4D 02 86
			39 01 00 00 00 00 11 D7 02 AB 02 E0 03 04 03 31 03 50 03 6F 03 83 03 A0
			39 01 00 00 00 00 05 D8 03 BA 03 CF
			39 01 00 00 00 00 11 D9 00 1C 00 50 00 60 00 8A 00 92 00 BA 00 D6 01 05
			39 01 00 00 00 00 11 DD 01 28 01 60 01 8F 01 D5 02 0E 02 0D 02 43 02 7D
			39 01 00 00 00 00 11 DE 02 A2 02 D3 02 F9 03 2C 03 4C 03 70 03 85 03 A0
			39 01 00 00 00 00 05 DF 03 BA 03 CF
			39 01 00 00 00 00 06 F0 55 AA 52 08 03
			39 01 00 00 00 00 05 B0 00 23 00 00
			39 01 00 00 00 00 08 B2 01 00 06 04 00 D8 42
			39 01 00 00 00 00 08 B3 01 00 05 04 00 D8 42
			39 01 00 00 00 00 08 BA 85 03 00 04 01 D8 42
			39 01 00 00 00 00 08 BB 85 03 00 03 01 D8 42
			39 01 00 00 00 00 06 F0 55 AA 52 08 06
			15 01 00 00 00 00 02 B3 03
			39 01 00 00 00 00 06 B1 19 18 18 02 3A
			39 01 00 00 00 00 03 B2 3A 3A
			39 01 00 00 00 00 06 B6 13 12 12 00 3A
			39 01 00 00 00 00 05 FF AA 55 A5 80
			15 01 00 00 00 00 02 6F 09
			15 01 00 00 00 00 02 F7 82
			15 01 00 00 00 00 02 6F 0B
			15 01 00 00 00 00 02 F7 E0
			15 01 00 00 00 00 02 55 80
			15 01 00 00 00 00 02 53 2C
			15 01 00 00 00 00 02 51 FF*/
			05 01 00 00 78 00 01 11
			05 01 00 00 0A 00 01 29
			];
		qcom,mdss-dsi-off-command = [
			05 01 00 00 32 00 02
			28 00
			05 01 00 00 78 00 02
			10 00
			];

		qcom,mdss-dsi-on-command-state = "dsi_lp_mode";
		qcom,mdss-dsi-off-command-state = "dsi_hs_mode";
		qcom,mdss-dsi-reader-mode-command-state = "dsi_hs_mode";
		qcom,mdss-dsi-h-sync-pulse = <0>;
		qcom,mdss-dsi-traffic-mode = "non_burst_sync_event";
		qcom,mdss-dsi-lane-map = "lane_map_0123";
		qcom,mdss-dsi-bllp-eof-power-mode;
		qcom,mdss-dsi-bllp-power-mode;
		qcom,mdss-dsi-lane-0-state;
		qcom,mdss-dsi-lane-1-state;
		qcom,mdss-dsi-lane-2-state;
		qcom,mdss-dsi-lane-3-state;
		qcom,mdss-dsi-lp11-init = <1>;
		qcom,mdss-dsi-panel-timings = [7B 1A 10 00 3C 42 14 1c 15 03 04 00];
		qcom,mdss-dsi-t-clk-post = <0x04>;
		qcom,mdss-dsi-t-clk-pre = <0x1A>;
		qcom,mdss-dsi-dma-trigger = "trigger_sw";
		qcom,mdss-dsi-mdp-trigger = "none";
		qcom,mdss-dsi-reset-sequence = <1 10>, <0 20>, <1 200>;
	};
};
