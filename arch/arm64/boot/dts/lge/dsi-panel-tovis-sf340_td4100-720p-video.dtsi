&mdss_mdp {
	dsi_tovis_td4100_hd_incell_vid: qcom,mdss_dsi_tovis_incell_td4100_hd_video{
		compatible = "qcom,mdss-dsi-panel";
		status = "disable";
		qcom,cont-splash-enabled;
		qcom,mdss-dsi-panel-name = "TOVIS INCELL TD4100 HD video mode dsi panel";
		qcom,mdss-dsi-panel-controller = <&mdss_dsi0>;
		qcom,mdss-dsi-panel-type = "dsi_video_mode";
		qcom,mdss-dsi-panel-destination = "display_1";
		qcom,mdss-dsi-panel-framerate = <60>;
		//qcom,mdss-dsi-force-clock-lane-hs;
		qcom,mdss-dsi-virtual-channel-id = <0>;
		qcom,mdss-dsi-stream = <0>;
		qcom,mdss-dsi-lp11-init;
		qcom,suspend-ulps-enabled;
		qcom,mdss-dsi-panel-width = <720>;
		qcom,mdss-dsi-panel-height = <1280>;
		qcom,mdss-dsi-h-front-porch = <78>;
		qcom,mdss-dsi-h-back-porch = <32>;
		qcom,mdss-dsi-h-pulse-width = <4>;
		qcom,mdss-dsi-h-sync-skew = <0>;
		qcom,mdss-dsi-v-front-porch = <127>;
		qcom,mdss-dsi-v-back-porch = <127>;
		qcom,mdss-dsi-v-pulse-width = <127>;
		qcom,mdss-dsi-h-left-border = <0>;
		qcom,mdss-dsi-h-right-border = <0>;
		qcom,mdss-dsi-v-top-border = <0>;
		qcom,mdss-dsi-v-bottom-border = <0>;
		qcom,mdss-pan-physical-width-dimension = <68>;
		qcom,mdss-pan-physical-height-dimension = <120>;
		qcom,mdss-dsi-bpp = <24>;
		qcom,mdss-dsi-color-order = "rgb_swap_rgb";
		qcom,mdss-dsi-underflow-color = <0>;
		qcom,mdss-dsi-border-color = <0>;
		qcom,mdss-dsi-post-panel-on-command = [
			05 01 00 00 78 00 02
			11 00
			05 01 00 00 00 00 02
			29 00
		];
		qcom,mdss-dsi-off-command = [
			05 01 00 00 00 00 02
			28 00
			05 01 00 00 50 00 02
			10 00
		];

		qcom,panel-reader-mode-step1-command = [
			29 01 00 00 00 00 02    // MACP
			B0 04
			15 01 00 00 00 00 02
			84 CC
			15 01 00 00 00 00 02
			C8 01
			29 01 00 00 00 00 02    // MACP
			B0 03
		];
		qcom,panel-reader-mode-step2-command = [
			29 01 00 00 00 00 02    // MACP
			B0 04
			15 01 00 00 00 00 02
			84 A5
			15 01 00 00 00 00 02
			C8 01
			29 01 00 00 00 00 02    // MACP
			B0 03
		];
		qcom,panel-reader-mode-step3-command = [
			29 01 00 00 00 00 02    // MACP
			B0 04
			15 01 00 00 00 00 02
			84 80
			15 01 00 00 00 00 02
			C8 01
			29 01 00 00 00 00 02    // MACP
			B0 03
		];
		qcom,panel-reader-mode-off-command = [
			29 01 00 00 00 00 02    // MACP
			B0 04
			15 01 00 00 00 00 02
			84 00
			15 01 00 00 00 00 02
			C8 00
			29 01 00 00 00 00 02    // MACP
			B0 03
		];

		qcom,mdss-dsi-on-command-state = "dsi_lp_mode";
		qcom,mdss-dsi-off-command-state = "dsi_hs_mode";
		qcom,mdss-dsi-reader-mode-command-state = "dsi_hs_mode";
		qcom,mdss-dsi-h-sync-pulse = <0>;
		qcom,mdss-dsi-traffic-mode = "non_burst_sync_event";
		qcom,mdss-dsi-lane-map = "lane_map_0123";
		qcom,mdss-dsi-bllp-eof-power-mode;
		qcom,mdss-dsi-bllp-power-mode;
		qcom,mdss-dsi-lane-0-state;
		qcom,mdss-dsi-lane-1-state;
		qcom,mdss-dsi-lane-2-state;
		qcom,mdss-dsi-lane-3-state;
		qcom,mdss-dsi-tx-eot-append;
		qcom,mdss-dsi-panel-timings = [8B 1E 14 00 44 4A 18 22 19 03 04 00];
		qcom,mdss-dsi-t-clk-post = <0x04>;
		qcom,mdss-dsi-t-clk-pre = <0x1C>;

		//The following feature "none" and "trigger_sw" are the same in video mode.
		//The feature used any option of TE signal in command mode.
		qcom,mdss-dsi-dma-trigger = "trigger_sw";	//default "trigger_sw"
		qcom,mdss-dsi-mdp-trigger = "trigger_sw";	//default "trigger_sw"

		qcom,mdss-dsi-bl-min-level = <1>;
		qcom,mdss-dsi-bl-max-level = <255>;
		qcom,mdss-dsi-bl-pmic-control-type = "bl_ctrl_wled";
		qcom,mdss-dsi-reset-sequence = <0 10>, <1 130>;

		lge,blmap-size = <256>;
		lge,blmap = <
			0 25 26 27 28 29 30 31 32 33				/* 0 ~ 9 */
			38 38 38 38 39 39 39 39 40 40				/* 10 ~ 19 */
			40 40 41 41 42 43 44 45 46 47				/* 20 ~ 29 */
			48 49 50 51 52 55 57 57 60 63				/* 30 ~ 39 */
			65 67 70 73 75 78 80 80 85 90				/* 40 ~ 49 */
			90 95 95 100 105 105 110 115 115 120			/* 50 ~ 59 */
			125 130 135 140 145 150 155 160 165 170			/* 60 ~ 69 */
			175 175 180 185 190 195 200 205 210 215			/* 70 ~ 79 */
			220 230 235 240 250 255 260 265 270 275			/* 80 ~ 89 */
			280 285 290 295 300 310 320 330 340 345			/* 90 ~ 99 */
			350 360 370 380 390 400 410 415 420 430			/* 100 ~ 109 */
			440 450 460 470 480 490 500 510 520 530			/* 110 ~ 119 */
			535 540 555 567 579 593 615 637 651 667			/* 120 ~ 129 */
			673 679 680 680 692 703 714 725 738 750			/* 130 ~ 139 */
			768 782 795 803 810 820 835 850 865 880			/* 140 ~ 149 */
			895 910 925 940 970 1000 1030 1045 1050 1055		/* 150 ~ 159 */
			1060 1070 1080 1090 1100 1110 1120 1140 1150 1170	/* 160 ~ 169 */
			1190 1210 1230 1250 1300 1350 1400 1450 1455 1460	/* 170 ~ 179 */
			1462 1466 1500 1502 1506 1508 1510 1520 1526 1547	/* 180 ~ 189 */
			1568 1589 1610 1631 1635 1659 1683 1707 1731 1755	/* 190 ~ 199 */
			1800 1850 1900 1940 1970 2000 2010 2020 2050 2080	/* 200 ~ 209 */
			2110 2140 2170 2200 2240 2270 2300 2330 2360 2380	/* 210 ~ 219 */
			2400 2420 2440 2470 2500 2540 2570 2590 2620 2640	/* 220 ~ 229 */
			2660 2680 2700 2730 2750 2780 2800 2820 2840 2870	/* 230 ~ 239 */
			2900 2940 2970 3000 3030 3070 3100 3130 3160 3190	/* 240 ~ 249 */
			3220 3250 3280 3300 3330 3350				/* 250 ~ 255 */
		>;

	};
};
