qcom,LGE_BLT20_LGC_4800mAh {
	/* #2187128_LGE_BLT20_4800mAh_averaged_MasterSlave_Oct30th2015*/
	qcom,max-voltage-uv = <4350000>;
	qcom,nom-batt-capacity-mah = <4800>;
	qcom,batt-id-kohm = <0>;
	qcom,battery-beta = <4150>;
	qcom,battery-type = "LGE_BLT20_LGC_4800mAh";
	qcom,chg-rslow-comp-c1 = <3739897>;
	qcom,chg-rslow-comp-c2 = <7868795>;
	qcom,chg-rs-to-rslow = <956770>;
	qcom,chg-rslow-comp-thr = <0xC3>;
	qcom,checksum = <0xF2E2>;
	qcom,gui-version = "PMI8950GUI - 2.0.0.14";
	qcom,fg-profile-data = [
		D2 83 26 7C
		3C 80 6B 75
		67 83 1E 7C
		2B 90 E9 96
		E3 81 D0 99
		D2 B7 21 C3
		52 13 F8 83
		FE 7C B0 80
		0C 76 5E 83
		6C 6C 8A 88
		F3 8F 31 82
		96 98 EE B5
		29 C1 58 15
		24 13 7E 58
		CE 6E 72 F9
		E8 35 65 44
		AF 39 00 00
		EA 4C 5C 42
		FD 2E 00 00
		00 00 00 00
		00 00 00 00
		D9 70 46 70
		1E 6F B0 81
		95 77 A3 6A
		C8 6C 40 80
		C0 76 D9 68
		B8 69 12 B0
		2D A6 60 8E
		56 A0 71 0C
		28 00 FF 36
		F0 11 30 03
		00 00 00 0C
	];
};
