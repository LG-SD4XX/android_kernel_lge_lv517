qcom,LGE_BL45B1F_Tocad_3000mAh {
	/* #2213834_LGE_BL45B1F_Tocad_3000mAh_averaged_MasterSlave_Nov11th2015*/
	qcom,max-voltage-uv = <4400000>;
	qcom,nom-batt-capacity-mah = <3000>;
	qcom,batt-id-kohm = <0>;
	qcom,battery-beta = <4150>;
	qcom,battery-type = "LGE_BL45B1F_Tocad_3000mAh";
	qcom,chg-rslow-comp-c1 = <4382416>;
	qcom,chg-rslow-comp-c2 = <8472939>;
	qcom,chg-rs-to-rslow = <1454243>;
	qcom,chg-rslow-comp-thr = <0xBD>;
	qcom,checksum = <0xFDCC>;
	qcom,gui-version = "PMI8950GUI - 2.0.0.14";
	qcom,fg-profile-data = [
		 D5 83 5B 7C
		 B6 80 78 76
		 60 83 BD 74
		 0E 8A 1F 95
		 08 82 4F 99
		 21 B7 68 C2
		 52 18 F4 83
		 ED 7C 03 81
		 EB 76 5C 83
		 85 56 FB 82
		 70 8E 62 82
		 B1 98 50 B7
		 AA C3 58 0F
		 80 0B F5 59
		 14 70 71 FD
		 C3 2E 63 46
		 CA 41 00 00
		 66 47 0D 38
		 8E 32 00 00
		 00 00 00 00
		 00 00 00 00
		 5F 71 93 70
		 34 64 C1 81
		 93 76 96 6A
		 DA 66 60 7A
		 8A 75 06 69
		 0C 74 4D B1
		 21 49 69 83
		 67 A0 71 0C
		 28 00 FF 36
		 F0 11 30 03
		 00 00 00 0C
	];
};
