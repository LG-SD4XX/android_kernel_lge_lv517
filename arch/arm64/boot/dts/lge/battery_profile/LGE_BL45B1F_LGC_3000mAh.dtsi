qcom,LGE_BL45B1F_LGC_3000mAh {
	/* #2213834_LGE_BL45B1F_LGC_3000mAh_averaged_MasterSlave_Nov11th2015*/
	qcom,max-voltage-uv = <4400000>;
	qcom,nom-batt-capacity-mah = <3000>;
	qcom,batt-id-kohm = <0>;
	qcom,battery-beta = <4150>;
	qcom,battery-type = "LGE_BL45B1F_LGC_3000mAh";
	qcom,chg-rslow-comp-c1 = <3246327>;
	qcom,chg-rslow-comp-c2 = <5632178>;
	qcom,chg-rs-to-rslow = <1215613>;
	qcom,chg-rslow-comp-thr = <0xB5>;
	qcom,checksum = <0x9ACC>;
	qcom,gui-version = "PMI8950GUI - 2.0.0.14";
	qcom,fg-profile-data = [
		 D2 83 54 7C
		 A3 80 29 76
		 48 83 1E 4B
		 D3 82 CD 8E
		 F3 81 D4 99
		 2C BC 12 C8
		 53 10 ED 83
		 D8 7C E7 80
		 87 76 5D 83
		 DD 67 D6 88
		 8D 94 12 82
		 B8 9A F2 BD
		 44 CB 54 0E
		 9B 0B 9A 59
		 14 70 71 FD
		 0D 3E B4 44
		 02 42 00 00
		 CC 47 04 31
		 FD 26 00 00
		 00 00 00 00
		 00 00 00 00
		 EF 71 07 71
		 93 6F BD 80
		 9A 76 6A 69
		 B5 5E A3 79
		 12 76 A9 68
		 07 6F 5D B0
		 2C B8 68 46
		 65 A0 71 0C
		 28 00 FF 36
		 F0 11 30 03
		 00 00 00 0C
	];
};
