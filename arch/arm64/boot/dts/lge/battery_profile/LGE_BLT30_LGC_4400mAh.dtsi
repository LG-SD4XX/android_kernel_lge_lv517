qcom,LGE_BLT30_LGC_4400mAh{
	/* #2645254_LGE_BLT30lgc_4400mAh_averaged_MasterSlave_Oct25th2016*/
	qcom,max-voltage-uv = <4400000>;
	qcom,nom-batt-capacity-mah = <4400>;
	qcom,batt-id-kohm = <4700>;
	qcom,battery-beta = <4150>;
	qcom,battery-type = "LGE_BLT30_LGC_4400mAh";
	qcom,chg-rslow-comp-c1 = <2758900>;
	qcom,chg-rslow-comp-c2 = <3026230>;
	qcom,chg-rs-to-rslow = <1121261>;
	qcom,chg-rslow-comp-thr = <0x99>;
	qcom,checksum = <0x4F8E>;
	qcom,gui-version = "PMI8950GUI - 2.0.0.16";
	qcom,fg-profile-data = [
		 E6 83 1F 7D
		 52 81 9D 77
		 7A 83 F3 7C
		 28 90 49 96
		 6B 82 50 93
		 AD B4 FB BB
		 58 19 74 83
		 D5 66 92 78
		 25 6C 45 83
		 E6 72 E2 7C
		 C3 6B 75 82
		 04 98 81 B5
		 C0 C0 6B 0D
		 33 12 04 59
		 14 70 71 FD
		 88 44 9D 3D
		 5F 38 00 00
		 9D 46 07 39
		 DE 2B 00 00
		 00 00 00 00
		 00 00 00 00
		 50 70 3B 6B
		 DB 59 5C 7A
		 6C 74 A4 5B
		 85 71 06 82
		 B7 6E 7D 43
		 39 72 45 B3
		 18 66 63 62
		 64 A0 71 0C
		 28 00 FF 36
		 F0 11 30 03
		 00 00 00 0C
	];
};
