qcom,LGE_BL44E1F_LGC_3200mAh {
	/* #2606636_LGE_BL44E1Flgc_3200mAh_averaged_MasterSlave_Sept16th2016*/
	qcom,max-voltage-uv = <4400000>;
	qcom,nom-batt-capacity-mah = <3200>;
	qcom,batt-id-kohm = <0>;
	qcom,battery-beta = <4150>;
	qcom,battery-type = "LGE_BL44E1F_LGC_3200mAh";
	qcom,chg-rslow-comp-c1 = <3130048>;
	qcom,chg-rslow-comp-c2 = <5003927>;
	qcom,chg-rs-to-rslow = <1064448>;
	qcom,chg-rslow-comp-thr = <0xAF>;
	qcom,checksum = <0xC246>;
	qcom,gui-version = "PMI8950GUI - 2.0.0.16";
	qcom,fg-profile-data = [
		 CF 83 2B 7C
		 8A 80 1B 76
		 43 83 25 68
		 1E 80 81 8C
		 EA 81 D9 99
		 16 BC D2 C3
		 55 10 E3 83
		 5E 7C 82 80
		 D0 75 45 83
		 65 71 37 59
		 F8 7E 0D 82
		 9E 9A C3 BD
		 0A CB 58 0E
		 4C 0C F9 59
		 14 70 71 FD
		 F6 3D 05 46
		 C6 42 00 00
		 EB 4C 9B 3A
		 27 38 00 00
		 00 00 00 00
		 00 00 00 00
		 CA 70 29 70
		 D9 57 1D 82
		 43 75 2D 63
		 4E 60 1F 80
		 1E 75 50 63
		 A0 64 E6 A9
		 2C 46 6B 79
		 6C A0 71 0C
		 28 00 FF 36
		 F0 11 30 03
		 00 00 00 0C
	];
};
