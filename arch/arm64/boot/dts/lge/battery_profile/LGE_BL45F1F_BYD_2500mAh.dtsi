qcom,LGE_BL45F1F_BYD_2500mAh {
    /* #2641373_LGE_BL45F1Fbyd_2500mAh_averaged_MasterSlave_Oct18th2016*/
    qcom,max-voltage-uv = <4400000>;
    qcom,nom-batt-capacity-mah = <2500>;
    qcom,batt-id-kohm = <0>;
    qcom,battery-beta = <4150>;
    qcom,battery-type = "LGE_BL45F1F_BYD_2500mAh";
    qcom,chg-rslow-comp-c1 = <4141447>;
    qcom,chg-rslow-comp-c2 = <7998783>;
    qcom,chg-rs-to-rslow = <1182443>;
    qcom,chg-rslow-comp-thr = <0xBD>;
    qcom,checksum = <0x0095>;
    qcom,gui-version = "PMI8950GUI - 2.0.0.16";
    qcom,fg-profile-data = [
         F1 83 65 7D
         85 81 17 7C
         5F 83 EE 6C
         A5 83 E7 8D
         31 82 92 99
         75 BC D2 C8
         5C 0F F9 83
         2C 7D 3A 81
         73 77 52 83
         F0 6A DF 73
         8F 85 3D 82
         0A 9A 50 BD
         51 CA 59 0D
         62 09 C0 5A
         14 70 29 FC
         A2 21 9F 47
         3F 31 00 00
         D7 45 F7 34
         8E 3A 00 00
         00 00 00 00
         00 00 00 00
         17 71 16 70
         38 84 3E 88
         69 77 5D 70
         68 75 D5 79
         C9 74 96 68
         F4 44 4A A0
         29 BC 62 C3
         64 A0 71 0C
         28 00 FF 36
         F0 11 30 03
         00 00 00 0C
    ];
};
