
qcom,LGE_BLT24_PANA_4100mAh{
	/* #2671074_LGE_BLT24pana_4100mAh_averaged_MasterSlave_Nov3rd2016*/
	qcom,max-voltage-uv = <4400000>;
	qcom,nom-batt-capacity-mah = <4100>;
	qcom,batt-id-kohm = <54500>;
	qcom,battery-beta = <3435>;
	qcom,battery-type = "LGE_BLT24_PANA_4100mAh";
	qcom,chg-rslow-comp-c1 = <3121666>;
	qcom,chg-rslow-comp-c2 = <4571535>;
	qcom,chg-rs-to-rslow = <761887>;
	qcom,chg-rslow-comp-thr = <0xA8>;
	qcom,checksum = <0x7037>;
	qcom,gui-version = "PMI8950GUI - 2.0.0.16";
	qcom,fg-profile-data = [
		 E7 83 1B 7D
		 58 81 C2 77
		 4C 83 B8 61
		 07 80 C1 87
		 36 82 8D 99
		 89 BC F5 C8
		 58 14 F5 83
		 21 7D 47 81
		 8F 77 5A 83
		 5C 51 28 82
		 FD 8D 3F 82
		 87 9A 3F BE
		 05 D0 58 0D
		 C4 0F 55 5A
		 14 70 71 FD
		 AC 2C F4 47
		 93 41 00 00
		 B0 4C 75 30
		 C6 42 00 00
		 00 00 00 00
		 00 00 00 00
		 93 6A D1 69
		 F5 68 69 88
		 CD 75 C4 69
		 8A 68 A9 82
		 4E 75 C4 68
		 09 7D 79 A3
		 1A A2 61 6E
		 5E A0 71 0C
		 28 00 FF 36
		 F0 11 30 03
		 00 00 00 0C
	];
};
