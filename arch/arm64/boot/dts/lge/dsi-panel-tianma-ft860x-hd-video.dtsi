/* Copyright (c) 2013, The Linux Foundation. All rights reserved.
 *
 * This program is free software; you can redistribute it and/or modify
 * it under the terms of the GNU General Public License version 2 and
 * only version 2 as published by the Free Software Foundation.
 *
 * This program is distributed in the hope that it will be useful,
 * but WITHOUT ANY WARRANTY; without even the implied warranty of
 * MERCHANTABILITY or FITNESS FOR A PARTICULAR PURPOSE.  See the
 * GNU General Public License for more details.
 */

/*---------------------------------------------------------------------------
 * This file is autogenerated file using gcdb parser. Please do not edit it.
 * Update input XML file to add a new entry or update variable in this file
 * VERSION = "1.0"
 *---------------------------------------------------------------------------*/
&mdss_mdp {
	dsi_tianma_ft860x_hd_video: qcom,mdss_dsi_tianma_ft860x_hd_video {
		compatible = "qcom,mdss-dsi-panel";
		status = "ok";
		qcom,cont-splash-enabled;
		qcom,mdss-dsi-panel-name = "tianma ft860x 720p video mode dsi panel";
		qcom,mdss-dsi-panel-controller = <&mdss_dsi0>;
		qcom,mdss-dsi-panel-type = "dsi_video_mode";
		qcom,mdss-dsi-panel-destination = "display_1";
		qcom,mdss-dsi-panel-framerate = <60>;
		qcom,mdss-pan-physical-width-dimension = < 62 >;
		qcom,mdss-pan-physical-height-dimension = < 110 >;
		qcom,mdss-dsi-virtual-channel-id = <0>;
		qcom,mdss-dsi-stream = <0>;
		qcom,mdss-dsi-panel-width = <720>;
		qcom,mdss-dsi-panel-height = <1280>;
		qcom,mdss-dsi-h-front-porch = <96>;
		qcom,mdss-dsi-h-back-porch = <51>;
		qcom,mdss-dsi-h-pulse-width = <4>;
		qcom,mdss-dsi-h-sync-skew = <0>;
		qcom,mdss-dsi-v-back-porch = <25>;
		qcom,mdss-dsi-v-front-porch = <30>;
		qcom,mdss-dsi-v-pulse-width = <4>;
		qcom,mdss-dsi-h-left-border = <0>;
		qcom,mdss-dsi-h-right-border = <0>;
		qcom,mdss-dsi-v-top-border = <0>;
		qcom,mdss-dsi-v-bottom-border = <0>;
		qcom,mdss-dsi-bpp = <24>;
		qcom,mdss-dsi-color-order = "rgb_swap_rgb";
		qcom,mdss-dsi-underflow-color = <0xff>;
		qcom,mdss-dsi-border-color = <0>;
		qcom,mdss-dsi-on-command = [
			05 01 00 00 78 00 01 11
			05 01 00 00 00 00 01 29
		];
		qcom,mdss-dsi-off-command = [05 01 00 00 00 00 01 28
					05 01 00 00 78 00 01 10];

		qcom,panel-reader-mode-step1-command = [	// LOW 6200K
			39 01 00 00 00 00 06 F0 46 23 11 01 01
			39 01 00 00 00 00 05 D0 0F 0F 0F 0F
			39 01 00 00 00 00 3D D1 00 00 00 09 00 23 00 45 00 5B 00 77 00 84 00 92 00 A3 00 CC 00 EF 01 23 01 4C 01 88 01 C1 01 C3 02 03 02 54 02 86 02 C7 02 F0 03 24 03 34 03 46 03 5B 03 75 03 93 03 BD 03 E9 03 FF
			39 01 00 00 00 00 3D D4 00 00 00 09 00 23 00 45 00 5B 00 77 00 84 00 92 00 A3 00 CC 00 EF 01 23 01 4C 01 88 01 C1 01 C3 02 03 02 54 02 86 02 C7 02 F0 03 24 03 34 03 46 03 5B 03 75 03 93 03 BD 03 E9 03 FF
			39 01 00 00 00 00 3D D2 00 00 00 04 00 26 00 43 00 5A 00 78 00 83 00 91 00 A1 00 CB 00 EC 01 20 01 47 01 84 01 BB 01 BD 01 FB 02 47 02 76 02 B0 02 D4 02 FE 03 0A 03 17 03 25 03 35 03 46 03 5A 03 70 03 7D
			39 01 00 00 00 00 3D D5 00 00 00 04 00 26 00 43 00 5A 00 78 00 83 00 91 00 A1 00 CB 00 EC 01 20 01 47 01 84 01 BB 01 BD 01 FB 02 47 02 76 02 B0 02 D4 02 FE 03 0A 03 17 03 25 03 35 03 46 03 5A 03 70 03 7D
			39 01 00 00 00 00 3D D3 00 00 00 07 00 31 00 45 00 5A 00 73 00 80 00 8C 00 9B 00 C6 00 E2 01 19 01 39 01 74 01 A6 01 A8 01 DF 02 20 02 44 02 6E 02 85 02 A0 02 A7 02 AE 02 B6 02 BE 02 C6 02 CE 02 D7 02 DB
			39 01 00 00 00 00 3D D6 00 00 00 07 00 31 00 45 00 5A 00 73 00 80 00 8C 00 9B 00 C6 00 E2 01 19 01 39 01 74 01 A6 01 A8 01 DF 02 20 02 44 02 6E 02 85 02 A0 02 A7 02 AE 02 B6 02 BE 02 C6 02 CE 02 D7 02 DB
			39 01 00 00 00 00 06 F0 46 23 11 00 01
		];
		qcom,panel-reader-mode-step2-command = [	// MIDDLE 5500K
			39 01 00 00 00 00 06 F0 46 23 11 01 01
			39 01 00 00 00 00 05 D0 0F 0F 0F 0F
			39 01 00 00 00 00 3D D1 00 00 00 0A 00 20 00 42 00 5A 00 6E 00 82 00 98 00 A2 00 D1 00 F3 01 26 01 4C 01 89 01 CD 01 CE 02 0A 02 58 02 8A 02 C8 02 F0 03 1E 03 2C 03 3C 03 4F 03 66 03 80 03 9D 03 D9 03 FF
			39 01 00 00 00 00 3D D4 00 00 00 0A 00 20 00 42 00 5A 00 6E 00 82 00 98 00 A2 00 D1 00 F3 01 26 01 4C 01 89 01 CD 01 CE 02 0A 02 58 02 8A 02 C8 02 F0 03 1E 03 2C 03 3C 03 4F 03 66 03 80 03 9D 03 D9 03 FF
			39 01 00 00 00 00 3D D2 00 00 00 0B 00 25 00 45 00 5E 00 70 00 86 00 9A 00 A4 00 D2 00 F3 01 26 01 4C 01 89 01 CB 01 CD 02 08 02 54 02 86 02 C1 02 E7 03 14 03 1F 03 2E 03 3D 03 50 03 65 03 7D 03 9B 03 AF
			39 01 00 00 00 00 3D D5 00 00 00 0B 00 25 00 45 00 5E 00 70 00 86 00 9A 00 A4 00 D2 00 F3 01 26 01 4C 01 89 01 CB 01 CD 02 08 02 54 02 86 02 C1 02 E7 03 14 03 1F 03 2E 03 3D 03 50 03 65 03 7D 03 9B 03 AF
			39 01 00 00 00 00 3D D3 00 00 00 13 00 20 00 3E 00 58 00 6B 00 7A 00 90 00 9C 00 C5 00 E8 01 17 01 3A 01 71 01 A2 01 A3 01 DC 02 0E 02 2D 02 50 02 63 02 77 02 7D 02 82 02 88 02 8D 02 93 02 99 02 9F 02 A2
			39 01 00 00 00 00 3D D6 00 00 00 13 00 20 00 3E 00 58 00 6B 00 7A 00 90 00 9C 00 C5 00 E8 01 17 01 3A 01 71 01 A2 01 A3 01 DC 02 0E 02 2D 02 50 02 63 02 77 02 7D 02 82 02 88 02 8D 02 93 02 99 02 9F 02 A2
			39 01 00 00 00 00 06 F0 46 23 11 00 01
		];
		qcom,panel-reader-mode-step3-command = [	// HIGH 5000K
			39 01 00 00 00 00 06 F0 46 23 11 01 01
			39 01 00 00 00 00 05 D0 0F 0F 0F 0F
			39 01 00 00 00 00 3D D1 00 00 00 18 00 34 00 51 00 67 00 7C 00 8A 00 9C 00 A9 00 D3 00 F7 01 27 01 53 01 90 01 CB 01 CD 02 0F 02 5D 02 8E 02 CF 02 F9 03 2E 03 3F 03 51 03 64 03 7D 03 96 03 BF 03 EA 03 FF
			39 01 00 00 00 00 3D D4 00 00 00 18 00 34 00 51 00 67 00 7C 00 8A 00 9C 00 A9 00 D3 00 F7 01 27 01 53 01 90 01 CB 01 CD 02 0F 02 5D 02 8E 02 CF 02 F9 03 2E 03 3F 03 51 03 64 03 7D 03 96 03 BF 03 EA 03 FF
			39 01 00 00 00 00 3D D2 00 00 00 11 00 34 00 51 00 67 00 7D 00 8C 00 9E 00 AA 00 D4 00 F6 01 25 01 50 01 8B 01 C4 01 C6 02 03 02 4E 02 7D 02 B6 02 DA 03 07 03 13 03 20 03 2F 03 40 03 53 03 68 03 81 03 8E
			39 01 00 00 00 00 3D D5 00 00 00 11 00 34 00 51 00 67 00 7D 00 8C 00 9E 00 AA 00 D4 00 F6 01 25 01 50 01 8B 01 C4 01 C6 02 03 02 4E 02 7D 02 B6 02 DA 03 07 03 13 03 20 03 2F 03 40 03 53 03 68 03 81 03 8E
			39 01 00 00 00 00 3D D3 00 00 00 14 00 34 00 49 00 5B 00 72 00 80 00 8D 00 9D 00 C3 00 E0 01 13 01 32 01 69 01 97 01 98 01 C6 01 F6 02 12 02 31 02 41 02 52 02 57 02 5C 02 60 02 65 02 6A 02 6E 02 73 02 76
			39 01 00 00 00 00 3D D6 00 00 00 14 00 34 00 49 00 5B 00 72 00 80 00 8D 00 9D 00 C3 00 E0 01 13 01 32 01 69 01 97 01 98 01 C6 01 F6 02 12 02 31 02 41 02 52 02 57 02 5C 02 60 02 65 02 6A 02 6E 02 73 02 76
			39 01 00 00 00 00 06 F0 46 23 11 00 01
		];
		qcom,panel-reader-mode-off-command = [		// NORMAL
			39 01 00 00 00 00 06 F0 46 23 11 01 01
			39 01 00 00 00 00 05 D0 0F 0F 0F 0F
			39 01 00 00 00 00 3D D1 00 00 00 22 00 39 00 63 00 6C 00 7A 00 86 00 94 00 A0 00 D0 00 F0 01 27 01 4D 01 88 01 BE 01 C0 01 FA 02 3C 02 64 02 94 02 B1 02 D4 02 DD 02 E8 02 F3 02 FE 03 0A 03 16 03 25 03 2F
			39 01 00 00 00 00 3D D4 00 00 00 22 00 39 00 63 00 6C 00 7A 00 86 00 94 00 A0 00 D0 00 F0 01 27 01 4D 01 88 01 BE 01 C0 01 FA 02 3C 02 64 02 94 02 B1 02 D4 02 DD 02 E8 02 F3 02 FE 03 0A 03 16 03 25 03 2F
			39 01 00 00 00 00 3D D2 00 00 00 20 00 4C 00 74 00 7E 00 8A 00 9A 00 A6 00 B2 00 E1 01 02 01 35 01 5C 01 98 01 CC 01 CE 02 0B 02 5D 02 8E 02 CB 02 F1 03 26 03 35 03 45 03 57 03 6B 03 82 03 9E 03 C3 03 DF
			39 01 00 00 00 00 3D D5 00 00 00 20 00 4C 00 74 00 7E 00 8A 00 9A 00 A6 00 B2 00 E1 01 02 01 35 01 5C 01 98 01 CC 01 CE 02 0B 02 5D 02 8E 02 CB 02 F1 03 26 03 35 03 45 03 57 03 6B 03 82 03 9E 03 C3 03 DF
			39 01 00 00 00 00 3D D3 00 00 00 26 00 50 00 79 00 81 00 90 00 A1 00 A9 00 B8 00 E8 01 06 01 3E 01 65 01 A3 01 DA 01 DC 02 27 02 7A 02 B0 02 F4 03 18 03 57 03 5D 03 66 03 77 03 8E 03 A5 03 C1 03 E6 03 FF
			39 01 00 00 00 00 3D D6 00 00 00 26 00 50 00 79 00 81 00 90 00 A1 00 A9 00 B8 00 E8 01 06 01 3E 01 65 01 A3 01 DA 01 DC 02 27 02 7A 02 B0 02 F4 03 18 03 57 03 5D 03 66 03 77 03 8E 03 A5 03 C1 03 E6 03 FF
			39 01 00 00 00 00 06 F0 46 23 11 00 01
		];
		qcom,mdss-dsi-on-command-state = "dsi_lp_mode";
		qcom,mdss-dsi-off-command-state = "dsi_hs_mode";
		qcom,mdss-dsi-reader-mode-command-state = "dsi_hs_mode";
		qcom,mdss-dsi-h-sync-pulse = <1>;//0
		qcom,mdss-dsi-traffic-mode = "non_burst_sync_pulse";
		qcom,mdss-dsi-lane-map = "lane_map_0123";
		qcom,mdss-dsi-bllp-eof-power-mode;
		qcom,suspend-ulps-enabled;
		//qcom,esd-check-enabled;
		qcom,mdss-dsi-panel-status-check-mode = "bta_check";
		qcom,mdss-dsi-last-line-interleave;
		qcom,mdss-dsi-lane-0-state;
		qcom,mdss-dsi-lane-1-state;
		qcom,mdss-dsi-lane-2-state;
		qcom,mdss-dsi-lane-3-state;
		qcom,mdss-dsi-lp11-init;//reset during lp11
		qcom,mdss-dsi-panel-timings = [77 1a 14 00 3e 40 16 1e 15 03 04 00];
		qcom,mdss-dsi-t-clk-post = <0x04>;
		qcom,mdss-dsi-t-clk-pre = <0x1a>;//0x26
		qcom,mdss-dsi-bl-pmic-control-type = "bl_ctrl_wled";
		qcom,mdss-dsi-bl-min-level = <1>;
		qcom,mdss-dsi-bl-max-level = <255>;
		qcom,mdss-dsi-dma-trigger = "trigger_sw";
		qcom,mdss-dsi-mdp-trigger = "none";
		qcom,mdss-dsi-reset-sequence = <2 2>, <0 1>, <2 20>;

                lge,blmap-size = <256>;
                lge,blmap = <
                        0 42 42 42 42 42 42 42 42 42                            /* 0 ~ 9 */
                        42 42 42 43 43 44 44 45 45 46                           /* 10 ~ 19 */
                        46 46 47 47 47 49 51 53 55 57                           /* 20 ~ 29 */
                        59 61 62 63 65 65 65 68 72 75                           /* 30 ~ 39 */
                        79 82 86 89 93 96 99 99 99 105                           /* 40 ~ 49 */
                        110 115 120 125 130 135 140 145 149 149                    /* 50 ~ 59 */
                        149 155 162 168 175 182 188 195 202 206                 /* 60 ~ 69 */
                        210 215 215 215 223 231 239 248 257 266                 /* 70 ~ 79 */
                        275 282 290 300 300 300 310 320 330 340                 /* 80 ~ 89 */
                        350 360 370 380 390 412 424 436 447 460                 /* 90 ~ 99 */
                        472 484 496 503 510 515 520 524 524 524                 /* 100 ~ 109 */
                        536 548 560 572 584 596 608 620 632 644                 /* 110 ~ 119 */
                        666 666 666 682 698 714 730 746 762 778                 /* 120 ~ 129 */
                        794 810 828 828 828 846 862 878 896 914                 /* 130 ~ 139 */
                        930 950 970 992 1013 1013 1013 1033 1053 1075            /* 140 ~ 149 */
                        1096 1117 1140 1160 1180 1200 1219 1219 1219 1242       /* 150 ~ 159 */
                        1265 1283 1306 1329 1352 1375 1399 1410 1425 1449       /* 160 ~ 169 */
                        1449 1449 1475 1501 1527 1553 1579 1605 1631 1658       /* 170 ~ 179 */
                        1680 1703 1703 1703 1731 1759 1788 1808 1836 1852       /* 180 ~ 189 */
                        1890 1918 1950 1983 1983 1983 2014 2044 2073 2103       /* 190 ~ 199 */
                        2133 2166 2193 2223 2263 2292 2292 2292 2328 2354       /* 200 ~ 209 */
                        2390 2426 2450 2486 2522 2558 2594 2601 2629 2629       /* 210 ~ 219 */
                        2629 2665 2701 2737 2773 2809 2845 2881 2917 2953       /* 220 ~ 229 */
                        2990 2990 2990 3030 3070 3110 3150 3190 3240 3280       /* 230 ~ 239 */
                        3320 3350 3380 3380 3380 3422 3464 3506 3548 3590       /* 240 ~ 249 */
                        3630 3670 3710 3750 3775 3800>;
	};
};
