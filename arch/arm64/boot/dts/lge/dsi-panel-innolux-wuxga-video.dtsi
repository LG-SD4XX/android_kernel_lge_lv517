/* Copyright (c) 2014, Code Aurora Forum. All rights reserved.
 *
 * This program is free software; you can redistribute it and/or modify
 * it under the terms of the GNU General Public License version 2 and
 * only version 2 as published by the Free Software Foundation.
 *
 * This program is distributed in the hope that it will be useful,
 * but WITHOUT ANY WARRANTY; without even the implied warranty of
 * MERCHANTABILITY or FITNESS FOR A PARTICULAR PURPOSE.  See the
 * GNU General Public License for more details.
 */

&mdss_mdp {
	dsi_innolux_vid: qcom,mdss_dsi_innolux_nt51021_wuxga_video {
		compatible = "qcom,mdss-dsi-panel";
		qcom,mdss-dsi-panel-name = "innolux NT51021 wuxga video mode panel";
		qcom,mdss-dsi-panel-controller = <&mdss_dsi0>;
		qcom,mdss-dsi-panel-type = "dsi_video_mode";
		qcom,mdss-dsi-panel-destination = "display_1";
		qcom,mdss-dsi-panel-framerate = <60>;
		qcom,mdss-dsi-virtual-channel-id = <0>;
		qcom,mdss-dsi-stream = <0>;
		qcom,mdss-dsi-panel-width = <1200>;
		qcom,mdss-dsi-panel-height = <1920>;
		qcom,mdss-dsi-h-front-porch = <152>;
		qcom,mdss-dsi-h-back-porch = <52>;
		qcom,mdss-dsi-h-pulse-width = <4>;
		qcom,mdss-dsi-h-sync-skew = <0>;
		qcom,mdss-dsi-v-back-porch = <22>;
		qcom,mdss-dsi-v-front-porch = <28>;
		qcom,mdss-dsi-v-pulse-width = <1>;
		qcom,mdss-dsi-h-left-border = <0>;
		qcom,mdss-dsi-h-right-border = <0>;
		qcom,mdss-dsi-v-top-border = <0>;
		qcom,mdss-dsi-v-bottom-border = <0>;
		qcom,mdss-dsi-bpp = <24>;
		qcom,mdss-dsi-color-order = "rgb_swap_rgb";
		qcom,mdss-dsi-underflow-color = <0xff>;
		qcom,mdss-dsi-border-color = <0>;
		qcom,cont-splash-enabled;
		qcom,mdss-dsi-force-clock-lane-hs;
		qcom,mdss-dsi-on-command = [
			15 01 00 00 00 00 02 83 00
			15 01 00 00 00 00 02 84 00
			15 01 00 00 00 00 02 8C 04
			15 01 00 00 00 00 02 83 AA
			15 01 00 00 00 00 02 84 11
			15 01 00 00 00 00 02 A9 4B

			/* cabc still image mode */
			15 01 00 00 00 00 02 83 BB
			15 01 00 00 00 00 02 84 22
			15 01 00 00 00 00 02 90 40
			];

		qcom,mdss-dsi-off-command = [
			05 01 00 00 64 00 02 10 00
			];
		qcom,mdss-dsi-on-command-state = "dsi_lp_mode";
		qcom,mdss-dsi-off-command-state = "dsi_hs_mode";

		lge,pre-on-cmds-delay = <30>;

		lge,panel-cmd-state-lp = "dsi_lp_mode";
		lge,panel-cmd-state-hs = "dsi_hs_mode";

		lge,panel-cmd-fast-gamma-step1 = [
			// 34
			15 00 00 00 00 00 02 83 AA
			15 00 00 00 00 00 02 84 11
			//----R Gamma Register----
			15 00 00 00 00 00 02 C0 00
			15 00 00 00 00 00 02 C1 00
			15 00 00 00 00 00 02 C2 12
			15 00 00 00 00 00 02 C3 17
			15 00 00 00 00 00 02 C4 20
			15 00 00 00 00 00 02 C5 2E
			15 00 00 00 00 00 02 C6 39
			15 00 00 00 00 00 02 C7 42
			15 00 00 00 00 00 02 C8 48
			15 00 00 00 00 00 02 C9 9F
			15 00 00 00 00 00 02 CA A4
			15 00 00 00 00 00 02 CB C0
			15 00 00 00 00 00 02 CC D0
			15 00 00 00 00 00 02 CD DB
			15 00 00 00 00 00 02 CE DF
			15 00 00 00 00 00 02 CF E1
			15 00 00 00 00 00 02 D0 E7
			15 00 00 00 00 00 02 D1 FD
			15 00 00 00 00 00 02 D2 12
			15 00 00 00 00 00 02 D3 35
			15 00 00 00 00 00 02 D4 3F
			15 00 00 00 00 00 02 D5 A9
			15 00 00 00 00 00 02 D6 B1
			15 00 00 00 00 00 02 D7 BA
			15 00 00 00 00 00 02 D8 C3
			15 00 00 00 00 00 02 D9 CD
			15 00 00 00 00 00 02 DA D9
			15 00 00 00 00 00 02 DB E6
			15 00 00 00 00 00 02 DC F6
			15 00 00 00 00 00 02 DD FF
			15 00 00 00 00 00 02 DE 00
			15 01 00 00 00 00 02 DF 0E
			//34
			15 00 00 00 00 00 02 E0 00
			15 00 00 00 00 00 02 E1 00
			15 00 00 00 00 00 02 E2 12
			15 00 00 00 00 00 02 E3 17
			15 00 00 00 00 00 02 E4 20
			15 00 00 00 00 00 02 E5 2E
			15 00 00 00 00 00 02 E6 39
			15 00 00 00 00 00 02 E7 42
			15 00 00 00 00 00 02 E8 48
			15 00 00 00 00 00 02 E9 9F
			15 00 00 00 00 00 02 EA A4
			15 00 00 00 00 00 02 EB C0
			15 00 00 00 00 00 02 EC D0
			15 00 00 00 00 00 02 ED DB
			15 00 00 00 00 00 02 EE DF
			15 00 00 00 00 00 02 EF E1
			15 00 00 00 00 00 02 F0 E7
			15 00 00 00 00 00 02 F1 FD
			15 00 00 00 00 00 02 F2 12
			15 00 00 00 00 00 02 F3 35
			15 00 00 00 00 00 02 F4 3F
			15 00 00 00 00 00 02 F5 A9
			15 00 00 00 00 00 02 F6 B1
			15 00 00 00 00 00 02 F7 BA
			15 00 00 00 00 00 02 F8 C3
			15 00 00 00 00 00 02 F9 CD
			15 00 00 00 00 00 02 FA D9
			15 00 00 00 00 00 02 FB E6
			15 00 00 00 00 00 02 FC F6
			15 00 00 00 00 00 02 FD FF
			15 00 00 00 00 00 02 FE 00
			15 00 00 00 00 00 02 FF 0E
			//----G Gamma Registe G
			15 00 00 00 00 00 02 83 BB
			15 01 00 00 00 00 02 84 22
			//----G Gamma Registe G
			//32
			15 00 00 00 00 00 02 C0 00
			15 00 00 00 00 00 02 C1 08
			15 00 00 00 00 00 02 C2 0D
			15 00 00 00 00 00 02 C3 14
			15 00 00 00 00 00 02 C4 1B
			15 00 00 00 00 00 02 C5 23
			15 00 00 00 00 00 02 C6 2B
			15 00 00 00 00 00 02 C7 33
			15 00 00 00 00 00 02 C8 3B
			15 00 00 00 00 00 02 C9 8A
			15 00 00 00 00 00 02 CA 8F
			15 00 00 00 00 00 02 CB AC
			15 00 00 00 00 00 02 CC BD
			15 00 00 00 00 00 02 CD C5
			15 00 00 00 00 00 02 CE C3
			15 00 00 00 00 00 02 CF C5
			15 00 00 00 00 00 02 D0 C4
			15 00 00 00 00 00 02 D1 C8
			15 00 00 00 00 00 02 D2 D0
			15 00 00 00 00 00 02 D3 DD
			15 00 00 00 00 00 02 D4 D6
			15 00 00 00 00 00 02 D5 69
			15 00 00 00 00 00 02 D6 6D
			15 00 00 00 00 00 02 D7 71
			15 00 00 00 00 00 02 D8 75
			15 00 00 00 00 00 02 D9 79
			15 00 00 00 00 00 02 DA 7D
			15 00 00 00 00 00 02 DB 82
			15 00 00 00 00 00 02 DC 86
			15 00 00 00 00 00 02 DD 89
			15 00 00 00 00 00 02 DE 00
			15 01 00 00 00 00 02 DF 00
			//34
			15 00 00 00 00 00 02 E0 00
			15 00 00 00 00 00 02 E1 08
			15 00 00 00 00 00 02 E2 0D
			15 00 00 00 00 00 02 E3 14
			15 00 00 00 00 00 02 E4 1B
			15 00 00 00 00 00 02 E5 23
			15 00 00 00 00 00 02 E6 2B
			15 00 00 00 00 00 02 E7 33
			15 00 00 00 00 00 02 E8 3B
			15 00 00 00 00 00 02 E9 8A
			15 00 00 00 00 00 02 EA 8F
			15 00 00 00 00 00 02 EB AC
			15 00 00 00 00 00 02 EC BD
			15 00 00 00 00 00 02 ED C5
			15 00 00 00 00 00 02 EE C3
			15 00 00 00 00 00 02 EF C5
			15 00 00 00 00 00 02 F0 C4
			15 00 00 00 00 00 02 F1 C8
			15 00 00 00 00 00 02 F2 D0
			15 00 00 00 00 00 02 F3 DD
			15 00 00 00 00 00 02 F4 D6
			15 00 00 00 00 00 02 F5 69
			15 00 00 00 00 00 02 F6 6D
			15 00 00 00 00 00 02 F7 71
			15 00 00 00 00 00 02 F8 75
			15 00 00 00 00 00 02 F9 79
			15 00 00 00 00 00 02 FA 7D
			15 00 00 00 00 00 02 FB 82
			15 00 00 00 00 00 02 FC 86
			15 00 00 00 00 00 02 FD 89
			15 00 00 00 00 00 02 FE 00
			15 00 00 00 00 00 02 FF 00
			//change page 3
			15 00 00 00 00 00 02 83 CC
			15 01 00 00 00 00 02 84 33
			//----B Gamma Register---
			//32
			15 00 00 00 00 00 02 C0 00
			15 00 00 00 00 00 02 C1 00
			15 00 00 00 00 00 02 C2 0C
			15 00 00 00 00 00 02 C3 11
			15 00 00 00 00 00 02 C4 12
			15 00 00 00 00 00 02 C5 16
			15 00 00 00 00 00 02 C6 18
			15 00 00 00 00 00 02 C7 20
			15 00 00 00 00 00 02 C8 2B
			15 00 00 00 00 00 02 C9 78
			15 00 00 00 00 00 02 CA 82
			15 00 00 00 00 00 02 CB A2
			15 00 00 00 00 00 02 CC B3
			15 00 00 00 00 00 02 CD BB
			15 00 00 00 00 00 02 CE B8
			15 00 00 00 00 00 02 CF BA
			15 00 00 00 00 00 02 D0 B5
			15 00 00 00 00 00 02 D1 B4
			15 00 00 00 00 00 02 D2 B8
			15 00 00 00 00 00 02 D3 BF
			15 00 00 00 00 00 02 D4 B4
			15 00 00 00 00 00 02 D5 56
			15 00 00 00 00 00 02 D6 59
			15 00 00 00 00 00 02 D7 5C
			15 00 00 00 00 00 02 D8 5F
			15 00 00 00 00 00 02 D9 62
			15 00 00 00 00 00 02 DA 66
			15 00 00 00 00 00 02 DB 69
			15 00 00 00 00 00 02 DC 6C
			15 00 00 00 00 00 02 DD 6E
			15 00 00 00 00 00 02 DE 00
			15 01 00 00 00 00 02 DF 00
			//32
			15 00 00 00 00 00 02 E0 00
			15 00 00 00 00 00 02 E1 00
			15 00 00 00 00 00 02 E2 0C
			15 00 00 00 00 00 02 E3 11
			15 00 00 00 00 00 02 E4 12
			15 00 00 00 00 00 02 E5 16
			15 00 00 00 00 00 02 E6 18
			15 00 00 00 00 00 02 E7 20
			15 00 00 00 00 00 02 E8 2B
			15 00 00 00 00 00 02 E9 78
			15 00 00 00 00 00 02 EA 82
			15 00 00 00 00 00 02 EB A2
			15 00 00 00 00 00 02 EC B3
			15 00 00 00 00 00 02 ED BB
			15 00 00 00 00 00 02 EE B8
			15 00 00 00 00 00 02 EF BA
			15 00 00 00 00 00 02 F0 B5
			15 00 00 00 00 00 02 F1 B4
			15 00 00 00 00 00 02 F2 B8
			15 00 00 00 00 00 02 F3 BF
			15 00 00 00 00 00 02 F4 B4
			15 00 00 00 00 00 02 F5 56
			15 00 00 00 00 00 02 F6 59
			15 00 00 00 00 00 02 F7 5C
			15 00 00 00 00 00 02 F8 5F
			15 00 00 00 00 00 02 F9 62
			15 00 00 00 00 00 02 FA 66
			15 00 00 00 00 00 02 FB 69
			15 00 00 00 00 00 02 FC 6C
			15 00 00 00 00 00 02 FD 6E
			15 00 00 00 00 00 02 FE 00
			15 01 00 00 64 00 02 FF 00
			];
		lge,panel-cmd-fast-gamma-step2 = [
			//----B Gamma Register----
			//34
			15 00 00 00 00 00 02 83 AA
			15 00 00 00 00 00 02 84 11
			15 00 00 00 00 00 02 C0 00
			15 00 00 00 00 00 02 C1 00
			15 00 00 00 00 00 02 C2 12
			15 00 00 00 00 00 02 C3 17
			15 00 00 00 00 00 02 C4 1E
			15 00 00 00 00 00 02 C5 28
			15 00 00 00 00 00 02 C6 35
			15 00 00 00 00 00 02 C7 40
			15 00 00 00 00 00 02 C8 47
			15 00 00 00 00 00 02 C9 A0
			15 00 00 00 00 00 02 CA A8
			15 00 00 00 00 00 02 CB C1
			15 00 00 00 00 00 02 CC D0
			15 00 00 00 00 00 02 CD DB
			15 00 00 00 00 00 02 CE DF
			15 00 00 00 00 00 02 CF E1
			15 00 00 00 00 00 02 D0 E8
			15 00 00 00 00 00 02 D1 FD
			15 00 00 00 00 00 02 D2 12
			15 00 00 00 00 00 02 D3 35
			15 00 00 00 00 00 02 D4 3F
			15 00 00 00 00 00 02 D5 A9
			15 00 00 00 00 00 02 D6 B1
			15 00 00 00 00 00 02 D7 BA
			15 00 00 00 00 00 02 D8 C3
			15 00 00 00 00 00 02 D9 CD
			15 00 00 00 00 00 02 DA D9
			15 00 00 00 00 00 02 DB E6
			15 00 00 00 00 00 02 DC F6
			15 00 00 00 00 00 02 DD FF
			15 00 00 00 00 00 02 DE 00
			15 01 00 00 00 00 02 DF 0E
			//34
			15 00 00 00 00 00 02 E0 00
			15 00 00 00 00 00 02 E1 00
			15 00 00 00 00 00 02 E2 12
			15 00 00 00 00 00 02 E3 17
			15 00 00 00 00 00 02 E4 1E
			15 00 00 00 00 00 02 E5 28
			15 00 00 00 00 00 02 E6 35
			15 00 00 00 00 00 02 E7 40
			15 00 00 00 00 00 02 E8 47
			15 00 00 00 00 00 02 E9 A0
			15 00 00 00 00 00 02 EA A8
			15 00 00 00 00 00 02 EB C1
			15 00 00 00 00 00 02 EC D0
			15 00 00 00 00 00 02 ED DB
			15 00 00 00 00 00 02 EE DF
			15 00 00 00 00 00 02 EF E1
			15 00 00 00 00 00 02 F0 E8
			15 00 00 00 00 00 02 F1 FD
			15 00 00 00 00 00 02 F2 12
			15 00 00 00 00 00 02 F3 35
			15 00 00 00 00 00 02 F4 3F
			15 00 00 00 00 00 02 F5 A9
			15 00 00 00 00 00 02 F6 B1
			15 00 00 00 00 00 02 F7 BA
			15 00 00 00 00 00 02 F8 C3
			15 00 00 00 00 00 02 F9 CD
			15 00 00 00 00 00 02 FA D9
			15 00 00 00 00 00 02 FB E6
			15 00 00 00 00 00 02 FC F6
			15 00 00 00 00 00 02 FD FF
			15 00 00 00 00 00 02 FE 00
			15 00 00 00 00 00 02 FF 0E
			//----G Gamma Register---
			15 00 00 00 00 00 02 83 BB
			15 01 00 00 00 00 02 84 22
			//32
			15 00 00 00 00 00 02 C0 00
			15 00 00 00 00 00 02 C1 08
			15 00 00 00 00 00 02 C2 0C
			15 00 00 00 00 00 02 C3 13
			15 00 00 00 00 00 02 C4 19
			15 00 00 00 00 00 02 C5 21
			15 00 00 00 00 00 02 C6 2A
			15 00 00 00 00 00 02 C7 32
			15 00 00 00 00 00 02 C8 39
			15 00 00 00 00 00 02 C9 86
			15 00 00 00 00 00 02 CA 8E
			15 00 00 00 00 00 02 CB A8
			15 00 00 00 00 00 02 CC B9
			15 00 00 00 00 00 02 CD C0
			15 00 00 00 00 00 02 CE BD
			15 00 00 00 00 00 02 CF BF
			15 00 00 00 00 00 02 D0 BB
			15 00 00 00 00 00 02 D1 BC
			15 00 00 00 00 00 02 D2 C1
			15 00 00 00 00 00 02 D3 CB
			15 00 00 00 00 00 02 D4 C1
			15 00 00 00 00 00 02 D5 5D
			15 00 00 00 00 00 02 D6 61
			15 00 00 00 00 00 02 D7 64
			15 00 00 00 00 00 02 D8 68
			15 00 00 00 00 00 02 D9 6B
			15 00 00 00 00 00 02 DA 6F
			15 00 00 00 00 00 02 DB 73
			15 00 00 00 00 00 02 DC 77
			15 00 00 00 00 00 02 DD 79
			15 00 00 00 00 00 02 DE 00
			15 01 00 00 00 00 02 DF 00
			//34
			15 00 00 00 00 00 02 E0 00
			15 00 00 00 00 00 02 E1 08
			15 00 00 00 00 00 02 E2 0C
			15 00 00 00 00 00 02 E3 13
			15 00 00 00 00 00 02 E4 19
			15 00 00 00 00 00 02 E5 21
			15 00 00 00 00 00 02 E6 2A
			15 00 00 00 00 00 02 E7 32
			15 00 00 00 00 00 02 E8 39
			15 00 00 00 00 00 02 E9 86
			15 00 00 00 00 00 02 EA 8E
			15 00 00 00 00 00 02 EB A8
			15 00 00 00 00 00 02 EC B9
			15 00 00 00 00 00 02 ED C0
			15 00 00 00 00 00 02 EE BD
			15 00 00 00 00 00 02 EF BF
			15 00 00 00 00 00 02 F0 BB
			15 00 00 00 00 00 02 F1 BC
			15 00 00 00 00 00 02 F2 C1
			15 00 00 00 00 00 02 F3 CB
			15 00 00 00 00 00 02 F4 C1
			15 00 00 00 00 00 02 F5 5D
			15 00 00 00 00 00 02 F6 61
			15 00 00 00 00 00 02 F7 64
			15 00 00 00 00 00 02 F8 68
			15 00 00 00 00 00 02 F9 6B
			15 00 00 00 00 00 02 FA 6F
			15 00 00 00 00 00 02 FB 73
			15 00 00 00 00 00 02 FC 77
			15 00 00 00 00 00 02 FD 79
			15 00 00 00 00 00 02 FE 00
			15 00 00 00 00 00 02 FF 00
			//----R Gamma Register---
			15 00 00 00 00 00 02 83 CC
			15 01 00 00 00 00 02 84 33
			//32
			15 00 00 00 00 00 02 C0 00
			15 00 00 00 00 00 02 C1 00
			15 00 00 00 00 00 02 C2 0C
			15 00 00 00 00 00 02 C3 0E
			15 00 00 00 00 00 02 C4 0F
			15 00 00 00 00 00 02 C5 10
			15 00 00 00 00 00 02 C6 11
			15 00 00 00 00 00 02 C7 12
			15 00 00 00 00 00 02 C8 18
			15 00 00 00 00 00 02 C9 62
			15 00 00 00 00 00 02 CA 72
			15 00 00 00 00 00 02 CB 91
			15 00 00 00 00 00 02 CC A1
			15 00 00 00 00 00 02 CD A7
			15 00 00 00 00 00 02 CE A0
			15 00 00 00 00 00 02 CF A2
			15 00 00 00 00 00 02 D0 97
			15 00 00 00 00 00 02 D1 8D
			15 00 00 00 00 00 02 D2 89
			15 00 00 00 00 00 02 D3 88
			15 00 00 00 00 00 02 D4 78
			15 00 00 00 00 00 02 D5 35
			15 00 00 00 00 00 02 D6 37
			15 00 00 00 00 00 02 D7 39
			15 00 00 00 00 00 02 D8 3B
			15 00 00 00 00 00 02 D9 3E
			15 00 00 00 00 00 02 DA 40
			15 00 00 00 00 00 02 DB 42
			15 00 00 00 00 00 02 DC 45
			15 00 00 00 00 00 02 DD 46
			15 00 00 00 00 00 02 DE 00
			15 01 00 00 00 00 02 DF 00
			//32
			15 00 00 00 00 00 02 E0 00
			15 00 00 00 00 00 02 E1 00
			15 00 00 00 00 00 02 E2 0C
			15 00 00 00 00 00 02 E3 0E
			15 00 00 00 00 00 02 E4 0F
			15 00 00 00 00 00 02 E5 10
			15 00 00 00 00 00 02 E6 11
			15 00 00 00 00 00 02 E7 12
			15 00 00 00 00 00 02 E8 18
			15 00 00 00 00 00 02 E9 62
			15 00 00 00 00 00 02 EA 72
			15 00 00 00 00 00 02 EB 91
			15 00 00 00 00 00 02 EC A1
			15 00 00 00 00 00 02 ED A7
			15 00 00 00 00 00 02 EE A0
			15 00 00 00 00 00 02 EF A2
			15 00 00 00 00 00 02 F0 97
			15 00 00 00 00 00 02 F1 8D
			15 00 00 00 00 00 02 F2 89
			15 00 00 00 00 00 02 F3 88
			15 00 00 00 00 00 02 F4 78
			15 00 00 00 00 00 02 F5 35
			15 00 00 00 00 00 02 F6 37
			15 00 00 00 00 00 02 F7 39
			15 00 00 00 00 00 02 F8 3B
			15 00 00 00 00 00 02 F9 3E
			15 00 00 00 00 00 02 FA 40
			15 00 00 00 00 00 02 FB 42
			15 00 00 00 00 00 02 FC 45
			15 00 00 00 00 00 02 FD 46
			15 00 00 00 00 00 02 FE 00
			15 01 00 00 64 00 02 FF 00
			];
		lge,panel-cmd-fast-gamma-mono = [
			15 00 00 00 00 00 02 83 CC
			15 00 00 00 00 00 02 84 33
			15 00 00 00 00 00 02 91 C0	//Level 13
			15 00 00 00 00 00 02 90 11	//CE ON

			//----B Gamma Register----
			//34
			15 00 00 00 00 00 02 83 AA
			15 00 00 00 00 00 02 84 11
			15 00 00 00 00 00 02 C0 00
			15 00 00 00 00 00 02 C1 00
			15 00 00 00 00 00 02 C2 12
			15 00 00 00 00 00 02 C3 17
			15 00 00 00 00 00 02 C4 1E
			15 00 00 00 00 00 02 C5 28
			15 00 00 00 00 00 02 C6 35
			15 00 00 00 00 00 02 C7 40
			15 00 00 00 00 00 02 C8 47
			15 00 00 00 00 00 02 C9 A0
			15 00 00 00 00 00 02 CA A8
			15 00 00 00 00 00 02 CB C1
			15 00 00 00 00 00 02 CC D0
			15 00 00 00 00 00 02 CD DB
			15 00 00 00 00 00 02 CE DF
			15 00 00 00 00 00 02 CF E1
			15 00 00 00 00 00 02 D0 E8
			15 00 00 00 00 00 02 D1 FD
			15 00 00 00 00 00 02 D2 12
			15 00 00 00 00 00 02 D3 35
			15 00 00 00 00 00 02 D4 3F
			15 00 00 00 00 00 02 D5 A9
			15 00 00 00 00 00 02 D6 B1
			15 00 00 00 00 00 02 D7 BA
			15 00 00 00 00 00 02 D8 C3
			15 00 00 00 00 00 02 D9 CD
			15 00 00 00 00 00 02 DA D9
			15 00 00 00 00 00 02 DB E6
			15 00 00 00 00 00 02 DC F6
			15 00 00 00 00 00 02 DD FF
			15 00 00 00 00 00 02 DE 00
			15 01 00 00 00 00 02 DF 0E
			//34

			15 00 00 00 00 00 02 83 CC
			15 00 00 00 00 00 02 84 33
			15 00 00 00 00 00 02 91 D7	//Level 23

			15 00 00 00 00 00 02 83 AA
			15 00 00 00 00 00 02 84 11

			15 00 00 00 00 00 02 E0 00
			15 00 00 00 00 00 02 E1 00
			15 00 00 00 00 00 02 E2 12
			15 00 00 00 00 00 02 E3 17
			15 00 00 00 00 00 02 E4 1E
			15 00 00 00 00 00 02 E5 28
			15 00 00 00 00 00 02 E6 35
			15 00 00 00 00 00 02 E7 40
			15 00 00 00 00 00 02 E8 47
			15 00 00 00 00 00 02 E9 A0
			15 00 00 00 00 00 02 EA A8
			15 00 00 00 00 00 02 EB C1
			15 00 00 00 00 00 02 EC D0
			15 00 00 00 00 00 02 ED DB
			15 00 00 00 00 00 02 EE DF
			15 00 00 00 00 00 02 EF E1
			15 00 00 00 00 00 02 F0 E8
			15 00 00 00 00 00 02 F1 FD
			15 00 00 00 00 00 02 F2 12
			15 00 00 00 00 00 02 F3 35
			15 00 00 00 00 00 02 F4 3F
			15 00 00 00 00 00 02 F5 A9
			15 00 00 00 00 00 02 F6 B1
			15 00 00 00 00 00 02 F7 BA
			15 00 00 00 00 00 02 F8 C3
			15 00 00 00 00 00 02 F9 CD
			15 00 00 00 00 00 02 FA D9
			15 00 00 00 00 00 02 FB E6
			15 00 00 00 00 00 02 FC F6
			15 00 00 00 00 00 02 FD FF
			15 00 00 00 00 00 02 FE 00
			15 00 00 00 00 00 02 FF 0E

			15 00 00 00 00 00 02 83 CC
			15 00 00 00 00 00 02 84 33
			15 01 00 00 00 00 02 91 E1	//Level 33

			//----G Gamma Register---
			15 00 00 00 00 00 02 83 BB
			15 00 00 00 00 00 02 84 22
			//32

			15 00 00 00 00 00 02 C0 00
			15 00 00 00 00 00 02 C1 08
			15 00 00 00 00 00 02 C2 0C
			15 00 00 00 00 00 02 C3 13
			15 00 00 00 00 00 02 C4 19
			15 00 00 00 00 00 02 C5 21
			15 00 00 00 00 00 02 C6 2A
			15 00 00 00 00 00 02 C7 32
			15 00 00 00 00 00 02 C8 39
			15 00 00 00 00 00 02 C9 86
			15 00 00 00 00 00 02 CA 8E
			15 00 00 00 00 00 02 CB A8
			15 00 00 00 00 00 02 CC B9
			15 00 00 00 00 00 02 CD C0
			15 00 00 00 00 00 02 CE BD
			15 00 00 00 00 00 02 CF BF
			15 00 00 00 00 00 02 D0 BB
			15 00 00 00 00 00 02 D1 BC
			15 00 00 00 00 00 02 D2 C1
			15 00 00 00 00 00 02 D3 CB
			15 00 00 00 00 00 02 D4 C1
			15 00 00 00 00 00 02 D5 5D
			15 00 00 00 00 00 02 D6 61
			15 00 00 00 00 00 02 D7 64
			15 00 00 00 00 00 02 D8 68
			15 00 00 00 00 00 02 D9 6B
			15 00 00 00 00 00 02 DA 6F
			15 00 00 00 00 00 02 DB 73
			15 00 00 00 00 00 02 DC 77
			15 00 00 00 00 00 02 DD 79
			15 00 00 00 00 00 02 DE 00
			15 00 00 00 00 00 02 DF 00
			//34

			15 00 00 00 00 00 02 83 CC
			15 00 00 00 00 00 02 84 33
			15 01 00 00 00 00 02 91 EB	//Level 43

			15 00 00 00 00 00 02 83 BB
			15 00 00 00 00 00 02 84 22

			15 00 00 00 00 00 02 E0 00
			15 00 00 00 00 00 02 E1 08
			15 00 00 00 00 00 02 E2 0C
			15 00 00 00 00 00 02 E3 13
			15 00 00 00 00 00 02 E4 19
			15 00 00 00 00 00 02 E5 21
			15 00 00 00 00 00 02 E6 2A
			15 00 00 00 00 00 02 E7 32
			15 00 00 00 00 00 02 E8 39
			15 00 00 00 00 00 02 E9 86
			15 00 00 00 00 00 02 EA 8E
			15 00 00 00 00 00 02 EB A8
			15 00 00 00 00 00 02 EC B9
			15 00 00 00 00 00 02 ED C0
			15 00 00 00 00 00 02 EE BD
			15 00 00 00 00 00 02 EF BF
			15 00 00 00 00 00 02 F0 BB
			15 00 00 00 00 00 02 F1 BC
			15 00 00 00 00 00 02 F2 C1
			15 00 00 00 00 00 02 F3 CB
			15 00 00 00 00 00 02 F4 C1
			15 00 00 00 00 00 02 F5 5D
			15 00 00 00 00 00 02 F6 61
			15 00 00 00 00 00 02 F7 64
			15 00 00 00 00 00 02 F8 68
			15 00 00 00 00 00 02 F9 6B
			15 00 00 00 00 00 02 FA 6F
			15 00 00 00 00 00 02 FB 73
			15 00 00 00 00 00 02 FC 77
			15 00 00 00 00 00 02 FD 79
			15 00 00 00 00 00 02 FE 00
			15 00 00 00 00 00 02 FF 00
			//----R Gamma Register---
			//15 00 00 00 00 00 02 83 CC
			//15 01 00 00 00 00 02 84 33
			//32

			15 00 00 00 00 00 02 83 CC
			15 00 00 00 00 00 02 84 33
			15 01 00 00 00 00 02 91 F5	//Level 53

			15 00 00 00 00 00 02 C0 00
			15 00 00 00 00 00 02 C1 00
			15 00 00 00 00 00 02 C2 0C
			15 00 00 00 00 00 02 C3 0E
			15 00 00 00 00 00 02 C4 0F
			15 00 00 00 00 00 02 C5 10
			15 00 00 00 00 00 02 C6 11
			15 00 00 00 00 00 02 C7 12
			15 00 00 00 00 00 02 C8 18
			15 00 00 00 00 00 02 C9 62
			15 00 00 00 00 00 02 CA 72
			15 00 00 00 00 00 02 CB 91
			15 00 00 00 00 00 02 CC A1
			15 00 00 00 00 00 02 CD A7
			15 00 00 00 00 00 02 CE A0
			15 00 00 00 00 00 02 CF A2
			15 00 00 00 00 00 02 D0 97
			15 00 00 00 00 00 02 D1 8D
			15 00 00 00 00 00 02 D2 89
			15 00 00 00 00 00 02 D3 88
			15 00 00 00 00 00 02 D4 78
			15 00 00 00 00 00 02 D5 35
			15 00 00 00 00 00 02 D6 37
			15 00 00 00 00 00 02 D7 39
			15 00 00 00 00 00 02 D8 3B
			15 00 00 00 00 00 02 D9 3E
			15 00 00 00 00 00 02 DA 40
			15 00 00 00 00 00 02 DB 42
			15 00 00 00 00 00 02 DC 45
			15 00 00 00 00 00 02 DD 46
			15 00 00 00 00 00 02 DE 00
			15 01 00 00 00 00 02 DF 00
			//32

			15 00 00 00 00 00 02 83 CC
			15 00 00 00 00 00 02 84 33
			15 00 00 00 00 00 02 91 FF	//Level 63

			15 00 00 00 00 00 02 E0 00
			15 00 00 00 00 00 02 E1 00
			15 00 00 00 00 00 02 E2 0C
			15 00 00 00 00 00 02 E3 0E
			15 00 00 00 00 00 02 E4 0F
			15 00 00 00 00 00 02 E5 10
			15 00 00 00 00 00 02 E6 11
			15 00 00 00 00 00 02 E7 12
			15 00 00 00 00 00 02 E8 18
			15 00 00 00 00 00 02 E9 62
			15 00 00 00 00 00 02 EA 72
			15 00 00 00 00 00 02 EB 91
			15 00 00 00 00 00 02 EC A1
			15 00 00 00 00 00 02 ED A7
			15 00 00 00 00 00 02 EE A0
			15 00 00 00 00 00 02 EF A2
			15 00 00 00 00 00 02 F0 97
			15 00 00 00 00 00 02 F1 8D
			15 00 00 00 00 00 02 F2 89
			15 00 00 00 00 00 02 F3 88
			15 00 00 00 00 00 02 F4 78
			15 00 00 00 00 00 02 F5 35
			15 00 00 00 00 00 02 F6 37
			15 00 00 00 00 00 02 F7 39
			15 00 00 00 00 00 02 F8 3B
			15 00 00 00 00 00 02 F9 3E
			15 00 00 00 00 00 02 FA 40
			15 00 00 00 00 00 02 FB 42
			15 00 00 00 00 00 02 FC 45
			15 00 00 00 00 00 02 FD 46
			15 00 00 00 00 00 02 FE 00
			15 01 00 00 64 00 02 FF 00
			];
		lge,panel-cmd-fast-gamma-step3 = [
			//----B Gamma Register----
			//34
			15 00 00 00 00 00 02 83 AA
			15 00 00 00 00 00 02 84 11
			15 00 00 00 00 00 02 C0 00
			15 00 00 00 00 00 02 C1 00
			15 00 00 00 00 00 02 C2 12
			15 00 00 00 00 00 02 C3 17
			15 00 00 00 00 00 02 C4 1E
			15 00 00 00 00 00 02 C5 26
			15 00 00 00 00 00 02 C6 2F
			15 00 00 00 00 00 02 C7 38
			15 00 00 00 00 00 02 C8 41
			15 00 00 00 00 00 02 C9 98
			15 00 00 00 00 00 02 CA A1
			15 00 00 00 00 00 02 CB C0
			15 00 00 00 00 00 02 CC D0
			15 00 00 00 00 00 02 CD DB
			15 00 00 00 00 00 02 CE DF
			15 00 00 00 00 00 02 CF E1
			15 00 00 00 00 00 02 D0 E7
			15 00 00 00 00 00 02 D1 FD
			15 00 00 00 00 00 02 D2 12
			15 00 00 00 00 00 02 D3 35
			15 00 00 00 00 00 02 D4 3F
			15 00 00 00 00 00 02 D5 A9
			15 00 00 00 00 00 02 D6 B1
			15 00 00 00 00 00 02 D7 BA
			15 00 00 00 00 00 02 D8 C3
			15 00 00 00 00 00 02 D9 CD
			15 00 00 00 00 00 02 DA D9
			15 00 00 00 00 00 02 DB E6
			15 00 00 00 00 00 02 DC F6
			15 00 00 00 00 00 02 DD FF
			15 00 00 00 00 00 02 DE 00
			15 01 00 00 00 00 02 DF 0E
			//34
			15 00 00 00 00 00 02 E0 00
			15 00 00 00 00 00 02 E1 00
			15 00 00 00 00 00 02 E2 12
			15 00 00 00 00 00 02 E3 17
			15 00 00 00 00 00 02 E4 1E
			15 00 00 00 00 00 02 E5 26
			15 00 00 00 00 00 02 E6 2F
			15 00 00 00 00 00 02 E7 38
			15 00 00 00 00 00 02 E8 41
			15 00 00 00 00 00 02 E9 98
			15 00 00 00 00 00 02 EA A1
			15 00 00 00 00 00 02 EB C0
			15 00 00 00 00 00 02 EC D0
			15 00 00 00 00 00 02 ED DB
			15 00 00 00 00 00 02 EE DF
			15 00 00 00 00 00 02 EF E1
			15 00 00 00 00 00 02 F0 E7
			15 00 00 00 00 00 02 F1 FD
			15 00 00 00 00 00 02 F2 12
			15 00 00 00 00 00 02 F3 35
			15 00 00 00 00 00 02 F4 3F
			15 00 00 00 00 00 02 F5 A9
			15 00 00 00 00 00 02 F6 B1
			15 00 00 00 00 00 02 F7 BA
			15 00 00 00 00 00 02 F8 C3
			15 00 00 00 00 00 02 F9 CD
			15 00 00 00 00 00 02 FA D9
			15 00 00 00 00 00 02 FB E6
			15 00 00 00 00 00 02 FC F6
			15 00 00 00 00 00 02 FD FF
			15 00 00 00 00 00 02 FE 00
			15 00 00 00 00 00 02 FF 0E
			//----G Gamma Register---
			15 00 00 00 00 00 02 83 BB
			15 01 00 00 00 00 02 84 22
			//32
			15 00 00 00 00 00 02 C0 00
			15 00 00 00 00 00 02 C1 07
			15 00 00 00 00 00 02 C2 0C
			15 00 00 00 00 00 02 C3 13
			15 00 00 00 00 00 02 C4 1A
			15 00 00 00 00 00 02 C5 22
			15 00 00 00 00 00 02 C6 29
			15 00 00 00 00 00 02 C7 31
			15 00 00 00 00 00 02 C8 39
			15 00 00 00 00 00 02 C9 85
			15 00 00 00 00 00 02 CA 8C
			15 00 00 00 00 00 02 CB A8
			15 00 00 00 00 00 02 CC B7
			15 00 00 00 00 00 02 CD BE
			15 00 00 00 00 00 02 CE BB
			15 00 00 00 00 00 02 CF BC
			15 00 00 00 00 00 02 D0 B7
			15 00 00 00 00 00 02 D1 B6
			15 00 00 00 00 00 02 D2 BA
			15 00 00 00 00 00 02 D3 C2
			15 00 00 00 00 00 02 D4 B8
			15 00 00 00 00 00 02 D5 58
			15 00 00 00 00 00 02 D6 5B
			15 00 00 00 00 00 02 D7 5E
			15 00 00 00 00 00 02 D8 62
			15 00 00 00 00 00 02 D9 65
			15 00 00 00 00 00 02 DA 69
			15 00 00 00 00 00 02 DB 6C
			15 00 00 00 00 00 02 DC 70
			15 00 00 00 00 00 02 DD 72
			15 00 00 00 00 00 02 DE 00
			15 01 00 00 00 00 02 DF 00
			//34
			15 00 00 00 00 00 02 E0 00
			15 00 00 00 00 00 02 E1 07
			15 00 00 00 00 00 02 E2 0C
			15 00 00 00 00 00 02 E3 13
			15 00 00 00 00 00 02 E4 1A
			15 00 00 00 00 00 02 E5 22
			15 00 00 00 00 00 02 E6 29
			15 00 00 00 00 00 02 E7 31
			15 00 00 00 00 00 02 E8 39
			15 00 00 00 00 00 02 E9 85
			15 00 00 00 00 00 02 EA 8C
			15 00 00 00 00 00 02 EB A8
			15 00 00 00 00 00 02 EC B7
			15 00 00 00 00 00 02 ED BE
			15 00 00 00 00 00 02 EE BB
			15 00 00 00 00 00 02 EF BC
			15 00 00 00 00 00 02 F0 B7
			15 00 00 00 00 00 02 F1 B6
			15 00 00 00 00 00 02 F2 BA
			15 00 00 00 00 00 02 F3 C2
			15 00 00 00 00 00 02 F4 B8
			15 00 00 00 00 00 02 F5 58
			15 00 00 00 00 00 02 F6 5B
			15 00 00 00 00 00 02 F7 5E
			15 00 00 00 00 00 02 F8 62
			15 00 00 00 00 00 02 F9 65
			15 00 00 00 00 00 02 FA 69
			15 00 00 00 00 00 02 FB 6C
			15 00 00 00 00 00 02 FC 70
			15 00 00 00 00 00 02 FD 72
			15 00 00 00 00 00 02 FE 00
			15 00 00 00 00 00 02 FF 00
			//----R Gamma Register---
			15 00 00 00 00 00 02 83 CC
			15 01 00 00 00 00 02 84 33
			//32
			15 00 00 00 00 00 02 C0 00
			15 00 00 00 00 00 02 C1 00
			15 00 00 00 00 00 02 C2 0C
			15 00 00 00 00 00 02 C3 0F
			15 00 00 00 00 00 02 C4 14
			15 00 00 00 00 00 02 C5 1C
			15 00 00 00 00 00 02 C6 20
			15 00 00 00 00 00 02 C7 22
			15 00 00 00 00 00 02 C8 23
			15 00 00 00 00 00 02 C9 48
			15 00 00 00 00 00 02 CA 5F
			15 00 00 00 00 00 02 CB 86
			15 00 00 00 00 00 02 CC 98
			15 00 00 00 00 00 02 CD 9E
			15 00 00 00 00 00 02 CE 96
			15 00 00 00 00 00 02 CF 98
			15 00 00 00 00 00 02 D0 8A
			15 00 00 00 00 00 02 D1 7D
			15 00 00 00 00 00 02 D2 77
			15 00 00 00 00 00 02 D3 73
			15 00 00 00 00 00 02 D4 62
			15 00 00 00 00 00 02 D5 28
			15 00 00 00 00 00 02 D6 2A
			15 00 00 00 00 00 02 D7 2C
			15 00 00 00 00 00 02 D8 2E
			15 00 00 00 00 00 02 D9 30
			15 00 00 00 00 00 02 DA 32
			15 00 00 00 00 00 02 DB 35
			15 00 00 00 00 00 02 DC 37
			15 00 00 00 00 00 02 DD 38
			15 00 00 00 00 00 02 DE 00
			15 01 00 00 00 00 02 DF 00
			//32
			15 00 00 00 00 00 02 E0 00
			15 00 00 00 00 00 02 E1 00
			15 00 00 00 00 00 02 E2 0C
			15 00 00 00 00 00 02 E3 0F
			15 00 00 00 00 00 02 E4 14
			15 00 00 00 00 00 02 E5 1C
			15 00 00 00 00 00 02 E6 20
			15 00 00 00 00 00 02 E7 22
			15 00 00 00 00 00 02 E8 23
			15 00 00 00 00 00 02 E9 48
			15 00 00 00 00 00 02 EA 5F
			15 00 00 00 00 00 02 EB 86
			15 00 00 00 00 00 02 EC 98
			15 00 00 00 00 00 02 ED 9E
			15 00 00 00 00 00 02 EE 96
			15 00 00 00 00 00 02 EF 98
			15 00 00 00 00 00 02 F0 8A
			15 00 00 00 00 00 02 F1 7D
			15 00 00 00 00 00 02 F2 77
			15 00 00 00 00 00 02 F3 73
			15 00 00 00 00 00 02 F4 62
			15 00 00 00 00 00 02 F5 28
			15 00 00 00 00 00 02 F6 2A
			15 00 00 00 00 00 02 F7 2C
			15 00 00 00 00 00 02 F8 2E
			15 00 00 00 00 00 02 F9 30
			15 00 00 00 00 00 02 FA 32
			15 00 00 00 00 00 02 FB 35
			15 00 00 00 00 00 02 FC 37
			15 00 00 00 00 00 02 FD 38
			15 00 00 00 00 00 02 FE 00
			15 01 00 00 64 00 02 FF 00
			];
		lge,panel-cmd-fast-gamma-dft = [
			//34
			//change page1
			15 00 00 00 00 00 02 83 AA
			15 00 00 00 00 00 02 84 11
			//----R Gamma Register----
			15 00 00 00 00 00 02 C0 00
			15 00 00 00 00 00 02 C1 0F
			15 00 00 00 00 00 02 C2 17
			15 00 00 00 00 00 02 C3 23
			15 00 00 00 00 00 02 C4 32
			15 00 00 00 00 00 02 C5 3C
			15 00 00 00 00 00 02 C6 45
			15 00 00 00 00 00 02 C7 4E
			15 00 00 00 00 00 02 C8 56
			15 00 00 00 00 00 02 C9 BC
			15 00 00 00 00 00 02 CA C4
			15 00 00 00 00 00 02 CB DF
			15 00 00 00 00 00 02 CC EB
			15 00 00 00 00 00 02 CD F3
			15 00 00 00 00 00 02 CE F5
			15 00 00 00 00 00 02 CF F7
			15 00 00 00 00 00 02 D0 FD
			15 00 00 00 00 00 02 D1 11
			15 00 00 00 00 00 02 D2 25
			15 00 00 00 00 00 02 D3 46
			15 00 00 00 00 00 02 D4 4E
			15 00 00 00 00 00 02 D5 B0
			15 00 00 00 00 00 02 D6 B7
			15 00 00 00 00 00 02 D7 BF
			15 00 00 00 00 00 02 D8 C8
			15 00 00 00 00 00 02 D9 D2
			15 00 00 00 00 00 02 DA DC
			15 00 00 00 00 00 02 DB E9
			15 00 00 00 00 00 02 DC F7
			15 00 00 00 00 00 02 DD FF
			15 00 00 00 00 00 02 DE 00
			15 01 00 00 00 00 02 DF 0F

			//34
			15 00 00 00 00 00 02 E0 00
			15 00 00 00 00 00 02 E1 0F
			15 00 00 00 00 00 02 E2 17
			15 00 00 00 00 00 02 E3 23
			15 00 00 00 00 00 02 E4 32
			15 00 00 00 00 00 02 E5 3C
			15 00 00 00 00 00 02 E6 45
			15 00 00 00 00 00 02 E7 4E
			15 00 00 00 00 00 02 E8 56
			15 00 00 00 00 00 02 E9 BC
			15 00 00 00 00 00 02 EA C4
			15 00 00 00 00 00 02 EB DF
			15 00 00 00 00 00 02 EC EB
			15 00 00 00 00 00 02 ED F3
			15 00 00 00 00 00 02 EE F5
			15 00 00 00 00 00 02 EF F7
			15 00 00 00 00 00 02 F0 FD
			15 00 00 00 00 00 02 F1 11
			15 00 00 00 00 00 02 F2 25
			15 00 00 00 00 00 02 F3 46
			15 00 00 00 00 00 02 F4 4E
			15 00 00 00 00 00 02 F5 B0
			15 00 00 00 00 00 02 F6 B7
			15 00 00 00 00 00 02 F7 BF
			15 00 00 00 00 00 02 F8 C8
			15 00 00 00 00 00 02 F9 D2
			15 00 00 00 00 00 02 FA DC
			15 00 00 00 00 00 02 FB E9
			15 00 00 00 00 00 02 FC F7
			15 00 00 00 00 00 02 FD FF
			15 00 00 00 00 00 02 FE 00
			15 00 00 00 00 00 02 FF 0F
			//change page 2
			15 00 00 00 00 00 02 83 BB
			15 01 00 00 00 00 02 84 22
			//----G Gamma Register----
			//32
			15 00 00 00 00 00 02 C0 00
			15 00 00 00 00 00 02 C1 0A
			15 00 00 00 00 00 02 C2 16
			15 00 00 00 00 00 02 C3 22
			15 00 00 00 00 00 02 C4 2E
			15 00 00 00 00 00 02 C5 3A
			15 00 00 00 00 00 02 C6 44
			15 00 00 00 00 00 02 C7 4D
			15 00 00 00 00 00 02 C8 55
			15 00 00 00 00 00 02 C9 BA
			15 00 00 00 00 00 02 CA C1
			15 00 00 00 00 00 02 CB DF
			15 00 00 00 00 00 02 CC EB
			15 00 00 00 00 00 02 CD F3
			15 00 00 00 00 00 02 CE F6
			15 00 00 00 00 00 02 CF F8
			15 00 00 00 00 00 02 D0 FE
			15 00 00 00 00 00 02 D1 13
			15 00 00 00 00 00 02 D2 27
			15 00 00 00 00 00 02 D3 48
			15 00 00 00 00 00 02 D4 51
			15 00 00 00 00 00 02 D5 B1
			15 00 00 00 00 00 02 D6 B9
			15 00 00 00 00 00 02 D7 C1
			15 00 00 00 00 00 02 D8 C9
			15 00 00 00 00 00 02 D9 D2
			15 00 00 00 00 00 02 DA DD
			15 00 00 00 00 00 02 DB E9
			15 00 00 00 00 00 02 DC F7
			15 00 00 00 00 00 02 DD FF
			15 00 00 00 00 00 02 DE 00
			15 01 00 00 00 00 02 DF 0F
			//34
			15 00 00 00 00 00 02 E0 00
			15 00 00 00 00 00 02 E1 0A
			15 00 00 00 00 00 02 E2 16
			15 00 00 00 00 00 02 E3 22
			15 00 00 00 00 00 02 E4 2E
			15 00 00 00 00 00 02 E5 3A
			15 00 00 00 00 00 02 E6 44
			15 00 00 00 00 00 02 E7 4D
			15 00 00 00 00 00 02 E8 55
			15 00 00 00 00 00 02 E9 BA
			15 00 00 00 00 00 02 EA C1
			15 00 00 00 00 00 02 EB DF
			15 00 00 00 00 00 02 EC EB
			15 00 00 00 00 00 02 ED F3
			15 00 00 00 00 00 02 EE F6
			15 00 00 00 00 00 02 EF F8
			15 00 00 00 00 00 02 F0 FE
			15 00 00 00 00 00 02 F1 13
			15 00 00 00 00 00 02 F2 27
			15 00 00 00 00 00 02 F3 48
			15 00 00 00 00 00 02 F4 51
			15 00 00 00 00 00 02 F5 B1
			15 00 00 00 00 00 02 F6 B9
			15 00 00 00 00 00 02 F7 C1
			15 00 00 00 00 00 02 F8 C9
			15 00 00 00 00 00 02 F9 D2
			15 00 00 00 00 00 02 FA DD
			15 00 00 00 00 00 02 FB E9
			15 00 00 00 00 00 02 FC F7
			15 00 00 00 00 00 02 FD FF
			15 00 00 00 00 00 02 FE 00
			15 00 00 00 00 00 02 FF 0F
			//change page 3
			15 00 00 00 00 00 02 83 CC
			15 01 00 00 00 00 02 84 33
			//----B Gamma Register----
			//32
			15 00 00 00 00 00 02 C0 00
			15 00 00 00 00 00 02 C1 0B
			15 00 00 00 00 00 02 C2 12
			15 00 00 00 00 00 02 C3 15
			15 00 00 00 00 00 02 C4 22
			15 00 00 00 00 00 02 C5 31
			15 00 00 00 00 00 02 C6 3D
			15 00 00 00 00 00 02 C7 48
			15 00 00 00 00 00 02 C8 51
			15 00 00 00 00 00 02 C9 B7
			15 00 00 00 00 00 02 CA C0
			15 00 00 00 00 00 02 CB DE
			15 00 00 00 00 00 02 CC EB
			15 00 00 00 00 00 02 CD F4
			15 00 00 00 00 00 02 CE F8
			15 00 00 00 00 00 02 CF FA
			15 00 00 00 00 00 02 D0 01
			15 00 00 00 00 00 02 D1 17
			15 00 00 00 00 00 02 D2 2C
			15 00 00 00 00 00 02 D3 4C
			15 00 00 00 00 00 02 D4 54
			15 00 00 00 00 00 02 D5 B1
			15 00 00 00 00 00 02 D6 B8
			15 00 00 00 00 00 02 D7 C0
			15 00 00 00 00 00 02 D8 C7
			15 00 00 00 00 00 02 D9 D0
			15 00 00 00 00 00 02 DA D9
			15 00 00 00 00 00 02 DB E3
			15 00 00 00 00 00 02 DC EF
			15 00 00 00 00 00 02 DD F5
			15 00 00 00 00 00 02 DE 80
			15 01 00 00 00 00 02 DF 0F

			//32
			15 00 00 00 00 00 02 E0 00
			15 00 00 00 00 00 02 E1 0B
			15 00 00 00 00 00 02 E2 12
			15 00 00 00 00 00 02 E3 15
			15 00 00 00 00 00 02 E4 22
			15 00 00 00 00 00 02 E5 31
			15 00 00 00 00 00 02 E6 3D
			15 00 00 00 00 00 02 E7 48
			15 00 00 00 00 00 02 E8 51
			15 00 00 00 00 00 02 E9 B7
			15 00 00 00 00 00 02 EA C0
			15 00 00 00 00 00 02 EB DE
			15 00 00 00 00 00 02 EC EB
			15 00 00 00 00 00 02 ED F4
			15 00 00 00 00 00 02 EE F8
			15 00 00 00 00 00 02 EF FA
			15 00 00 00 00 00 02 F0 01
			15 00 00 00 00 00 02 F1 17
			15 00 00 00 00 00 02 F2 2C
			15 00 00 00 00 00 02 F3 4C
			15 00 00 00 00 00 02 F4 54
			15 00 00 00 00 00 02 F5 B1
			15 00 00 00 00 00 02 F6 B8
			15 00 00 00 00 00 02 F7 C0
			15 00 00 00 00 00 02 F8 C7
			15 00 00 00 00 00 02 F9 D0
			15 00 00 00 00 00 02 FA D9
			15 00 00 00 00 00 02 FB E3
			15 00 00 00 00 00 02 FC EF
			15 00 00 00 00 00 02 FD F5
			15 00 00 00 00 00 02 FE 80
			15 01 00 00 64 00 02 FF 0F
			];
		lge,panel-cmd-fast-gamma-mtd = [
			15 00 00 00 00 00 02 83 CC
			15 00 00 00 00 00 02 84 33
			15 00 00 00 00 00 02 91 F5	//Level 53

			//34
			//change page1
			15 00 00 00 00 00 02 83 AA
			15 00 00 00 00 00 02 84 11
			//----R Gamma Register----
			15 00 00 00 00 00 02 C0 00
			15 00 00 00 00 00 02 C1 0F
			15 00 00 00 00 00 02 C2 17
			15 00 00 00 00 00 02 C3 23
			15 00 00 00 00 00 02 C4 32
			15 00 00 00 00 00 02 C5 3C
			15 00 00 00 00 00 02 C6 45
			15 00 00 00 00 00 02 C7 4E
			15 00 00 00 00 00 02 C8 56
			15 00 00 00 00 00 02 C9 BC
			15 00 00 00 00 00 02 CA C4
			15 00 00 00 00 00 02 CB DF
			15 00 00 00 00 00 02 CC EB
			15 00 00 00 00 00 02 CD F3
			15 00 00 00 00 00 02 CE F5
			15 00 00 00 00 00 02 CF F7
			15 00 00 00 00 00 02 D0 FD
			15 00 00 00 00 00 02 D1 11
			15 00 00 00 00 00 02 D2 25
			15 00 00 00 00 00 02 D3 46
			15 00 00 00 00 00 02 D4 4E
			15 00 00 00 00 00 02 D5 B0
			15 00 00 00 00 00 02 D6 B7
			15 00 00 00 00 00 02 D7 BF
			15 00 00 00 00 00 02 D8 C8
			15 00 00 00 00 00 02 D9 D2
			15 00 00 00 00 00 02 DA DC
			15 00 00 00 00 00 02 DB E9
			15 00 00 00 00 00 02 DC F7
			15 00 00 00 00 00 02 DD FF
			15 00 00 00 00 00 02 DE 00
			15 01 00 00 00 00 02 DF 0F

			//34
			15 00 00 00 00 00 02 83 CC
			15 00 00 00 00 00 02 84 33
			15 00 00 00 00 00 02 91 EB	//Level 43

			15 00 00 00 00 00 02 83 AA
			15 00 00 00 00 00 02 84 11

			15 00 00 00 00 00 02 E0 00
			15 00 00 00 00 00 02 E1 0F
			15 00 00 00 00 00 02 E2 17
			15 00 00 00 00 00 02 E3 23
			15 00 00 00 00 00 02 E4 32
			15 00 00 00 00 00 02 E5 3C
			15 00 00 00 00 00 02 E6 45
			15 00 00 00 00 00 02 E7 4E
			15 00 00 00 00 00 02 E8 56
			15 00 00 00 00 00 02 E9 BC
			15 00 00 00 00 00 02 EA C4
			15 00 00 00 00 00 02 EB DF
			15 00 00 00 00 00 02 EC EB
			15 00 00 00 00 00 02 ED F3
			15 00 00 00 00 00 02 EE F5
			15 00 00 00 00 00 02 EF F7
			15 00 00 00 00 00 02 F0 FD
			15 00 00 00 00 00 02 F1 11
			15 00 00 00 00 00 02 F2 25
			15 00 00 00 00 00 02 F3 46
			15 00 00 00 00 00 02 F4 4E
			15 00 00 00 00 00 02 F5 B0
			15 00 00 00 00 00 02 F6 B7
			15 00 00 00 00 00 02 F7 BF
			15 00 00 00 00 00 02 F8 C8
			15 00 00 00 00 00 02 F9 D2
			15 00 00 00 00 00 02 FA DC
			15 00 00 00 00 00 02 FB E9
			15 00 00 00 00 00 02 FC F7
			15 00 00 00 00 00 02 FD FF
			15 00 00 00 00 00 02 FE 00
			15 01 00 00 00 00 02 FF 0F

			15 00 00 00 00 00 02 83 CC
			15 00 00 00 00 00 02 84 33
			15 00 00 00 00 00 02 91 E1	//Level 33

			//change page 2
			15 00 00 00 00 00 02 83 BB
			15 00 00 00 00 00 02 84 22
			//----G Gamma Register----

			//32
			15 00 00 00 00 00 02 C0 00
			15 00 00 00 00 00 02 C1 0A
			15 00 00 00 00 00 02 C2 16
			15 00 00 00 00 00 02 C3 22
			15 00 00 00 00 00 02 C4 2E
			15 00 00 00 00 00 02 C5 3A
			15 00 00 00 00 00 02 C6 44
			15 00 00 00 00 00 02 C7 4D
			15 00 00 00 00 00 02 C8 55
			15 00 00 00 00 00 02 C9 BA
			15 00 00 00 00 00 02 CA C1
			15 00 00 00 00 00 02 CB DF
			15 00 00 00 00 00 02 CC EB
			15 00 00 00 00 00 02 CD F3
			15 00 00 00 00 00 02 CE F6
			15 00 00 00 00 00 02 CF F8
			15 00 00 00 00 00 02 D0 FE
			15 00 00 00 00 00 02 D1 13
			15 00 00 00 00 00 02 D2 27
			15 00 00 00 00 00 02 D3 48
			15 00 00 00 00 00 02 D4 51
			15 00 00 00 00 00 02 D5 B1
			15 00 00 00 00 00 02 D6 B9
			15 00 00 00 00 00 02 D7 C1
			15 00 00 00 00 00 02 D8 C9
			15 00 00 00 00 00 02 D9 D2
			15 00 00 00 00 00 02 DA DD
			15 00 00 00 00 00 02 DB E9
			15 00 00 00 00 00 02 DC F7
			15 00 00 00 00 00 02 DD FF
			15 00 00 00 00 00 02 DE 00
			15 01 00 00 00 00 02 DF 0F

			15 00 00 00 00 00 02 83 CC
			15 00 00 00 00 00 02 84 33
			15 00 00 00 00 00 02 91 D7	//Level 23

			//change page 2
			15 00 00 00 00 00 02 83 BB
			15 00 00 00 00 00 02 84 22

			//34
			15 00 00 00 00 00 02 E0 00
			15 00 00 00 00 00 02 E1 0A
			15 00 00 00 00 00 02 E2 16
			15 00 00 00 00 00 02 E3 22
			15 00 00 00 00 00 02 E4 2E
			15 00 00 00 00 00 02 E5 3A
			15 00 00 00 00 00 02 E6 44
			15 00 00 00 00 00 02 E7 4D
			15 00 00 00 00 00 02 E8 55
			15 00 00 00 00 00 02 E9 BA
			15 00 00 00 00 00 02 EA C1
			15 00 00 00 00 00 02 EB DF
			15 00 00 00 00 00 02 EC EB
			15 00 00 00 00 00 02 ED F3
			15 00 00 00 00 00 02 EE F6
			15 00 00 00 00 00 02 EF F8
			15 00 00 00 00 00 02 F0 FE
			15 00 00 00 00 00 02 F1 13
			15 00 00 00 00 00 02 F2 27
			15 00 00 00 00 00 02 F3 48
			15 00 00 00 00 00 02 F4 51
			15 00 00 00 00 00 02 F5 B1
			15 00 00 00 00 00 02 F6 B9
			15 00 00 00 00 00 02 F7 C1
			15 00 00 00 00 00 02 F8 C9
			15 00 00 00 00 00 02 F9 D2
			15 00 00 00 00 00 02 FA DD
			15 00 00 00 00 00 02 FB E9
			15 00 00 00 00 00 02 FC F7
			15 00 00 00 00 00 02 FD FF
			15 00 00 00 00 00 02 FE 00
			15 00 00 00 00 00 02 FF 0F
			//change page 3
			15 00 00 00 00 00 02 83 CC
			15 01 00 00 00 00 02 84 33
			//----B Gamma Register----

			15 00 00 00 00 00 02 83 CC
			15 00 00 00 00 00 02 84 33
			15 00 00 00 00 00 02 91 CD	//Level 13

			//32
			15 00 00 00 00 00 02 C0 00
			15 00 00 00 00 00 02 C1 0B
			15 00 00 00 00 00 02 C2 12
			15 00 00 00 00 00 02 C3 15
			15 00 00 00 00 00 02 C4 22
			15 00 00 00 00 00 02 C5 31
			15 00 00 00 00 00 02 C6 3D
			15 00 00 00 00 00 02 C7 48
			15 00 00 00 00 00 02 C8 51
			15 00 00 00 00 00 02 C9 B7
			15 00 00 00 00 00 02 CA C0
			15 00 00 00 00 00 02 CB DE
			15 00 00 00 00 00 02 CC EB
			15 00 00 00 00 00 02 CD F4
			15 00 00 00 00 00 02 CE F8
			15 00 00 00 00 00 02 CF FA
			15 00 00 00 00 00 02 D0 01
			15 00 00 00 00 00 02 D1 17
			15 00 00 00 00 00 02 D2 2C
			15 00 00 00 00 00 02 D3 4C
			15 00 00 00 00 00 02 D4 54
			15 00 00 00 00 00 02 D5 B1
			15 00 00 00 00 00 02 D6 B8
			15 00 00 00 00 00 02 D7 C0
			15 00 00 00 00 00 02 D8 C7
			15 00 00 00 00 00 02 D9 D0
			15 00 00 00 00 00 02 DA D9
			15 00 00 00 00 00 02 DB E3
			15 00 00 00 00 00 02 DC EF
			15 00 00 00 00 00 02 DD F5
			15 00 00 00 00 00 02 DE 80
			15 01 00 00 00 00 02 DF 0F

			15 00 00 00 00 00 02 83 CC
			15 00 00 00 00 00 02 84 33
			15 00 00 00 00 00 02 90 10	//CE OFF

			//32
			15 00 00 00 00 00 02 E0 00
			15 00 00 00 00 00 02 E1 0B
			15 00 00 00 00 00 02 E2 12
			15 00 00 00 00 00 02 E3 15
			15 00 00 00 00 00 02 E4 22
			15 00 00 00 00 00 02 E5 31
			15 00 00 00 00 00 02 E6 3D
			15 00 00 00 00 00 02 E7 48
			15 00 00 00 00 00 02 E8 51
			15 00 00 00 00 00 02 E9 B7
			15 00 00 00 00 00 02 EA C0
			15 00 00 00 00 00 02 EB DE
			15 00 00 00 00 00 02 EC EB
			15 00 00 00 00 00 02 ED F4
			15 00 00 00 00 00 02 EE F8
			15 00 00 00 00 00 02 EF FA
			15 00 00 00 00 00 02 F0 01
			15 00 00 00 00 00 02 F1 17
			15 00 00 00 00 00 02 F2 2C
			15 00 00 00 00 00 02 F3 4C
			15 00 00 00 00 00 02 F4 54
			15 00 00 00 00 00 02 F5 B1
			15 00 00 00 00 00 02 F6 B8
			15 00 00 00 00 00 02 F7 C0
			15 00 00 00 00 00 02 F8 C7
			15 00 00 00 00 00 02 F9 D0
			15 00 00 00 00 00 02 FA D9
			15 00 00 00 00 00 02 FB E3
			15 00 00 00 00 00 02 FC EF
			15 00 00 00 00 00 02 FD F5
			15 00 00 00 00 00 02 FE 80
			15 01 00 00 64 00 02 FF 0F
			];
		lge,panel-cmd-mono-on = [
			15 01 00 00 00 00 02 83 CC
			15 01 00 00 00 00 02 84 33
			15 01 00 00 00 00 02 90 11
			15 01 00 00 00 00 02 91 FF
			];
		lge,panel-cmd-mono-off = [
			15 01 00 00 00 00 02 83 CC
			15 01 00 00 00 00 02 84 33
			15 01 00 00 00 00 02 90 10
			];
		qcom,mdss-pan-physical-width-dimension = <108>;
		qcom,mdss-pan-physical-height-dimension = <172>;
		qcom,mdss-dsi-h-sync-pulse = <0>;
		qcom,mdss-dsi-traffic-mode = "non_burst_sync_event";
		qcom,mdss-dsi-lane-map = "lane_map_0123";
		qcom,mdss-dsi-bllp-eof-power-mode;
		qcom,mdss-dsi-bllp-power-mode;
		qcom,mdss-dsi-lane-0-state;
		qcom,mdss-dsi-lane-1-state;
		qcom,mdss-dsi-lane-2-state;
		qcom,mdss-dsi-lane-3-state;
		qcom,mdss-dsi-panel-timings = [03 3E 2A 01 72 76 2E 42 4C 03 04 00];	//999Mhz
		qcom,mdss-dsi-t-clk-post = <0x02>;
		qcom,mdss-dsi-t-clk-pre = <0x32>;
		qcom,mdss-dsi-dma-trigger = "trigger_sw";
		qcom,mdss-dsi-mdp-trigger = "none";
		qcom,mdss-dsi-pan-enable-dynamic-fps;
		qcom,mdss-dsi-pan-fps-update = "dfps_immediate_porch_mode_vfp";
		qcom,mdss-dsi-min-refresh-rate = <48>;
		qcom,off-cmds-dsi-state = "dsi_hs_mode";

		lge,blmap-size = <256>;
		lge,blmap = <
			   0   50   50   50   50   50   50   50   50   50 	/*  0 ~   9*/
			  50   50   51   51   52   52   52   53   53   53 	/* 10 ~  19*/
			  54   54   55   55   57   58   60   62   63   65 	/* 20 ~  29*/
			  67   68   70   72   73   75   78   81   84   87 	/* 30 ~  39*/
			  90   92   95   98  101  104  107  110  113  117 	/* 40 ~  49*/
			 120  123  127  130  133  137  140  143  147  150 	/* 50 ~  59*/
			 156  162  167  173  179  185  190  196  202  208 	/* 60 ~  69*/
			 213  219  225  231  238  244  250  256  262  269 	/* 70 ~  79*/
			 275  281  288  294  300  308  317  325  333  342 	/* 80 ~  89*/
			 350  358  367  375  383  392  400  410  420  430 	/* 90 ~  99*/
			 440  450  460  470  480  490  500  510  520  530 	/*100 ~ 109*/
			 540  550  560  570  580  590  600  610  620  630 	/*110 ~ 119*/
			 640  650  664  678  692  707  721  735  749  763 	/*120 ~ 129*/
			 778  792  806  820  835  850  865  880  895  910 	/*130 ~ 139*/
			 925  940  955  970  985 1000 1017 1033 1050 1067 	/*140 ~ 149*/
			1083 1100 1117 1133 1150 1167 1183 1200 1222 1243 	/*150 ~ 159*/
			1265 1286 1308 1329 1351 1372 1394 1415 1437 1458 	/*160 ~ 169*/
			1480 1497 1513 1530 1547 1563 1580 1597 1613 1630 	/*170 ~ 179*/
			1647 1663 1680 1702 1725 1748 1770 1792 1815 1838 	/*180 ~ 189*/
			1860 1882 1905 1928 1950 1975 2000 2025 2050 2075 	/*190 ~ 199*/
			2100 2125 2150 2175 2200 2225 2250 2275 2301 2326 	/*200 ~ 209*/
			2352 2377 2402 2428 2453 2478 2504 2529 2555 2580 	/*210 ~ 219*/
			2607 2633 2660 2687 2713 2740 2767 2793 2820 2847 	/*220 ~ 229*/
			2873 2900 2933 2967 3000 3033 3067 3100 3133 3167 	/*230 ~ 239*/
			3200 3233 3267 3300 3333 3367 3400 3433 3467 3500 	/*240 ~ 249*/
			3533 3567 3600 3633 3667 3700 				/*250 ~ 255*/
			>;
	};
};
