/* Copyright (c) 2013, The Linux Foundation. All rights reserved.
 *
 * This program is free software; you can redistribute it and/or modify
 * it under the terms of the GNU General Public License version 2 and
 * only version 2 as published by the Free Software Foundation.
 *
 * This program is distributed in the hope that it will be useful,
 * but WITHOUT ANY WARRANTY; without even the implied warranty of
 * MERCHANTABILITY or FITNESS FOR A PARTICULAR PURPOSE.  See the
 * GNU General Public License for more details.
 */

/*---------------------------------------------------------------------------
 * This file is autogenerated file using gcdb parser. Please do not edit it.
 * Update input XML file to add a new entry or update variable in this file
 * VERSION = "1.0"
 *---------------------------------------------------------------------------*/
&mdss_mdp {
	dsi_lgd_nt35521_wxga_video: qcom,mdss_dsi_lgd_nt35521_wxga_video {
		compatible = "qcom,mdss-dsi-panel";
		status = "ok";
		qcom,cont-splash-enabled;
		qcom,mdss-dsi-panel-name = "lgd nt32221 wxga video mode dsi panel";
		qcom,mdss-dsi-panel-controller = <&mdss_dsi0>;
		qcom,mdss-dsi-panel-type = "dsi_video_mode";
		qcom,mdss-dsi-panel-destination = "display_1";
		qcom,mdss-dsi-panel-framerate = <60>;
		qcom,mdss-pan-physical-width-dimension = <94>;
		qcom,mdss-pan-physical-height-dimension = <150>;
		qcom,mdss-dsi-virtual-channel-id = <0>;
		qcom,mdss-dsi-stream = <0>;
		qcom,mdss-dsi-panel-width = <800>;
		qcom,mdss-dsi-panel-height = <1280>;
		qcom,mdss-dsi-h-front-porch = <38>;
		qcom,mdss-dsi-h-back-porch = <56>;
		qcom,mdss-dsi-h-pulse-width = <4>;
		qcom,mdss-dsi-h-sync-skew = <0>;
		qcom,mdss-dsi-v-back-porch = <32>;
		qcom,mdss-dsi-v-front-porch = <24>;
		qcom,mdss-dsi-v-pulse-width = <4>;
		qcom,mdss-dsi-h-left-border = <0>;
		qcom,mdss-dsi-h-right-border = <0>;
		qcom,mdss-dsi-v-top-border = <0>;
		qcom,mdss-dsi-v-bottom-border = <0>;
		qcom,mdss-dsi-bpp = <24>;
		qcom,mdss-dsi-color-order = "rgb_swap_rgb";
		qcom,mdss-dsi-underflow-color = <0xff>;
		qcom,mdss-dsi-border-color = <0>;

		qcom,mdss-dsi-on-command = [
			39 01 00 00 00 00 05
			FF AA 55 A5 80
			15 01 00 00 00 00 02
			6F 02
			15 01 00 00 00 00 02
			F7 47
			15 01 00 00 00 00 02
			6F 17
			15 01 00 00 00 00 02
			F4 60
			39 01 00 00 00 00 06
			F0 55 AA 52 08 00
			39 01 00 00 00 00 03
			B1 28 01
			15 01 00 00 00 00 02
			B5 C8
			15 01 00 00 00 00 02
			B6 05
			39 01 00 00 00 00 05
			B8 01 02 0C 02
			39 01 00 00 00 00 03
			BB 33 33
			39 01 00 00 00 00 03
			BC 05 05
			39 01 00 00 00 00 06
			BD 02 67 20 20 00
			15 01 00 00 00 00 02
			D0 00
			39 01 00 00 00 00 03
			D9 00 01
			15 01 00 00 00 00 02
			C8 83
			39 01 00 00 00 00 11
			CC 40 36 87 00 00 00 00 00 00 00 00 00 40 08 A5 05
			39 01 00 00 00 00 11
			D1 00 06 0A 0E 12 16 22 28 22 20 16 14 12 0E 08 00
			39 01 00 00 00 00 0D
			D7 26 28 25 23 23 00 00 00 00 00 00 00
			39 01 00 00 00 00 0E
			D8 00 00 00 00 00 00 00 00 00 00 23 25 00
			39 01 00 00 00 00 06
			F0 55 AA 52 08 01
			39 01 00 00 00 00 03
			B3 19 19
			39 01 00 00 00 00 03
			B4 1E 1E
			39 01 00 00 00 00 03
			B9 24 24
			39 01 00 00 00 00 03
			BA 36 36
			39 01 00 00 00 00 03
			BC 40 10
			39 01 00 00 00 00 03
			BD 40 10
			15 01 00 00 00 00 02
			C1 01
			15 01 00 00 00 00 02
			CA 80
			39 01 00 00 00 00 03
			CB 90 F4
			39 01 00 00 00 00 04
			CD 15 03 03
			39 01 00 00 00 00 04
			CF 00 50 50
			39 01 00 00 00 00 03
			D0 50 50
			39 01 00 00 00 00 03
			D1 50 50
			15 01 00 00 00 00 02
			D2 39
			15 01 00 00 00 00 02
			D3 39
			39 01 00 00 00 00 06
			F0 55 AA 52 08 02
			15 01 00 00 00 00 02
			EE 02
			39 01 00 00 00 00 11
			B0 00 44 00 55 00 6A 00 88 00 97 00 BB 00 D2 00 FE
			39 01 00 00 00 00 11
			B1 01 23 01 58 01 8A 01 D2 02 11 02 13 02 49 02 87
			39 01 00 00 00 00 11
			B2 02 AF 02 E5 03 0B 03 4E 03 6C 03 8E 03 A5 03 C0
			39 01 00 00 00 00 05
			B3 03 E8 03 FF
			39 01 00 00 00 00 11
			BC 00 0A 00 1C 00 32 00 52 00 62 00 88 00 A1 00 CE
			39 01 00 00 00 00 11
			BD 00 F4 01 2F 01 63 01 B0 01 F3 01 F5 02 2E 02 70
			39 01 00 00 00 00 11
			BE 02 9A 02 D3 02 FC 03 42 03 63 03 86 03 9E 03 BB
			39 01 00 00 00 00 05
			BF 03 E6 03 FF
			39 01 00 00 00 00 06
			F0 55 AA 52 08 03
			39 01 00 00 00 00 03
			B0 22 00
			39 01 00 00 00 00 03
			B1 22 00
			39 01 00 00 00 00 06
			B2 05 00 B0 00 00
			39 01 00 00 00 00 06
			B3 05 00 B0 00 00
			39 01 00 00 00 00 06
			B4 05 00 B0 00 00
			39 01 00 00 00 00 06
			B5 05 00 B0 00 00
			39 01 00 00 00 00 06
			BA 53 00 B0 00 00
			39 01 00 00 00 00 06
			BB 53 00 B0 00 00
			39 01 00 00 00 00 06
			BC 53 00 B0 00 00
			39 01 00 00 00 00 06
			BD 53 00 B0 00 00
			39 01 00 00 00 00 05
			C0 00 60 00 00
			39 01 00 00 00 00 05
			C1 00 00 60 00
			39 01 00 00 00 00 05
			C2 00 00 34 00
			39 01 00 00 00 00 05
			C3 00 00 34 00
			15 01 00 00 00 00 02
			C4 60
			15 01 00 00 00 00 02
			C5 C0
			15 01 00 00 00 00 02
			C6 00
			15 01 00 00 00 00 02
			C7 00
			39 01 00 00 00 00 06
			F0 55 AA 52 08 05
			39 01 00 00 00 00 03
			B0 17 06
			39 01 00 00 00 00 03
			B1 17 06
			39 01 00 00 00 00 03
			B2 17 06
			39 01 00 00 00 00 03
			B3 17 06
			39 01 00 00 00 00 03
			B4 17 06
			39 01 00 00 00 00 03
			B5 17 06
			39 01 00 00 00 00 03
			B6 17 06
			39 01 00 00 00 00 03
			B7 17 06
			15 01 00 00 00 00 02
			B8 00
			39 01 00 00 00 00 03
			B9 00 03
			39 01 00 00 00 00 03
			BA 00 00
			39 01 00 00 00 00 03
			BB 02 03
			39 01 00 00 00 00 03
			BC 02 03
			39 01 00 00 00 00 06
			BD 03 03 00 03 03
			15 01 00 00 00 00 02
			C0 0B
			15 01 00 00 00 00 02
			C1 09
			15 01 00 00 00 00 02
			C2 A6
			15 01 00 00 00 00 02
			C3 05
			15 01 00 00 00 00 02
			C4 00
			15 01 00 00 00 00 02
			C5 02
			15 01 00 00 00 00 02
			C6 22
			15 01 00 00 00 00 02
			C7 03
			39 01 00 00 00 00 03
			C8 07 20
			39 01 00 00 00 00 03
			C9 03 20
			39 01 00 00 00 00 03
			CA 01 60
			39 01 00 00 00 00 03
			CB 01 60
			39 01 00 00 00 00 04
			CC 00 00 78
			39 01 00 00 00 00 04
			CD 00 00 78
			39 01 00 00 00 00 04
			CE 00 00 02
			39 01 00 00 00 00 04
			CF 00 00 02
			39 01 00 00 00 00 06
			D1 00 05 01 07 10
			39 01 00 00 00 00 06
			D2 10 05 05 03 10
			39 01 00 00 00 00 06
			D3 20 00 43 07 10
			39 01 00 00 00 00 06
			D4 30 00 43 07 10
			39 01 00 00 00 00 08
			D0 00 00 00 00 00 00 00
			39 01 00 00 00 00 0C
			D5 00 00 00 00 00 00 00 00 00 00 00
			39 01 00 00 00 00 0C
			D6 00 00 00 00 00 00 00 00 00 00 00
			39 01 00 00 00 00 0C
			D7 00 00 00 00 00 00 00 00 00 00 00
			39 01 00 00 00 00 06
			D8 00 00 00 00 00
			15 01 00 00 00 00 02
			E5 06
			15 01 00 00 00 00 02
			E6 06
			15 01 00 00 00 00 02
			E7 00
			15 01 00 00 00 00 02
			E8 06
			15 01 00 00 00 00 02
			E9 06
			15 01 00 00 00 00 02
			EA 06
			15 01 00 00 00 00 02
			EB 00
			15 01 00 00 00 00 02
			EC 00
			15 01 00 00 00 00 02
			ED 30
			39 01 00 00 00 00 06
			F0 55 AA 52 08 06
			39 01 00 00 00 00 03
			B0 34 34
			39 01 00 00 00 00 03
			B1 34 34
			39 01 00 00 00 00 03
			B2 2D 2E
			39 01 00 00 00 00 03
			B3 34 34
			39 01 00 00 00 00 03
			B4 29 2A
			39 01 00 00 00 00 03
			B5 13 11
			39 01 00 00 00 00 03
			B6 19 17
			39 01 00 00 00 00 03
			B7 01 03
			39 01 00 00 00 00 03
			B8 34 31
			39 01 00 00 00 00 03
			B9 31 31
			39 01 00 00 00 00 03
			BA 31 31
			39 01 00 00 00 00 03
			BB 31 34
			39 01 00 00 00 00 03
			BC 02 00
			39 01 00 00 00 00 03
			BD 16 18
			39 01 00 00 00 00 03
			BE 10 12
			39 01 00 00 00 00 03
			BF 2A 29
			39 01 00 00 00 00 03
			C0 34 34
			39 01 00 00 00 00 03
			C1 2E 2D
			39 01 00 00 00 00 03
			C2 34 34
			39 01 00 00 00 00 03
			C3 34 34
			39 01 00 00 00 00 06
			D8 00 00 00 00 00
			39 01 00 00 00 00 06
			D9 00 00 00 00 00
			39 01 00 00 00 00 05
			FF AA 55 A5 00
			39 01 00 00 00 00 06
			F0 55 AA 52 00 00

			05 01 00 00 78 00 02
			11 00
			15 01 00 00 00 00 02
			51 FF
			15 01 00 00 00 00 02
			53 24
			15 01 00 00 00 00 02
			55 80
			05 01 00 00 00 00 02
			29 00
			];
		qcom,mdss-dsi-off-command = [
			05 01 00 00 32 00 01
			28 00
			05 01 00 00 78 00 01
			10 00
			];

		qcom,mdss-dsi-on-command-state = "dsi_lp_mode";
		qcom,mdss-dsi-off-command-state = "dsi_hs_mode";
		qcom,mdss-dsi-reader-mode-command-state = "dsi_hs_mode";
		qcom,mdss-dsi-h-sync-pulse = <0>;
		qcom,mdss-dsi-traffic-mode = "non_burst_sync_pulse";
		qcom,mdss-dsi-lane-map = "lane_map_0123";
		qcom,mdss-dsi-bllp-eof-power-mode;
		qcom,mdss-dsi-bllp-power-mode;
		qcom,mdss-dsi-lane-0-state;
		qcom,mdss-dsi-lane-1-state;
		qcom,mdss-dsi-lane-2-state;
		qcom,mdss-dsi-lane-3-state;
		qcom,mdss-dsi-lp11-init = <1>;
		qcom,mdss-dsi-panel-timings = [7A 1A 12 00 40 4C 12 20 14 03 04 00];
		qcom,mdss-dsi-t-clk-post = <0x04>;
		qcom,mdss-dsi-t-clk-pre = <0x1A>;
		qcom,mdss-dsi-dma-trigger = "trigger_sw";
		qcom,mdss-dsi-mdp-trigger = "none";
		qcom,mdss-dsi-reset-sequence = <1 10>, <0 20>, <1 200>;
	};
};
