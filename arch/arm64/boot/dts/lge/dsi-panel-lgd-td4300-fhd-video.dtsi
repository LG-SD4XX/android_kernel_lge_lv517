/* Copyright (c) 2014, Code Aurora Forum. All rights reserved.
 *
 * This program is free software; you can redistribute it and/or modify
 * it under the terms of the GNU General Public License version 2 and
 * only version 2 as published by the Free Software Foundation.
 *
 * This program is distributed in the hope that it will be useful,
 * but WITHOUT ANY WARRANTY; without even the implied warranty of
 * MERCHANTABILITY or FITNESS FOR A PARTICULAR PURPOSE.  See the
 * GNU General Public License for more details.
 */

&mdss_mdp {
	dsi_lgd_td4300_vid: qcom,mdss_dsi_lgd_td4300_fhd_video {
		compatible = "qcom,mdss-dsi-panel";
		qcom,mdss-dsi-panel-name = "LGD FHD video mode dsi panel";
		qcom,mdss-dsi-panel-controller = <&mdss_dsi0>;
		qcom,mdss-dsi-panel-type = "dsi_video_mode";
		qcom,mdss-dsi-panel-destination = "display_1";
		qcom,mdss-dsi-panel-framerate = <60>;
		qcom,mdss-dsi-virtual-channel-id = <0>;
		qcom,mdss-dsi-stream = <0>;

		qcom,mdss-dsi-panel-width = <1080>;
		qcom,mdss-dsi-panel-height = <1920>;

		qcom,mdss-dsi-h-front-porch = <116>;
		qcom,mdss-dsi-h-back-porch = <124>;
		qcom,mdss-dsi-h-pulse-width = <2>;
		qcom,mdss-dsi-h-sync-skew = <0>;
		qcom,mdss-dsi-v-back-porch = <4>;
		qcom,mdss-dsi-v-front-porch = <16>;
		qcom,mdss-dsi-v-pulse-width = <2>;

		qcom,mdss-pan-physical-width-dimension = <65>;
		qcom,mdss-pan-physical-height-dimension = <115>;

		qcom,mdss-dsi-h-left-border = <0>;
		qcom,mdss-dsi-h-right-border = <0>;
		qcom,mdss-dsi-v-top-border = <0>;
		qcom,mdss-dsi-v-bottom-border = <0>;
		qcom,mdss-dsi-bpp = <24>;
		qcom,mdss-dsi-color-order = "rgb_swap_rgb";
		qcom,mdss-dsi-underflow-color = <0xff>;
		qcom,mdss-dsi-border-color = <0xff>;

		qcom,mdss-dsi-on-command = [
			29 01 00 00 00 00 02	// MCAP
			B0 04
			29 01 00 00 00 00 02	// Sequencer test control
			D6 01

			29 01 00 00 00 00 11	// Source timing setting and SOUT equalize setting
			C4 70 00 00 00 00 00 00 00 00 02 02 25 01 00 00 00
			29 01 00 00 00 00 17	// LTPS timing setting
			C6 62 05 54 05 54 01 0E 01 02 01 02 01 02 01 02 01 02 08 15 06 7F FF
			29 01 00 00 00 00 1F	// Gamma setting common set
			C7 00 10 1A 24 33 40 4A 57 3A 42 4E 5B 64 6E 77 00 10 1A 24 33 40 4A 57 3A 42 4E 5B 64 6E 77
			29 01 00 00 00 00 14	// Digital gamma setting 1
			C8 00 00 FC 03 F5 FC 00 00 FC 03 F5 FC 00 00 FC 03 F5 FC 00
			29 01 00 00 00 00 14	// Digital gamma setting 2
			C9 00 00 FC 03 F5 FC 00 00 FC 03 F5 FC 00 00 FC 03 F5 FC 00
			29 01 00 00 00 00 2C	// Color enhancement
			CA 1D FC DA DC 00 FB FB F8 00 F8 F0 F0 00 E6 00 00 00 ED 00 00 00 F8 00 00 00 00 00 00 00 00 00 00 00 00 00 00 00 00 00 00 00 00 00
			29 01 00 00 00 00 12	// Power setting for CHGP
			D0 33 59 D9 31 01 10 10 10 19 19 00 00 00 00 00 00 00
			29 01 00 00 00 00 15	// Power setting for internal power
			D3 1B 3B BB 77 77 77 BB B3 33 00 00 6D 6B CB CB 33 BB F2 FD C6

			29 01 00 00 00 00 02	// Sequence test control
			D6 01
			29 01 00 00 00 00 02	// MCAP
			B0 03
			];

			qcom,mdss-dsi-post-panel-on-command = [
			05 01 00 00 78 00 01		/* Sleep out */
			11
			05 01 00 00 05 00 01		/* Display On */
			29
			];

		qcom,mdss-dsi-off-command = [
			05 01 00 00 00 00 01		/* Display off */
			28
			05 01 00 00 64 00 01		/* Sleep in */
			10
			];

		qcom,panel-reader-mode-initial-step1-command  = [ // low
			29 01 00 00 00 00 02	// MACP
			B0 04

			29 01 00 00 00 00 1F	// Gamma setting common set
			C7 00 09 13 22 31 39 40 49 30 38 41 4C 53 5D 67 00 09 13 22 31 39 40 49 30 38 41 4C 53 5D 67
			29 01 00 00 00 00 14	// Digital gamma setting 1
			C8 01 00 04 01 FF FC 00	00 02 FC FD FC 00 00 05 FB F2 FC 00
			29 01 00 00 00 00 2C	// Color enhancement
			CA 05 FC 5F 00 00 F8 0B 17 00 32 05 17 00 F1 05 00 00 15 EA 00 E6 0D 00 00 00 00 00 00 00 00 00 00 00 00 00 00 00 00 00 00 00 00 00

			29 01 00 00 0A 00 02	// MCAP
			B0 03
			];

		qcom,panel-reader-mode-step1-command  = [ // low
			29 01 00 00 00 00 02	// MACP
			B0 04

			29 01 00 00 00 00 1F	// Gamma setting common set
			C7 00 09 13 22 31 39 40 49 30 38 41 4C 53 5D 67 00 09 13 22 31 39 40 49 30 38 41 4C 53 5D 67
			29 01 00 00 00 00 14	// Digital gamma setting 1
			C8 01 00 04 01 FF FC 00	00 02 FC FD FC 00 00 05 FB F2 FC 00
			29 01 00 00 00 00 2C	// Color enhancement
			CA 05 FC 5F 00 00 F8 0B 17 00 32 05 17 00 F1 05 00 00 15 EA 00 E6 0D 00 00 00 00 00 00 00 00 00 00 00 00 00 00 00 00 00 00 00 00 00

			29 01 00 00 0A 00 02	// MCAP
			B0 03
			];

		qcom,panel-reader-mode-initial-step2-command  = [ // medieum
			29 01 00 00 00 00 02	// MACP
			B0 04

			29 01 00 00 00 00 1F	// Gamma setting common set
			C7 00 09 13 22 31 39 41 49 30 38 41 4C 53 5D 67 00 09 13 22 31 39 41 49 30 38 41 4C 53 5D 67
			29 01 00 00 00 00 14	// Digital gamma setting 1
			C8 01 00 04 01 04 FC 01 00 FE 01 FB 55 E0 00 02 02 FA 0F F0
			29 01 00 00 00 00 2C	// Color enhancement
			CA 05 FC 5E 22 00 F8 00 17 00 22 09 1C 00 FB 00 F8 25 2B 00 00 E6 0D 00 00 00 00 00 00 00 00 00 00 00 00 00 00 00 00 00 00 00 00 00

			29 01 00 00 0A 00 02	// MCAP
			B0 03
			];

		qcom,panel-reader-mode-step2-command  = [ // medieum
			29 01 00 00 00 00 02	// MACP
			B0 04

			29 01 00 00 00 00 1F	// Gamma setting common set
			C7 00 09 13 22 31 39 41 49 30 38 41 4C 53 5D 67 00 09 13 22 31 39 41 49 30 38 41 4C 53 5D 67
			29 01 00 00 00 00 14	// Digital gamma setting 1
			C8 01 00 04 01 04 FC 01 00 FE 01 FB 55 E0 00 02 02 FA 0F F0
			29 01 00 00 00 00 2C	// Color enhancement
			CA 05 FC 5E 22 00 F8 00 17 00 22 09 1C 00 FB 00 F8 25 2B 00 00 E6 0D 00 00 00 00 00 00 00 00 00 00 00 00 00 00 00 00 00 00 00 00 00

			29 01 00 00 0A 00 02	// MCAP
			B0 03
			];

		qcom,panel-reader-mode-initial-step3-command  = [ // high
			29 01 00 00 00 00 02	// MACP
			B0 04

			29 01 00 00 00 00 1F	// Gamma setting common set
			C7 00 09 13 22 31 39 40 49 30 38 41 4C 53 5D 67 00 09 13 22 31 39 40 49 30 38 41 4C 53 5D 67
			29 01 00 00 00 00 14	// Digital gamma setting 1
			C8 01 00 04 01 FF FC 00 00 FE 01 F1 59 00 00 01 03 F4 00 00
			29 01 00 00 00 00 2C	// Color enhancement
			CA 05 FC 56 00 00 F9 0B 17 00 32 05 1C 00 F1 05 00 00 1D EE 00 E5 0D 00 00 00 00 00 00 00 00 00 00 00 00 00 00 00 00 00 00 00 00 00

			29 01 00 00 0A 00 02	// MCAP
			B0 03
			];

		qcom,panel-reader-mode-step3-command  = [// high
			29 01 00 00 00 00 02	// MACP
			B0 04

			29 01 00 00 00 00 1F	// Gamma setting common set
			C7 00 09 13 22 31 39 40 49 30 38 41 4C 53 5D 67 00 09 13 22 31 39 40 49 30 38 41 4C 53 5D 67
			29 01 00 00 00 00 14	// Digital gamma setting 1
			C8 01 00 04 01 FF FC 00 00 FE 01 F1 59 00 00 01 03 F4 00 00
			29 01 00 00 00 00 2C	// Color enhancement
			CA 05 FC 56 00 00 F9 0B 17 00 32 05 1C 00 F1 05 00 00 1D EE 00 E5 0D 00 00 00 00 00 00 00 00 00 00 00 00 00 00 00 00 00 00 00 00 00

			29 01 00 00 0A 00 02	// MCAP
			B0 03
			];

		qcom,panel-reader-mode-off-command  = [ // off : 7300K
			29 01 00 00 00 00 02	// MACP
			B0 04

			29 01 00 00 00 00 1F	// Gamma setting common set
			C7 00 10 19 25 33 41 4A 57 3A 41 4D 5C 65 6D 77 00 10 19 25 33 41 4A 57 3A 41 4D 5C 65 6D 77
			29 01 00 00 00 00 14	// Digital gamma setting 1
			C8 00 00 00 02 F2 FC 00 00 00 02 F5 FC F0 00 00 02 F5 FC F0
			29 01 00 00 00 00 2C	// Color enhancement
			CA 1D FC DA DC 00 FB FB F8 00 F8 F0 F0 00 E6 00 00 00 ED 00 00 00 F8 00 00 00 00 00 00 00 00 00 00 00 00 00 00 00 00 00 00 00 00 00

			29 01 00 00 0A 00 02	// MCAP
			B0 03
			];

		/*qcom,mdss-dsi-on-command-state = "dsi_lp_mode";*/
		qcom,mdss-dsi-on-command-state = "dsi_lp_mode";
		qcom,mdss-dsi-off-command-state = "dsi_hs_mode";
		qcom,mdss-dsi-reader-mode-command-state = "dsi_lp_mode";
		qcom,mdss-dsi-h-sync-pulse = <0>;
		qcom,mdss-dsi-lane-map = "lane_map_0123";
		qcom,mdss-dsi-bllp-eof-power-mode;
		qcom,mdss-dsi-bllp-power-mode;
		qcom,mdss-dsi-lane-0-state;
		qcom,mdss-dsi-lane-1-state;
		qcom,mdss-dsi-lane-2-state;
		qcom,mdss-dsi-lane-3-state;
		qcom,mdss-dsi-tx-eot-append;

		qcom,mdss-dsi-panel-timings = [F2 3A 28 00 6C 6E 2C 3E 2E 03 04 00];

		qcom,mdss-dsi-reset-sequence = <0 10>, <0 10>, <1 15>;

		qcom,mdss-dsi-t-clk-post = <0x02>;
		qcom,mdss-dsi-t-clk-pre = <0x2D>;

		qcom,mdss-dsi-dma-trigger = "trigger_sw";

		/* KYH 20150904 modified from none to trigger_sw */
		qcom,mdss-dsi-mdp-trigger = "trigger_sw";

		//qcom,cont-splash-enabled;
		//qcom,mdss-dsi-force-clock-lane-hs;
		qcom,mdss-dsi-lp11-init;
		qcom,suspend-ulps-enabled;

		/* KYH 20150904 modified from DSI_NON_BURST_SYNCH_PULSE to DSI_NON_BURST_SYNCH_EVENT */
		qcom,mdss-dsi-traffic-mode = "non_burst_sync_event";

		qcom,mdss-dsi-post-init-delay = <1>;

		lge,mdss-mdp-esd-bl-delay = <50>;

		lge,blmap-size = <256>;
		lge,blmap = <
			0 45 45 45 45 45 45 45 45 45 				/* 0 ~ 9 */
			45 45 45 46 46 46 47 47 47 48				/* 10 ~ 19 */
			48 48 49 49 50 53 55 58 60 62				/* 20 ~ 29 */
			64 66 69 72 75 78 80 82 84 86				/* 30 ~ 39 */
			88 90 92 94 96 98 100 102 103 108				/* 40 ~ 49 */
			112 116 120 125 130 134 138 142 146 150			/* 50 ~ 59 */
			154 159 164 169 175 181 187 193 199 205			/* 60 ~ 69 */
			211 217 223 230 237 244 251 259 267 274			/* 70 ~ 79 */
			281 289 296 303 311 319 327 335 343 351			/* 80 ~ 89 */
			359 367 375 383 390 397 404 411 419 432			/* 90 ~ 99 */
			443 456 469 482 495 508 521 534 548 558			/* 100 ~ 109 */
			568 578 588 599 610 621 632 643 654 665			/* 110 ~ 119 */
			676 687 699 713 727 741 755 769 783 798			/* 120 ~ 129 */
			813 828 843 858 873 891 909 927 945 963			/* 130 ~ 139 */
			981 999 1017 1036 1055 1073 1089 1105 1121 1137		/* 140 ~ 149 */
			1153 1170 1188 1206 1224 1242 1260 1278 1295 1316	/* 150 ~ 159 */
			1337 1359 1381 1402 1423 1444 1465 1486 1507 1528	/* 160 ~ 169 */
			1550 1571 1592 1613 1634 1655 1676 1698 1720 1742	/* 170 ~ 179 */
			1764 1786 1808 1830 1857 1884 1911 1938 1965 1992	/* 180 ~ 189 */
			2019 2047 2075 2103 2130 2154 2178 2202 2226 2250	/* 190 ~ 199 */
			2274 2298 2322 2346 2371 2396 2421 2446 2470 2500	/* 200 ~ 209 */
			2530 2560 2590 2620 2650 2680 2710 2740 2770 2800	/* 210 ~ 219 */
			2830 2865 2900 2935 2970 3006 3042 3078 3114 3150	/* 220 ~ 229 */
			3185 3220 3255 3290 3326 3362 3398 3434 3470 3506	/* 230 ~ 239 */
			3542 3578 3614 3650 3687 3724 3761 3798 3835 3872	/* 240 ~ 249 */
			3909 3946 3983 4020 4057 4095>;				/* 250 ~ 255 */
	};
};
