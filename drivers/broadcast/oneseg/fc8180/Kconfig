## drivers/broadcast/oneseg/fc8180/Kconfig
```kconfig
#
# FC8180_DEVICE subsystem configuration
#

#menu "FC8180 support"

config FC8180_ISDB_T
	default n
	---help---
	  This driver implements the front-end of the Xen virtual
	  keyboard and mouse device driver.  It communicates with a back-end
	  in another domain.

#endmenu
```

## drivers/input/sensor/Kconfig
```kconfig
#
# Input misc drivers configuration
#
menuconfig INPUT_SENSOR
	bool "Sensor devices"
	help
	  Say Y here, and a list of Sensor input drivers will be displayed.
	  Everything that didn't fit into the other categories is here. This option
	  doesn't affect the kernel.

	  If unsure, say Y.

config SENSOR_ATMF04
       bool "ATMF04 support"
       depends on I2C
       help
         Support ATMF04 as an input device.

config LGE_USE_CAP_SENSOR
       bool "Capsensor device"
       help
         Support Capsensor for this model.

config SENSOR_ATMF04_2ND
       bool "Secondary ATMF04 support"
       depends on I2C
       help
         Support Secondary ATMF04 as an input device.
```

## drivers/input/touchscreen/lge/Kconfig
```kconfig
#
# LGE touch core configuration
#

if INPUT_TOUCHSCREEN

menuconfig LGE_TOUCH_CORE
	bool "LGE Touch Core - Generic"
	select LGE_TOUCH_CORE_BASE
	help
	  If your plaform is generic linux, say Y

menuconfig LGE_TOUCH_CORE_MTK
	bool "LGE Touch Core - MTK"
	select LGE_TOUCH_CORE_BASE
	help
	  If your plaform is mtk linux, say Y

menuconfig LGE_TOUCH_CORE_MTK_LEGACY
	bool "LGE Touch Core - MTK Legacy driver for old model(CY series)"
	select LGE_TOUCH_CORE_BASE
	help
	  If your plaform is mtk linux, say Y

menuconfig LGE_TOUCH_CORE_QCT
	bool "LGE Touch Core - QCT"
	select LGE_TOUCH_CORE_BASE
	help
	  If your plaform is qct linux, say Y

config LGE_TOUCH_CORE_BASE
	bool "LGE Touch Core Base"
	depends on SPI_MASTER && I2C

config LGE_TOUCH_FW_PATH
	string "LGE Touch Core Firmware Path"
	help
	LGE_TOUCH_FW_PATH is set to path of synaptics firmware

config LGE_MODULE_DETECT
	bool "Enable Module detection"
	default n
	help
	Feature for read device maker id, like lcd or touch maker

menuconfig LGE_TOUCH_HALL_IC_COVER
	bool "LGE Touch Core - Smart Cover"
	select LGE_TOUCH_CORE_BASE
	help
	  If your plaform use hall_ic(smart cover) detect, say Y

menuconfig LGE_TOUCH_DUAL
	bool "LGE Touch Core - Touch Dualization"
	select LGE_TOUCH_CORE_BASE
	help
	  If touch dualization is applied, say Y

source "drivers/input/touchscreen/lge/synaptics/Kconfig"
source "drivers/input/touchscreen/lge/focaltech/Kconfig"
source "drivers/input/touchscreen/lge/lgsic/Kconfig"
source "drivers/input/touchscreen/lge/novatek/Kconfig"
endif
```

## drivers/input/touchscreen/lge/focaltech/Kconfig
```kconfig
#
# LGE touch core configuration
#
if INPUT_TOUCHSCREEN

menuconfig LGE_TOUCH_FOCALTECH_FT8607
	bool "LGE Touch Core ODM Device Driver - FT8607"
	depends on LGE_TOUCH_CORE_BASE
	help
	  If your device is ft8607, say Y

# To Do : Focal Tech Chipseet
endif
```

## drivers/input/touchscreen/lge/lgsic/Kconfig
```kconfig
#
# LGE touch core configuration
#
if INPUT_TOUCHSCREEN

menuconfig LGE_TOUCH_LGSIC_LG4945
	bool "LGE Touch Core ODM Device Driver - LG4945"
	depends on LGE_TOUCH_CORE_BASE
	help
	  If your device is lg4945, say Y

menuconfig LGE_TOUCH_LGSIC_LG4946
	bool "LGE Touch Core ODM Device Driver - LG4946"
	depends on LGE_TOUCH_CORE_BASE
	help
	  If your device is lg4946, say Y

menuconfig LGE_TOUCH_LG4894
	bool "LGE Touch Core ODM Device Driver - LG4894"
	depends on LGE_TOUCH_CORE_BASE
	help
	  If your device is lg4894, say Y

menuconfig LGE_TOUCH_LGSIC_SW49105
	bool "LGE Touch Core ODM Device Driver - SW49105"
	depends on LGE_TOUCH_CORE_BASE
	help
	  If your device is sw49105, say Y

# To Do : LGSIC Chipseet
endif
```

## drivers/input/touchscreen/lge/novatek/Kconfig
```kconfig
#
# LGE touch core configuration
#

if INPUT_TOUCHSCREEN

menuconfig LGE_TOUCH_NOVATEK_NT11206
	bool "LGE Touch Core ODM Device Driver - Novatek(nt11206)"
	depends on LGE_TOUCH_CORE_BASE
	help
	  If your device is Novatek(nt11206), say Y

endif
```

## drivers/input/touchscreen/lge/synaptics/Kconfig
```kconfig
#
# LGE touch core configuration
#

if INPUT_TOUCHSCREEN

menuconfig LGE_TOUCH_SYNAPTICS_S3330
	bool "LGE Touch Core ODM Device Driver - Synaptics(s3330)"
	depends on LGE_TOUCH_CORE_BASE
	help
	  If your device is synaptics(s3330), say Y

menuconfig LGE_TOUCH_SYNAPTICS_S3330_LV9
	bool "LGE Touch Core ODM Device Driver - Synaptics(LV9 - s3330)"
	depends on LGE_TOUCH_CORE_BASE
	help
	  If your device is synaptics(s3330), say Y

menuconfig LGE_TOUCH_SYNAPTICS_TD4100
	bool "LGE Touch Core ODM Device Driver - Synaptics(td4100)"
	depends on LGE_TOUCH_CORE_BASE
	help
	  If your device is synaptics(td4100), say Y

menuconfig LGE_TOUCH_TOVIS_SYNAPTICS_TD4100
	bool "LGE Touch Core ODM Device Driver - Tovis & Synaptics(td4100)"
	depends on LGE_TOUCH_CORE_BASE
	help
	  If your device is synaptics(td4100), say Y

menuconfig LGE_TOUCH_SYNAPTICS_TD4310
	bool "LGE Touch Core ODM Device Driver - Synaptics(td4310)"
	depends on LGE_TOUCH_CORE_BASE
	help
	  If your device is synaptics(td4310), say Y

menuconfig LGE_TOUCH_TOVIS_PANEL
	bool "LGE Touch Core ODM Device Driver - Tovis panel"
	depends on LGE_TOUCH_CORE_BASE
	help
	  If your device panel is tovis, say Y

endif
```

## drivers/input/touchscreen/lge_jp/Kconfig
```kconfig
#
# LGE touch core configuration
#

if INPUT_TOUCHSCREEN

menuconfig LGE_TOUCH_CORE_JP
	bool "LGE Touch Core for JP Model - Generic"
	select LGE_TOUCH_CORE_BASE
	help
	  If your plaform is generic linux, say Y

source "drivers/input/touchscreen/lge_jp/focaltech/Kconfig"
source "drivers/input/touchscreen/lge_jp/synaptics/Kconfig"

endif
```

## drivers/input/touchscreen/lge_jp/focaltech/Kconfig
```kconfig
#
# LGE touch core configuration
#
if INPUT_TOUCHSCREEN

menuconfig LGE_TOUCH_FOCALTECH_FT8707
	bool "LGE Touch Core ODM Device Driver - FT8707"
	depends on LGE_TOUCH_CORE_BASE
	help
	  If your device is ft8707, say Y

# To Do : Focal Tech Chipseet
endif
```

## drivers/soc/qcom/lge/Kconfig
```kconfig
config MACH_LGE
	bool "Machine LGE"
	help
	  Support for machine LGE.

menu "LGE Board Selection"

config MACH_MSM8937_LGPS29
	bool "MSM8937 LGPS29"
	depends on ARCH_MSM8916
	select MACH_LGE
	help
	  Support for the Qualcomm MSM8937 LGPS29 device.

config MACH_MSM8937_PH2_GLOBAL_COM
	bool "MSM8937 PH2_GLOBAL_COM"
	depends on ARCH_MSM8916
	select MACH_LGE
	help
	  Support for the Qualcomm MSM8937 PH2_GLOBAL_COM device.

config MACH_MSM8937_PH2_CMO_CN
	bool "MSM8937 PH2_CMO_CN"
	depends on ARCH_MSM8916
	select MACH_LGE
	help
	  Support for the Qualcomm MSM8937 PH2_CMO_CN device.
 
config MACH_MSM8937_PH2N_TMO_US
	bool "MSM8937 PH2N_TMO_US"
	depends on ARCH_MSM8916
	select MACH_LGE
	help
	  Support for the Qualcomm MSM8937 PH2N_TMO_US device.

config MACH_MSM8937_PH2N_MPCS_US
	bool "MSM8937 PH2N_MPCS_US"
	depends on ARCH_MSM8916
	select MACH_LGE
	help
	  Support for the Qualcomm MSM8937 PH2N_MPCS_US device.	  

config MACH_MSM8937_PH2N_GLOBAL_CA
	bool "MSM8937 PH2N_GLOBAL_CA"
	depends on ARCH_MSM8916
	select MACH_LGE
	help
	  Support for the Qualcomm MSM8937 PH2N_GLOBAL_CA device.

config MACH_MSM8937_L5_DCM_JP
	bool "MSM8937 L5_DCM_JP"
	depends on ARCH_MSM8916
	select MACH_LGE
	help
	  Support for the Qualcomm MSM8937 L5_DCM_JP device.

config MACH_MSM8937_JSG_KDDI_JP
	bool "MSM8937 JSG_KDDI_JP"
	depends on ARCH_MSM8916
	select MACH_LGE
	help
	  Support for the Qualcomm MSM8937 JSG_KDDI_JP device.

config MACH_MSM8940_LGPS33
	bool "MSM8940 LGPS33"
	depends on ARCH_MSM8916
	select MACH_LGE
	help
	  Support for the Qualcomm MSM8940 LGPS33 device.

config MACH_MSM8940_SF3_SPR_US
bool "MSM8940 SF3_SPR_US"
	bool "MSM8940 SF3_SPR_US"
	depends on ARCH_MSM8916
	select MACH_LGE
	help
	  Support for the Qualcomm MSM8940 SF3_SPR_US device.

config MACH_MSM8940_SF3_TMO_US
bool "MSM8940 SF3_TMO_US"
        bool "MSM8940 SF3_TMO_US"
        depends on ARCH_MSM8916
        select MACH_LGE
        help
          Support for the Qualcomm MSM8940 SF3_TMO_US device.

config MACH_MSM8940_TF8_TMO_US
bool "MSM8940 TF8_TMO_US"
        bool "MSM8940 TF8_TMO_US"
        depends on ARCH_MSM8916
        select MACH_LGE
        help
          Support for the Qualcomm MSM8940 TF8_TMO_US device.

config MACH_MSM8940_SF3_MPCS_US
bool "MSM8940 SF3_MPCS_US"
         bool "MSM8940 SF3_MPCS_US"
         depends on ARCH_MSM8916
         select MACH_LGE
         help
           Support for the Qualcomm MSM8940 SF3_MPCS_US device.

config MACH_MSM8940_LV9_ATT_US
	bool "MSM8940 LV9_ATT_US"
	depends on ARCH_MSM8916
	select MACH_LGE
	help
	  Support for the Qualcomm MSM8940 LV9_ATT_US device.

config MACH_MSM8940_LV9_NAO_US
	bool "MSM8940 LV9_NAO_US"
	depends on ARCH_MSM8916
	select MACH_LGE
	help
	  Support for the Qualcomm MSM8940 LV9_NAO_US device.
	  
config MACH_MSM8917_LGPS29_1
	bool "MSM8917 LGPS29_1"
	depends on ARCH_MSM8916
	select MACH_LGE
	help
	  Support for the Qualcomm MSM8917 LGPS29_1 device.

config MACH_MSM8917_LV3_MPCS_US
bool "MSM8917 LV3_MPCS_US"
	depends on ARCH_MSM8916
	select MACH_LGE
	help
	  Support for the Qualcomm MSM8917 LV3_MPCS_US device.

config MACH_MSM8917_LV3_TMO_US
bool "MSM8917 LV3_TMO_US"
        depends on ARCH_MSM8916
        select MACH_LGE
        help
          Support for the Qualcomm MSM8917 LV3_TMO_US device.

	  
config MACH_MSM8917_LV3_USC_US
bool "MSM8917 LV3_USC_US"
	depends on ARCH_MSM8916
	select MACH_LGE
	help
	  Support for the Qualcomm MSM8917 LV3_USC_US device.

config MACH_MSM8917_LV3_LGU_KR
bool "MSM8917 LV3_LGU_KR"
	depends on ARCH_MSM8916
	select MACH_LGE
	help
	  Support for the Qualcomm MSM8917 LV3_LGU_KR device.

config MACH_MSM8917_LV3_SKT_KR
bool "MSM8917 LV3_SKT_KR"
	depends on ARCH_MSM8916
	select MACH_LGE
	help
	  Support for the Qualcomm MSM8917 LV3_SKT_KR device.

config MACH_MSM8917_LV3_KT_KR
bool "MSM8917 LV3_KT_KR"
	depends on ARCH_MSM8916
	select MACH_LGE
	help
	  Support for the Qualcomm MSM8917 LV3_KT_KR device.

config MACH_MSM8917_LV3_GLOBAL_COM
bool "MSM8917 LV3_GLOBAL_COM"
	depends on ARCH_MSM8916
	select MACH_LGE
	help
	  Support for the Qualcomm MSM8917 LV3_GLOBAL_COM device.

config MACH_MSM8917_B6_JCM_JP
bool "MSM8917 B6_JCM_JP"
	depends on ARCH_MSM8916
	select MACH_LGE
	help
	  Support for the Qualcomm MSM8917 B6_JCM_JP device.

config MACH_MSM8917_B6_LGU_KR
bool "MSM8917 B6_LGU_KR"
	depends on ARCH_MSM8916
	select MACH_LGE
	help
	  Support for the Qualcomm MSM8917 B6_LGU_KR device.

config MACH_MSM8917_LV7_TRF_US
bool "MSM8917 LV7_TRF_US"
	depends on ARCH_MSM8916
	select MACH_LGE
	help
	  Support for the Qualcomm MSM8917 LV7_TRF_US device.

config MACH_MSM8917_LV7_TRF_US_VZW
bool "MSM8917 LV7_TRF_US_VZW"
	depends on ARCH_MSM8916
	select MACH_LGE
	help
	  Support for the Qualcomm MSM8917 LV7_TRF_US_VZW device.

config MACH_MSM8917_LV7_CCT_US_VZW
bool "MSM8917 LV7_CCT_US_VZW"
        depends on ARCH_MSM8916
        select MACH_LGE
        help
          Support for the Qualcomm MSM8917 LV7_CCT_US_VZW device.

config MACH_MSM8917_LV7_CRK_US
bool "MSM8917 LV7_CRK_US"
        depends on ARCH_MSM8916
        select MACH_LGE
        help
          Support for the Qualcomm MSM8917 LV7_CRK_US device.

config MACH_MSM8917_LV7_GLOBAL_CA
bool "MSM8917 LV7_GLOBAL_CA"
        depends on ARCH_MSM8916
        select MACH_LGE
        help
          Support for the Qualcomm MSM8917 LV7_GLOBAL_CA device.

config MACH_MSM8917_LV517N_ATT_US
bool "MSM8917 LV517N_ATT_US"
	depends on ARCH_MSM8916
	select MACH_LGE
	help
	  Support for the Qualcomm MSM8917 LV517N_ATT_US device.

config MACH_MSM8917_LV517_CRK_US
bool "MSM8917 LV517_CRK_US"
	depends on ARCH_MSM8916
	select MACH_LGE
	help
	  Support for the Qualcomm MSM8917 LV517_CRK_US device.

config MACH_MSM8917_LV517_TMO_US
bool "MSM8917 LV517_TMO_US"
	depends on ARCH_MSM8916
	select MACH_LGE
	help
	  Support for the Qualcomm MSM8917 LV517_TMO_US device.

config MACH_MSM8917_LV517_MPCS_US
bool "MSM8917 LV517_MPCS_US"
	depends on ARCH_MSM8916
	select MACH_LGE
	help
	  Support for the Qualcomm MSM8917 LV517_MPCS_US device.	  

config MACH_MSM8917_LV517_TRF_US
bool "MSM8917 LV517_TRF_US"
	depends on ARCH_MSM8916
	select MACH_LGE
	help
	  Support for the Qualcomm MSM8917 LV517_TRF_US device.

config MACH_MSM8917_LV517_VZW
bool "MSM8917 LV517_VZW"
	depends on ARCH_MSM8916
	select MACH_LGE
	help
	  Support for the Qualcomm MSM8917 LV517_VZW device.

config MACH_MSM8917_SF317_TRF_US
bool "MSM8917 SF317_TRF_US"
	depends on ARCH_MSM8916
	select MACH_LGE
	help
	  Support for the Qualcomm MSM8917 SF317_TRF_US device.

config MACH_MSM8917_SF317_TRF_US_VZW
bool "MSM8917 SF317_TRF_US_VZW"
	depends on ARCH_MSM8916
	select MACH_LGE
	help
	  Support for the Qualcomm MSM8917 SF317_TRF_US_VZW device.

config MACH_MSM8917_SF317_CRK_US
bool "MSM8917 SF317_CRK_US"
	depends on ARCH_MSM8916
	select MACH_LGE
	help
	  Support for the Qualcomm MSM8917 SF317_CRK_US device.
endmenu

menu "LGE Specific Patches"

config LGE_HANDLE_PANIC
	tristate "Support LGE Crash Handler"
	default n
	depends on MACH_LGE
	help
	  LGE Crash Handler

config LGE_BOOTLOADER_LOG
	tristate "Support LGE bootloader log"
	default n
	depends on MACH_LGE
	help
	  LGE bootloader log

config LGE_BOOTLOADER_TIME_CHECKER
	tristate "Supprt bootloader(LK, SBL) time"
	default n
	depends on MACH_LGE
	help
	  Check LK, SBL booting time at
	  sys/module/lge_bootloader_time_checker/parameters/lk_time
	  sys/module/lge_bootloader_time_checker/parameters/sbl_time

config LGE_PM
	tristate "Support LGE power-management"
	default n
	depends on MACH_LGE
	help
	  Global feature of LGE power-management

config LGE_PM_DEBUG
        tristate "Support LGE PM Debug Feature"
        default n
        depends on MACH_LGE
        help
	  LGE PM Debug Feature

config LGE_PM_PSEUDO_BATTERY
	tristate "Support pseudo battery mode"
	depends on MACH_LGE
	default n
	help
	  Say Y here to enable pseudo mode setting

config LGE_PM_CHARGING_TEMP_SCENARIO
tristate "Support LGE PM Charging scenario"
	default n
	depends on MACH_LGE
	help
	  LGE PM Charing Scenario

config LGE_UART_CONTROL
	tristate "Support LGE uart control"
	default n
	depends on MACH_LGE && SERIAL_MSM_HSL
	help
	  This module controls uart console.

config LGE_EARJACK_DEBUGGER
	tristate "Earjack UART debugger support"
	default n
	depends on LGE_UART_CONTROL
	help
	  Support earjack type UART debugger cable

config LGE_PM_CABLE_DETECTION
    tristate "Support LGE PM Cable Detection"
	default n
	depends on MACH_LGE
	help
	  LGE PM Cable Detection

config LGE_PM_UNIFIED_NODE
	bool "enable LGE PM Unified sysfs node"
	default n
	depends on MACH_LGE
	help
	  Support LGE PM Unified sysfs node

config LGE_PM_ONBINARY_ORANGE
        tristate "Support LGE PM Onebinary orange Detection"
	default n
	depends on LGE_PM
	help
	  LGE PM Onebinary Orange Detection

config PRE_SELF_DIAGNOSIS
	tristate "Support LGE self diagnosis for factory"
	default n
	depends on MACH_LGE
	help
	  LGE self diagnosis
endmenu

menu "LGE QFPROM Values"

config LGE_QFPROM_INTERFACE
	bool "Support qfprom interface"
	default n
	depends on MACH_LGE
	help
	  LGE QFPROM DRIVER.

config LGE_QFPROM_SECHASH
	string "Support qfprom sec hash"
	default 0x0
	depends on LGE_QFPROM_INTERFACE
	help
	  LGE QFPROM DRIVER-SEC partition's hash value.
endmenu
```
